/dts-v1/;

/ {
	model = "MT6761";
	compatible = "mediatek,MT6761";
	interrupt-parent = <0x01>;
	#address-cells = <0x02>;
	#size-cells = <0x02>;

	chosen {
		bootargs = "console=tty0 console=ttyS0,921600n1 vmalloc=400M \t\t\t\tslub_debug=OFZPU page_owner=on \t\t\t\tswiotlb=noforce \t\t\t\tcgroup.memory=nosocket,nokmem \t\t\t\tandroidboot.hardware=mt6761 \t\t\t\tmaxcpus=8 loop.max_part=7 \t\t\t\tfirmware_class.path=/vendor/firmware";
		phandle = <0x26>;
	};

	opp_table0 {
		compatible = "operating-points-v2";
		opp-shared;
		phandle = <0x02>;

		opp0 {
			opp-hz = <0x00 0x32a9f880>;
			opp-microvolt = <0x9eb10>;
		};

		opp1 {
			opp-hz = <0x00 0x36b79180>;
			opp-microvolt = <0xa344e>;
		};

		opp2 {
			opp-hz = <0x00 0x3ad46cc0>;
			opp-microvolt = <0xa7d8c>;
		};

		opp3 {
			opp-hz = <0x00 0x3ef14800>;
			opp-microvolt = <0xac6ca>;
		};

		opp4 {
			opp-hz = <0x00 0x430e2340>;
			opp-microvolt = <0xb1008>;
		};

		opp5 {
			opp-hz = <0x00 0x487ab000>;
			opp-microvolt = <0xb71b0>;
		};

		opp6 {
			opp-hz = <0x00 0x4df67f00>;
			opp-microvolt = <0xbd358>;
		};

		opp7 {
			opp-hz = <0x00 0x53724e00>;
			opp-microvolt = "\0\f5";
		};

		opp8 {
			opp-hz = <0x00 0x57616280>;
			opp-microvolt = <0xc96a8>;
		};

		opp9 {
			opp-hz = <0x00 0x5b5fb940>;
			opp-microvolt = <0xcf850>;
		};

		opp10 {
			opp-hz = <0x00 0x61559a40>;
			opp-microvolt = <0xd8acc>;
		};

		opp11 {
			opp-hz = <0x00 0x6553f100>;
			opp-microvolt = <0xdec74>;
		};

		opp12 {
			opp-hz = <0x00 0x695247c0>;
			opp-microvolt = <0xe4e1c>;
		};

		opp13 {
			opp-hz = <0x00 0x6d509e80>;
			opp-microvolt = <0xeafc4>;
		};

		opp14 {
			opp-hz = <0x00 0x72431940>;
			opp-microvolt = <0xf29d6>;
		};

		opp15 {
			opp-hz = <0x00 0x7744d640>;
			opp-microvolt = <0xfa3e8>;
		};
	};

	cpus {
		#address-cells = <0x01>;
		#size-cells = <0x00>;

		cpu@000 {
			device_type = "cpu";
			compatible = "arm,cortex-a53";
			reg = <0x00>;
			enable-method = "psci";
			clock-frequency = <0x8b799100>;
			operating-points-v2 = <0x02>;
			dynamic-power-coefficient = <0x113>;
			capacity-dmips-mhz = <0x400>;
			cpu-idle-states = <0x03 0x04 0x05 0x06 0x07 0x08 0x09>;
			phandle = <0x0a>;
		};

		cpu@001 {
			device_type = "cpu";
			compatible = "arm,cortex-a53";
			reg = <0x01>;
			enable-method = "psci";
			clock-frequency = <0x8b799100>;
			operating-points-v2 = <0x02>;
			dynamic-power-coefficient = <0x113>;
			capacity-dmips-mhz = <0x400>;
			cpu-idle-states = <0x03 0x04 0x05 0x06 0x07 0x08 0x09>;
			phandle = <0x0b>;
		};

		cpu@002 {
			device_type = "cpu";
			compatible = "arm,cortex-a53";
			reg = <0x02>;
			enable-method = "psci";
			clock-frequency = <0x8b799100>;
			operating-points-v2 = <0x02>;
			dynamic-power-coefficient = <0x113>;
			capacity-dmips-mhz = <0x400>;
			cpu-idle-states = <0x03 0x04 0x05 0x06 0x07 0x08 0x09>;
			phandle = <0x0c>;
		};

		cpu@003 {
			device_type = "cpu";
			compatible = "arm,cortex-a53";
			reg = <0x03>;
			enable-method = "psci";
			clock-frequency = <0x8b799100>;
			operating-points-v2 = <0x02>;
			dynamic-power-coefficient = <0x113>;
			capacity-dmips-mhz = <0x400>;
			cpu-idle-states = <0x03 0x04 0x05 0x06 0x07 0x08 0x09>;
			phandle = <0x0d>;
		};

		cpu-map {

			cluster0 {

				core0 {
					cpu = <0x0a>;
				};

				core1 {
					cpu = <0x0b>;
				};

				core2 {
					cpu = <0x0c>;
				};

				core3 {
					cpu = <0x0d>;
				};
			};
		};

		idle-states {
			entry-method = "arm,psci";

			standby {
				compatible = "arm,idle-state";
				arm,psci-suspend-param = <0x01>;
				entry-latency-us = <0x258>;
				exit-latency-us = <0x258>;
				min-residency-us = <0x4b0>;
				phandle = <0x03>;
			};

			mcdi-cpu {
				compatible = "arm,idle-state";
				arm,psci-suspend-param = <0x10001>;
				entry-latency-us = <0x258>;
				exit-latency-us = <0x258>;
				min-residency-us = <0x4b0>;
				phandle = <0x04>;
			};

			mcdi-cluster {
				compatible = "arm,idle-state";
				arm,psci-suspend-param = <0x1010001>;
				entry-latency-us = <0x258>;
				exit-latency-us = <0x258>;
				min-residency-us = <0x4b0>;
				phandle = <0x05>;
			};

			sodi {
				compatible = "arm,idle-state";
				arm,psci-suspend-param = <0x1010002>;
				entry-latency-us = <0x320>;
				exit-latency-us = <0x3e8>;
				min-residency-us = <0x7d0>;
				phandle = <0x06>;
			};

			sodi3 {
				compatible = "arm,idle-state";
				arm,psci-suspend-param = <0x1010003>;
				entry-latency-us = <0x320>;
				exit-latency-us = <0x3e8>;
				min-residency-us = <0x7d0>;
				phandle = <0x07>;
			};

			dpidle {
				compatible = "arm,idle-state";
				arm,psci-suspend-param = <0x1010004>;
				entry-latency-us = <0x320>;
				exit-latency-us = <0x3e8>;
				min-residency-us = <0x7d0>;
				phandle = <0x08>;
			};

			suspend {
				compatible = "arm,idle-state";
				arm,psci-suspend-param = <0x1010005>;
				entry-latency-us = <0x320>;
				exit-latency-us = <0x3e8>;
				min-residency-us = <0x7d0>;
				phandle = <0x09>;
			};
		};
	};

	psci {
		compatible = "arm,psci-1.0";
		method = "smc";
	};

	pmu {
		compatible = "arm,cortex-a7-pmu";
		interrupt-parent = <0x0e>;
		interrupts = <0x01 0x07 0x08>;
	};

	l2c_parity {
		compatible = "mediatek,l2c_parity-v1";
		interrupts = <0x00 0x00 0x04>;
	};

	memory {
		device_type = "memory";
		reg = <0x00 0x40000000 0x00 0x20000000>;
	};

	reserved-memory {
		#address-cells = <0x02>;
		#size-cells = <0x02>;
		ranges;

		reserve-memory-sspm_share {
			compatible = "mediatek,reserve-memory-sspm_share";
			no-map;
			status = "okay";
			size = <0x00 0x110000>;
			alignment = <0x00 0x10000>;
			alloc-ranges = <0x00 0x40000000 0x00 0x60000000>;
		};

		reserve-memory-scp_share {
			compatible = "mediatek,reserve-memory-scp_share";
			no-map;
			size = <0x00 0x300000>;
			alignment = <0x00 0x1000000>;
			alloc-ranges = <0x00 0x40000000 0x00 0x50000000>;
		};

		consys-reserve-memory {
			compatible = "mediatek,consys-reserve-memory";
			no-map;
			size = <0x00 0x400000>;
			alignment = <0x00 0x1000000>;
			alloc-ranges = <0x00 0x40000000 0x00 0x80000000>;
			phandle = <0x48>;
		};

		wifi-reserve-memory {
			compatible = "shared-dma-pool";
			no-map;
			size = <0x00 0x300000>;
			alignment = <0x00 0x1000000>;
			alloc-ranges = <0x00 0x40000000 0x00 0x80000000>;
			phandle = <0x49>;
		};
	};

	utos {
		compatible = "microtrust,utos";
		interrupts = <0x00 0xbc 0x01 0x00 0xbd 0x01>;
	};

	utos_tester {
		compatible = "microtrust,tester-v1";
	};

	cpu_dbgapb@0d410000 {
		compatible = "mediatek,hw_dbg";
		num = <0x08>;
		reg = <0x00 0xd410000 0x00 0x1000 0x00 0xd510000 0x00 0x1000 0x00 0xd610000 0x00 0x1000 0x00 0xd710000 0x00 0x1000 0x00 0xd810000 0x00 0x1000 0x00 0xd910000 0x00 0x1000 0x00 0xda10000 0x00 0x1000 0x00 0xdb10000 0x00 0x1000>;
		phandle = <0x61>;
	};

	atf_logger {
		compatible = "mediatek,atf_logger";
		interrupts = <0x00 0x4e 0x01>;
	};

	amms_control {
		compatible = "mediatek,amms";
		interrupts = <0x00 0x43 0x01>;
	};

	interrupt-controller@0c000000 {
		compatible = "arm,gic-v3";
		#interrupt-cells = <0x03>;
		#address-cells = <0x02>;
		#size-cells = <0x02>;
		#redistributor-regions = <0x01>;
		interrupt-parent = <0x0e>;
		interrupt-controller;
		reg = <0x00 0xc000000 0x00 0x40000 0x00 0xc080000 0x00 0x200000 0x00 0x10200a80 0x00 0x50>;
		interrupts = <0x01 0x09 0x04>;
		phandle = <0x0e>;
	};

	intpol-controller@10200a80 {
		compatible = "mediatek,mt6577-sysirq";
		interrupt-controller;
		#interrupt-cells = <0x03>;
		interrupt-parent = <0x0e>;
		reg = <0x00 0x10200a80 0x00 0x50>;
		phandle = <0x01>;
	};

	infracfg_ao@10001000 {
		compatible = "mediatek,common-infracfg_ao\0mediatek,mt6761-infracfg\0syscon";
		reg = <0x00 0x10001000 0x00 0x1000>;
		interrupts = <0x00 0x5b 0x01>;
		#clock-cells = <0x01>;
		phandle = <0x22>;
	};

	mcdi@0010fc00 {
		compatible = "mediatek,mt6761-mcdi";
		reg = <0x00 0x10fc00 0x00 0x800>;
	};

	scpsys@10001000 {
		compatible = "mediatek,mt6761-scpsys\0syscon";
		reg = <0x00 0x10001000 0x00 0x1000 0x00 0x10006000 0x00 0x1000 0x00 0x14002000 0x00 0x1000 0x00 0x1020e000 0x00 0x1000 0x00 0x18004000 0x00 0x1000>;
		clocks = <0x0f 0x6b 0x0f 0x6d 0x10 0x15 0x10 0x16 0x10 0x13 0x10 0x14 0x11 0x00 0x11 0x01 0x10 0x19 0x10 0x18>;
		clock-names = "mm\0mfg\0mm-0\0mm-1\0mm-2\0mm-3\0cam-0\0cam-1\0cam-2\0cam-3";
		#clock-cells = <0x01>;
		phandle = <0x33>;
	};

	scp_infra@10001000 {
		compatible = "mediatek,scpinfra";
		reg = <0x00 0x10001000 0x00 0x1000>;
		phandle = <0x62>;
	};

	topckgen@10000000 {
		compatible = "mediatek,mt6761-topckgen\0syscon";
		reg = <0x00 0x10000000 0x00 0x1000>;
		#clock-cells = <0x01>;
		phandle = <0x0f>;
	};

	dcm@10001000 {
		compatible = "mediatek,mt6761-dcm";
		reg = <0x00 0x10001000 0x00 0x1000 0x00 0x10200000 0x00 0x4000 0x00 0x10228000 0x00 0x2000 0x00 0x1022a000 0x00 0x2000 0x00 0x10230000 0x00 0x2000 0x00 0x10232000 0x00 0x2000 0x00 0x1022d000 0x00 0x1000 0x00 0x10235000 0x00 0x1000>;
		reg-names = "infra_ao\0mcucfg\0ddrphy0_ao\0dramc0_ao\0ddrphy1_ao\0dramc1_ao\0emi_ch0\0emi_ch1";
		phandle = <0x63>;
	};

	io_cfg_lt@10002000 {
		compatible = "mediatek,io_cfg_lt";
		reg = <0x00 0x10002000 0x00 0x200>;
		phandle = <0x17>;
	};

	io_cfg_lm@10002200 {
		compatible = "mediatek,io_cfg_lm";
		reg = <0x00 0x10002200 0x00 0x200>;
		phandle = <0x18>;
	};

	io_cfg_lb@10002400 {
		compatible = "mediatek,io_cfg_lb";
		reg = <0x00 0x10002400 0x00 0x200>;
		phandle = <0x19>;
	};

	io_cfg_bl@10002600 {
		compatible = "mediatek,io_cfg_bl";
		reg = <0x00 0x10002600 0x00 0x200>;
		phandle = <0x1a>;
	};

	io_cfg_rr@10002800 {
		compatible = "mediatek,io_cfg_rr";
		reg = <0x00 0x10002800 0x00 0x200>;
		phandle = <0x1b>;
	};

	io_cfg_rb@10002a00 {
		compatible = "mediatek,io_cfg_rb";
		reg = <0x00 0x10002a00 0x00 0x200>;
		phandle = <0x1c>;
	};

	io_cfg_rt@10002c00 {
		compatible = "mediatek,io_cfg_rt";
		reg = <0x00 0x10002c00 0x00 0x200>;
		phandle = <0x1d>;
	};

	pericfg@10003000 {
		compatible = "mediatek,pericfg\0syscon";
		reg = <0x00 0x10003000 0x00 0x1000>;
		#clock-cells = <0x01>;
		phandle = <0x64>;
	};

	efuse_dbg@10004000 {
		compatible = "mediatek,efuse_dbg";
		reg = <0x00 0x10004000 0x00 0x1000>;
	};

	smart_pa {
		phandle = <0x65>;
	};

	tcpc_pd {
		phandle = <0x66>;
	};

	md1_sim1_hot_plug_eint {
		phandle = <0x67>;
	};

	md1_sim2_hot_plug_eint {
		phandle = <0x68>;
	};

	gpio {
		compatible = "mediatek,gpio_usage_mapping";
		phandle = <0x69>;
	};

	gpio@10005000 {
		compatible = "mediatek,gpio\0syscon";
		reg = <0x00 0x10005000 0x00 0x1000>;
		phandle = <0x16>;
	};

	syscfg_pctl_0@10005000 {
		compatible = "mediatek,mt6761-pctl-0-syscfg\0syscon";
		reg = <0x00 0x10005000 0x00 0x1000>;
		phandle = <0x6a>;
	};

	sleep@10006000 {
		compatible = "mediatek,sleep\0syscon";
		mediatek,pwrap-regmap = <0x12>;
		reg = <0x00 0x10006000 0x00 0x1000>;
		interrupts = <0x00 0x7d 0x08>;
		wakeup-source = <0x13 0x00 0x04 0x14 0x01 0x20 0x15 0x03 0x2000000>;
		phandle = <0x5f>;
	};

	eint@1000b000 {
		compatible = "mediatek,eint";
		reg = <0x00 0x1000b000 0x00 0x1000>;
		phandle = <0x6b>;
	};

	pinctrl@10005000 {
		compatible = "mediatek,mt6761-pinctrl";
		reg_bases = <0x16 0x17 0x18 0x19 0x1a 0x1b 0x1c 0x1d>;
		pins-are-numbered;
		gpio-controller;
		gpio-ranges = <0x1e 0x00 0x00 0xb3>;
		#gpio-cells = <0x02>;
		interrupt-controller;
		#interrupt-cells = <0x02>;
		interrupts = <0x00 0x73 0x04>;
		interrupt-parent = <0x0e>;
		phandle = <0x1e>;

		msdc0@default {
			phandle = <0x4b>;

			pins_cmd {
				drive-strength = [03];
			};

			pins_dat {
				drive-strength = [03];
			};

			pins_clk {
				drive-strength = [03];
			};

			pins_rst {
				drive-strength = [03];
			};

			pins_ds {
				drive-strength = [03];
			};
		};

		msdc0@hs400 {
			phandle = <0x4c>;

			pins_cmd {
				drive-strength = [03];
			};

			pins_dat {
				drive-strength = [04];
			};

			pins_clk {
				drive-strength = [04];
			};

			pins_rst {
				drive-strength = [03];
			};

			pins_ds {
				drive-strength = [04];
			};
		};

		msdc0@hs200 {
			phandle = <0x4d>;

			pins_cmd {
				drive-strength = [03];
			};

			pins_dat {
				drive-strength = [04];
			};

			pins_clk {
				drive-strength = [04];
			};

			pins_rst {
				drive-strength = [03];
			};

			pins_ds {
				drive-strength = [04];
			};
		};

		msdc0@register_default {
			cmd_edge = [00];
			rdata_edge = [00];
			wdata_edge = [00];
			phandle = <0x4e>;
		};

		msdc1@default {
			phandle = <0x50>;

			pins_cmd {
				drive-strength = [03];
			};

			pins_dat {
				drive-strength = [03];
			};

			pins_clk {
				drive-strength = [03];
			};
		};

		msdc1@sdr104 {
			phandle = <0x51>;

			pins_cmd {
				drive-strength = [03];
			};

			pins_dat {
				drive-strength = [03];
			};

			pins_clk {
				drive-strength = [03];
			};
		};

		msdc1@sdr50 {
			phandle = <0x52>;

			pins_cmd {
				drive-strength = [03];
			};

			pins_dat {
				drive-strength = [03];
			};

			pins_clk {
				drive-strength = [03];
			};
		};

		msdc1@ddr50 {
			phandle = <0x53>;

			pins_cmd {
				drive-strength = [03];
			};

			pins_dat {
				drive-strength = [03];
			};

			pins_clk {
				drive-strength = [03];
			};
		};

		msdc1@register_default {
			cmd_edge = [00];
			rdata_edge = [00];
			wdata_edge = [00];
			phandle = <0x54>;
		};

		msdc3@default {
			phandle = <0x6c>;

			pins_cmd {
				drive-strength = [04];
			};

			pins_dat {
				drive-strength = [04];
			};

			pins_clk {
				drive-strength = [04];
			};
		};

		msdc3@register_default {
			cmd_edge = [01];
			rdata_edge = [01];
			wdata_edge = [01];
			phandle = <0x6d>;
		};
	};

	toprgu@10007000 {
		compatible = "mediatek,mt6761-wdt\0mediatek,mt6589-wdt\0mediatek,toprgu\0syscon\0simple-mfd";
		reg = <0x00 0x10007000 0x00 0x1000>;
		interrupts = <0x00 0x53 0x00>;
		#reset-cells = <0x01>;
		phandle = <0x43>;

		reboot-mode {
			compatible = "syscon-reboot-mode";
			offset = <0x24>;
			mask = <0x0f>;
			mode-charger = <0x01>;
			mode-recovery = <0x02>;
			mode-bootloader = <0x03>;
			mode-dm-verity-dev-corrupt = <0x04>;
			mode-kpoc = <0x05>;
			mode-ddr-reserve = <0x06>;
			mode-meta = <0x07>;
			mode-rpmbpk = <0x08>;
		};
	};

	chipid@08000000 {
		compatible = "mediatek,chipid";
		reg = <0x00 0x8000000 0x00 0x04 0x00 0x8000004 0x00 0x04 0x00 0x8000008 0x00 0x04 0x00 0x800000c 0x00 0x04>;
	};

	mobicore {
		compatible = "trustonic,mobicore";
		interrupts = <0x00 0xc2 0x01>;
	};

	tkcore {
		compatible = "trustkernel,tkcore";
		interrupts = <0x00 0xc4 0x01>;
	};

	timer {
		compatible = "arm,armv8-timer";
		interrupt-parent = <0x0e>;
		interrupts = <0x01 0x0d 0x08 0x01 0x0e 0x08 0x01 0x0b 0x08 0x01 0x0a 0x08>;
		clock-frequency = <0xc65d40>;
	};

	clocks {

		clk26m {
			compatible = "fixed-clock";
			#clock-cells = <0x00>;
			clock-frequency = <0x18cba80>;
			phandle = <0x21>;
		};

		clk13m {
			compatible = "fixed-clock";
			#clock-cells = <0x00>;
			clock-frequency = <0xc65d40>;
			phandle = <0x2f>;
		};

		clk32k {
			compatible = "fixed-clock";
			#clock-cells = <0x00>;
			clock-frequency = <0x7d00>;
			phandle = <0x6e>;
		};
	};

	hacc@1000a000 {
		compatible = "mediatek,hacc";
		reg = <0x00 0x1000a000 0x00 0x1000>;
		interrupts = <0x00 0x85 0x08>;
	};

	apirq@1000b000 {
		compatible = "mediatek,apirq";
		reg = <0x00 0x1000b000 0x00 0x1000>;
		interrupts = <0x00 0x73 0x04>;
	};

	regulator_vibrator {
		compatible = "regulator-vibrator";
		min-volt = <0x231860>;
		max-volt = <0x30d400>;
		min-limit = <0x0f>;
		max-limit = <0x3a98>;
		vib-supply = <0x1f>;
	};

	apmixed@1000c000 {
		compatible = "mediatek,mt6761-apmixedsys\0syscon";
		reg = <0x00 0x1000c000 0x00 0xe00>;
		#clock-cells = <0x01>;
		phandle = <0x20>;
	};

	fhctl@1000ce00 {
		compatible = "mediatek,mt6761-fhctl";
		reg = <0x00 0x1000ce00 0x00 0x100>;
		mediatek,apmixed = <0x20>;
		phandle = <0x6f>;

		armpll {
			mediatek,fh-id = <0x00>;
			mediatek,fh-pll-id = <0x00>;
			mediatek,fh-cpu-pll;
		};

		mainpll {
			mediatek,fh-id = <0x01>;
			mediatek,fh-pll-id = <0x01>;
		};

		msdcpll {
			mediatek,fh-id = <0x02>;
			mediatek,fh-pll-id = <0x05>;
		};

		mfgpll {
			mediatek,fh-id = <0x03>;
			mediatek,fh-pll-id = <0x02>;
		};

		mpll {
			mediatek,fh-id = <0x05>;
			mediatek,fh-pll-id = <0x07>;
		};

		mmpll {
			mediatek,fh-id = <0x06>;
			mediatek,fh-pll-id = <0x03>;
		};
	};

	pwrap@1000d000 {
		compatible = "mediatek,mt6761-pwrap\0syscon";
		reg = <0x00 0x1000d000 0x00 0x1000>;
		reg-names = "pwrap";
		interrupts = <0x00 0x7b 0x04>;
		clocks = <0x21 0x22 0x02 0x0f 0x85>;
		clock-names = "spi\0wrap\0ulposc";
		phandle = <0x12>;

		main_pmic {
			compatible = "mediatek,mt6357";
			interrupt-controller;
			#interrupt-cells = <0x02>;
			interrupt-parent = <0x1e>;
			interrupts = <0x90 0x04 0x90 0x00>;
			phandle = <0x2b>;

			mtk_battery_oc_throttling {
				compatible = "mediatek,mt6357-battery_oc_throttling";
				oc-thd-h = <0x123e>;
				oc-thd-l = <0x157c>;
			};

			pmic_accdet {
				compatible = "mediatek,mt6357-accdet";
				accdet-name = "mt63xx-accdet";
				accdet-mic-vol = <0x06>;
				accdet-plugout-debounce = <0x01>;
				accdet-mic-mode = <0x01>;
				headset-mode-setting = <0x500 0x500 0x01 0x1f0 0x800 0x800 0x20 0x44>;
				headset-eint-level-pol = <0x08>;
				headset-use-ap-eint = <0x00>;
				headset-eint-num = <0x00>;
				headset-eint-trig-mode = <0x00>;
				headset-key-mode = <0x00>;
				headset-three-key-threshold = <0x00 0x50 0xdc 0x190>;
				headset-three-key-threshold-CDD = <0x00 0x79 0xc0 0x258>;
				headset-four-key-threshold = <0x00 0x3a 0x79 0xc0 0x190>;
				io-channels = <0x23 0x09>;
				io-channel-names = "pmic_accdet";
				nvmem = <0x24>;
				nvmem-names = "mt63xx-accdet-efuse";
				status = "okay";
				phandle = <0x70>;
			};

			mt6357keys {
				compatible = "mediatek,mt6357-keys";
				mediatek,long-press-mode = <0x01>;
				power-off-time-sec = <0x00>;
				phandle = <0x71>;

				power {
					linux,keycodes = <0x74>;
					wakeup-source;
				};

				home {
					linux,keycodes = <0x73>;
				};
			};

			pmic_auxadc {
				compatible = "mediatek,pmic-auxadc\0mediatek,mt6357-auxadc";
				#io-channel-cells = <0x01>;
				#interconnect-cells = <0x01>;
				phandle = <0x23>;

				batadc {
					channel = <0x00>;
					resistance-ratio = <0x03 0x01>;
					avg-num = <0x80>;
				};

				isense {
					channel = <0x01>;
					resistance-ratio = <0x03 0x01>;
					avg-num = <0x80>;
				};

				vcdt {
					channel = <0x02>;
				};

				bat_temp {
					channel = <0x03>;
					resistance-ratio = <0x01 0x01>;
				};

				chip_temp {
					channel = <0x05>;
				};

				vcore_temp {
					channel = <0x06>;
				};

				vproc_temp {
					channel = <0x07>;
				};

				accdet {
					channel = <0x09>;
				};

				tsx_temp {
					channel = <0x0b>;
					avg-num = <0x80>;
				};

				hpofs_cal {
					channel = <0x0c>;
					avg-num = <0x100>;
				};

				dcxo_temp {
					channel = <0x0d>;
					avg-num = <0x10>;
				};

				vbif {
					channel = <0x0e>;
					resistance-ratio = <0x01 0x01>;
				};

				imp {
					channel = <0x0f>;
					resistance-ratio = <0x03 0x01>;
					avg-num = <0x80>;
				};

				imix_r {
					channel = <0x10>;
				};
			};

			mtk_gauge {
				compatible = "mediatek,mt6357-gauge";
				charger = <0x25>;
				bootmode = <0x26>;
				io-channels = <0x23 0x03 0x23 0x00 0x23 0x0e 0x23 0x0f>;
				io-channel-names = "pmic_battery_temp\0pmic_battery_voltage\0pmic_bif_voltage\0pmic_ptim_voltage";
				nvmem-cells = <0x27 0x28>;
				nvmem-cell-names = "initialization\0state-of-charge";
				DIFFERENCE_FULLOCV_ITH = <0x64>;
				SHUTDOWN_1_TIME = <0x1e>;
				KEEP_100_PERCENT = <0x01>;
				R_FG_VALUE = <0x0a>;
				EMBEDDED_SEL = <0x01>;
				PMIC_SHUTDOWN_CURRENT = <0x14>;
				FG_METER_RESISTANCE = <0x4b>;
				CAR_TUNE_VALUE = <0x64>;
				PMIC_MIN_VOL = <0x82dc>;
				POWERON_SYSTEM_IBOOT = <0x1f4>;
				SHUTDOWN_GAUGE0_VOLTAGE = <0x84d0>;
				TEMPERATURE_T0 = <0x32>;
				TEMPERATURE_T1 = <0x19>;
				TEMPERATURE_T2 = <0x0a>;
				TEMPERATURE_T3 = <0x00>;
				TEMPERATURE_T4 = <0xfffffff6>;
				g_FG_PSEUDO100_T0 = <0x5a>;
				g_FG_PSEUDO100_T1 = <0x5a>;
				g_FG_PSEUDO100_T2 = <0x5a>;
				g_FG_PSEUDO100_T3 = <0x5a>;
				g_FG_PSEUDO100_T4 = <0x5a>;
				Q_MAX_SYS_VOLTAGE_BAT0 = <0xd16>;
				Q_MAX_SYS_VOLTAGE_BAT1 = <0xd16>;
				Q_MAX_SYS_VOLTAGE_BAT2 = <0xd16>;
				Q_MAX_SYS_VOLTAGE_BAT3 = <0xd16>;
				COM_FG_METER_RESISTANCE = <0x4b>;
				COM_R_FG_VALUE = <0x00>;
				battery0_profile_t0_num = <0x64>;
				battery0_profile_t0_col = <0x03>;
				battery0_profile_t0 = <0x00 0xa9ca 0x4d0 0x179 0xa9c3 0x4d0 0x2f3 0xa9bb 0x4d0 0x46c 0xa945 0x4d0 0x5e6 0xa8cf 0x4d0 0x75f 0xa85a 0x4d6 0x8d8 0xa7e5 0x4dc 0xa52 0xa770 0x4e3 0xbcb 0xa6fb 0x4e8 0xd44 0xa683 0x4e9 0xebe 0xa60c 0x4eb 0x1037 0xa595 0x4ee 0x11b1 0xa51e 0x4f1 0x132a 0xa4a8 0x4f1 0x14a3 0xa432 0x4f1 0x161d 0xa3bf 0x4f5 0x1796 0xa34b 0x4f9 0x190f 0xa2d8 0x4f7 0x1a89 0xa264 0x4f5 0x1c02 0xa1f5 0x4f7 0x1d7c 0xa186 0x4f9 0x1ef5 0xa118 0x4f9 0x206e 0xa0aa 0x4f9 0x21e8 0xa040 0x4fd 0x2361 0x9fd7 0x501 0x24da 0x9f70 0x503 0x2654 0x9f09 0x505 0x27cd 0x9ea4 0x506 0x2947 0x9e40 0x507 0x2ac0 0x9de0 0x50b 0x2c39 0x9d81 0x50e 0x2db3 0x9d26 0x513 0x2f2c 0x9ccb 0x518 0x30a5 0x9c72 0x51d 0x321f 0x9c1b 0x524 0x3398 0x9bc7 0x530 0x3512 0x9b74 0x53d 0x368b 0x9b23 0x54d 0x3804 0x9ad2 0x55e 0x397e 0x9a82 0x571 0x3af7 0x9a2e 0x57c 0x3c70 0x99ca 0x569 0x3dea 0x995f 0x546 0x3f63 0x98d5 0x4df 0x40dd 0x9856 0x487 0x4256 0x97fe 0x461 0x43cf 0x97aa 0x43f 0x4549 0x9765 0x42e 0x46c2 0x9724 0x420 0x483b 0x96ea 0x41b 0x49b5 0x96b3 0x418 0x4b2e 0x967f 0x416 0x4ca8 0x964c 0x414 0x4e21 0x961b 0x414 0x4f9a 0x95eb 0x415 0x5114 0x95bf 0x418 0x528d 0x9593 0x41b 0x5406 0x9569 0x41d 0x5580 0x9541 0x421 0x56f9 0x951c 0x428 0x5873 0x94f7 0x42e 0x59ec 0x94d4 0x432 0x5b65 0x94b1 0x436 0x5cdf 0x9490 0x43a 0x5e58 0x9470 0x440 0x5fd1 0x9453 0x449 0x614b 0x9436 0x453 0x62c4 0x941b 0x45e 0x643e 0x93fa 0x467 0x65b7 0x93d0 0x46b 0x6730 0x939b 0x461 0x68aa 0x934f 0x43a 0x6a23 0x930d 0x420 0x6b9d 0x92df 0x41e 0x6d16 0x92b2 0x41c 0x6e8f 0x9286 0x41a 0x7009 0x925b 0x418 0x7182 0x922f 0x416 0x72fb 0x9206 0x41d 0x7475 0x91e0 0x433 0x75ee 0x91b6 0x449 0x7768 0x9186 0x45e 0x78e1 0x914f 0x46a 0x7a5a 0x910c 0x46b 0x7bd4 0x90c9 0x45d 0x7d4d 0x9087 0x438 0x7ec6 0x9046 0x40b 0x8040 0x900a 0x3d3 0x81b9 0x8fe2 0x3c6 0x8333 0x8fd9 0x3f3 0x84ac 0x8fce 0x442 0x8625 0x8fc1 0x4bd 0x879f 0x8f9d 0x5e8 0x8918 0x8f5b 0x7ed 0x8a91 0x8e7c 0xa2c 0x8c0b 0x8ce4 0xcb0 0x8d84 0x8a62 0x15c4 0x8efe 0x86d1 0x2665 0x9077 0x862f 0x295c 0x91f0 0x862f 0x295c>;
				battery0_profile_t1_num = <0x64>;
				battery0_profile_t1_col = <0x03>;
				battery0_profile_t1 = <0x00 0xaa4e 0x460 0x179 0xa9c8 0x461 0x2f3 0xa942 0x462 0x46c 0xa8cc 0x466 0x5e6 0xa857 0x46a 0x75f 0xa7e1 0x46b 0x8d8 0xa76a 0x46c 0xa52 0xa6f2 0x471 0xbcb 0xa67a 0x476 0xd44 0xa602 0x47b 0xebe 0xa589 0x480 0x1037 0xa512 0x483 0x11b1 0xa49a 0x486 0x132a 0xa425 0x488 0x14a3 0xa3b0 0x48a 0x161d 0xa33b 0x490 0x1796 0xa2c7 0x496 0x190f 0xa254 0x49e 0x1a89 0xa1e2 0x4a5 0x1c02 0xa172 0x4ad 0x1d7c 0xa103 0x4b5 0x1ef5 0xa099 0x4c5 0x206e 0xa02e 0x4d5 0x21e8 0x9fc5 0x4df 0x2361 0x9f5b 0x4ea 0x24da 0x9ef4 0x4f1 0x2654 0x9e8e 0x4fa 0x27cd 0x9e2e 0x506 0x2947 0x9dcd 0x512 0x2ac0 0x9d6c 0x51c 0x2c39 0x9d0c 0x528 0x2db3 0x9cb4 0x538 0x2f2c 0x9c5c 0x549 0x30a5 0x9c06 0x561 0x321f 0x9bb1 0x577 0x3398 0x9b60 0x589 0x3512 0x9b0e 0x599 0x368b 0x9aba 0x59e 0x3804 0x9a61 0x59a 0x397e 0x99f7 0x57b 0x3af7 0x9986 0x550 0x3c70 0x9901 0x4fe 0x3dea 0x9884 0x4b7 0x3f63 0x981d 0x48b 0x40dd 0x97bf 0x469 0x4256 0x9775 0x45f 0x43cf 0x9730 0x457 0x4549 0x96f5 0x453 0x46c2 0x96bb 0x453 0x483b 0x9686 0x459 0x49b5 0x9652 0x45d 0x4b2e 0x9621 0x45d 0x4ca8 0x95f1 0x45e 0x4e21 0x95c5 0x463 0x4f9a 0x959a 0x46a 0x5114 0x9571 0x474 0x528d 0x954a 0x47e 0x5406 0x9525 0x489 0x5580 0x9501 0x493 0x56f9 0x94de 0x49b 0x5873 0x94bd 0x4a1 0x59ec 0x949e 0x4a4 0x5b65 0x947f 0x4a8 0x5cdf 0x9462 0x4ad 0x5e58 0x9445 0x4b4 0x5fd1 0x942b 0x4be 0x614b 0x9411 0x4c7 0x62c4 0x93f7 0x4cf 0x643e 0x93dc 0x4ce 0x65b7 0x93bd 0x4c3 0x6730 0x939a 0x4b7 0x68aa 0x9373 0x4a8 0x6a23 0x934b 0x496 0x6b9d 0x9321 0x481 0x6d16 0x92f6 0x471 0x6e8f 0x92ca 0x466 0x7009 0x92a3 0x464 0x7182 0x9280 0x46c 0x72fb 0x925a 0x476 0x7475 0x9230 0x480 0x75ee 0x91f9 0x47d 0x7768 0x91b6 0x46e 0x78e1 0x9177 0x46c 0x7a5a 0x913c 0x476 0x7bd4 0x90f5 0x470 0x7d4d 0x90a4 0x45b 0x7ec6 0x9073 0x458 0x8040 0x905e 0x466 0x81b9 0x904e 0x481 0x8333 0x9043 0x4a8 0x84ac 0x9032 0x4da 0x8625 0x901c 0x517 0x879f 0x8f8d 0x51d 0x8918 0x8ea4 0x4fb 0x8a91 0x8ce4 0x509 0x8c0b 0x8a8c 0x537 0x8d84 0x865e 0x5fd 0x8efe 0x80f8 0x728 0x9077 0x7ee3 0x79b 0x91f0 0x7ee3 0x79b>;
				battery0_profile_t2_num = <0x64>;
				battery0_profile_t2_col = <0x03>;
				battery0_profile_t2 = <0x00 0xaa4e 0x773 0x179 0xa9d3 0x773 0x2f3 0xa958 0x773 0x46c 0xa8e2 0x76b 0x5e6 0xa86d 0x764 0x75f 0xa7fa 0x764 0x8d8 0xa787 0x764 0xa52 0xa710 0x764 0xbcb 0xa699 0x763 0xd44 0xa623 0x75e 0xebe 0xa5ad 0x75a 0x1037 0xa536 0x767 0x11b1 0xa4bf 0x773 0x132a 0xa44a 0x77b 0x14a3 0xa3d5 0x782 0x161d 0xa363 0x782 0x1796 0xa2f2 0x781 0x190f 0xa280 0x779 0x1a89 0xa20e 0x774 0x1c02 0xa1a0 0x77c 0x1d7c 0xa131 0x785 0x1ef5 0xa0c6 0x78f 0x206e 0xa05b 0x798 0x21e8 0x9ff2 0x79a 0x2361 0x9f8a 0x7a0 0x24da 0x9f28 0x7b7 0x2654 0x9ec6 0x7cf 0x27cd 0x9e61 0x7e8 0x2947 0x9dfd 0x7ff 0x2ac0 0x9d98 0x80a 0x2c39 0x9d34 0x811 0x2db3 0x9cd7 0x80a 0x2f2c 0x9c7a 0x804 0x30a5 0x9c21 0x807 0x321f 0x9bc8 0x80a 0x3398 0x9b6f 0x812 0x3512 0x9b14 0x812 0x368b 0x9ab5 0x7fb 0x3804 0x9a53 0x7de 0x397e 0x99e4 0x7af 0x3af7 0x9975 0x77f 0x3c70 0x9905 0x74c 0x3dea 0x9899 0x71e 0x3f63 0x983c 0x6fe 0x40dd 0x97e2 0x6e1 0x4256 0x9794 0x6cd 0x43cf 0x974a 0x6c2 0x4549 0x970b 0x6cc 0x46c2 0x96cd 0x6d3 0x483b 0x9695 0x6d6 0x49b5 0x965e 0x6d6 0x4b2e 0x962d 0x6d1 0x4ca8 0x95fc 0x6cd 0x4e21 0x95cd 0x6ca 0x4f9a 0x95a0 0x6cc 0x5114 0x9575 0x6d6 0x528d 0x954c 0x6e1 0x5406 0x9526 0x6ef 0x5580 0x94ff 0x6f8 0x56f9 0x94d9 0x6fa 0x5873 0x94b6 0x703 0x59ec 0x9495 0x718 0x5b65 0x9475 0x727 0x5cdf 0x9458 0x72f 0x5e58 0x943b 0x733 0x5fd1 0x941f 0x731 0x614b 0x9404 0x72e 0x62c4 0x93e9 0x729 0x643e 0x93d1 0x727 0x65b7 0x93ba 0x728 0x6730 0x93a4 0x72e 0x68aa 0x938f 0x739 0x6a23 0x9379 0x745 0x6b9d 0x9361 0x753 0x6d16 0x9346 0x761 0x6e8f 0x9324 0x770 0x7009 0x9300 0x77e 0x7182 0x92da 0x78c 0x72fb 0x92b1 0x79d 0x7475 0x9287 0x7b4 0x75ee 0x9254 0x7c9 0x7768 0x9219 0x7db 0x78e1 0x91db 0x7f5 0x7a5a 0x919b 0x817 0x7bd4 0x9155 0x849 0x7d4d 0x910a 0x88b 0x7ec6 0x90c5 0x8c8 0x8040 0x9085 0x901 0x81b9 0x905c 0x965 0x8333 0x9045 0x9ed 0x84ac 0x902c 0xaa0 0x8625 0x9011 0xb75 0x879f 0x8fde 0xc9d 0x8918 0x8f9a 0xe02 0x8a91 0x8ea2 0xf82 0x8c0b 0x8d2f 0x1115 0x8d84 0x8ac5 0x1682 0x8efe 0x87bb 0x1e73 0x9077 0x8399 0x249a 0x91f0 0x7bb7 0x17eb>;
				battery0_profile_t3_num = <0x64>;
				battery0_profile_t3_col = <0x03>;
				battery0_profile_t3 = <0x00 0xaa79 0xd81 0x179 0xa9e8 0xd81 0x2f3 0xa957 0xd81 0x46c 0xa8db 0xd91 0x5e6 0xa85e 0xda0 0x75f 0xa7e6 0xda5 0x8d8 0xa76d 0xdaa 0xa52 0xa6f5 0xd9f 0xbcb 0xa67d 0xd94 0xd44 0xa607 0xd8e 0xebe 0xa590 0xd87 0x1037 0xa51b 0xd7c 0x11b1 0xa4a6 0xd71 0x132a 0xa431 0xd6a 0x14a3 0xa3bd 0xd62 0x161d 0xa34a 0xd5f 0x1796 0xa2d8 0xd5c 0x190f 0xa268 0xd5c 0x1a89 0xa1f8 0xd5c 0x1c02 0xa18b 0xd5c 0x1d7c 0xa11e 0xd5b 0x1ef5 0xa0b1 0xd56 0x206e 0xa044 0xd52 0x21e8 0x9fdd 0xd55 0x2361 0x9f77 0xd5c 0x24da 0x9f13 0xd7f 0x2654 0x9eae 0xd9d 0x27cd 0x9e41 0xda4 0x2947 0x9dd3 0xda7 0x2ac0 0x9d64 0xd92 0x2c39 0x9cf6 0xd7b 0x2db3 0x9c89 0xd5f 0x2f2c 0x9c1e 0xd42 0x30a5 0x9bbc 0xd26 0x321f 0x9b59 0xd0b 0x3398 0x9af5 0xcf6 0x3512 0x9a90 0xcdf 0x368b 0x9a27 0xcc3 0x3804 0x99c0 0xca7 0x397e 0x995e 0xc90 0x3af7 0x98fd 0xc7a 0x3c70 0x98a1 0xc67 0x3dea 0x9847 0xc54 0x3f63 0x97f3 0xc40 0x40dd 0x97a3 0xc31 0x4256 0x975d 0xc2d 0x43cf 0x9718 0xc2c 0x4549 0x96d8 0xc2e 0x46c2 0x969b 0xc33 0x483b 0x9663 0xc3e 0x49b5 0x962c 0xc46 0x4b2e 0x95f6 0xc49 0x4ca8 0x95c3 0xc50 0x4e21 0x9593 0xc60 0x4f9a 0x9564 0xc70 0x5114 0x953a 0xc82 0x528d 0x9510 0xc91 0x5406 0x94e8 0xc9c 0x5580 0x94c1 0xcaa 0x56f9 0x949b 0xcbb 0x5873 0x9477 0xccc 0x59ec 0x9457 0xcdc 0x5b65 0x9439 0xcec 0x5cdf 0x941e 0xcfc 0x5e58 0x9407 0xd15 0x5fd1 0x93f4 0xd3c 0x614b 0x93e1 0xd66 0x62c4 0x93ce 0xd95 0x643e 0x93bd 0xdc9 0x65b7 0x93ae 0xe05 0x6730 0x939b 0xe44 0x68aa 0x9386 0xe88 0x6a23 0x936e 0xed7 0x6b9d 0x9355 0xf31 0x6d16 0x9339 0xf8d 0x6e8f 0x931a 0xfeb 0x7009 0x92f6 0x104e 0x7182 0x92ce 0x10b6 0x72fb 0x92a1 0x1126 0x7475 0x926e 0x119d 0x75ee 0x9237 0x121b 0x7768 0x91fa 0x129f 0x78e1 0x91b9 0x1326 0x7a5a 0x9174 0x13ae 0x7bd4 0x912d 0x145c 0x7d4d 0x90e4 0x152c 0x7ec6 0x909f 0x161c 0x8040 0x905d 0x1725 0x81b9 0x9029 0x1884 0x8333 0x8fff 0x1a24 0x84ac 0x8fd3 0x1c95 0x8625 0x8fa5 0x1f9f 0x879f 0x8f5b 0x2544 0x8918 0x8efc 0x2cb6 0x8a91 0x8e57 0x341d 0x8c0b 0x8d0b 0x34cf 0x8d84 0x8ac4 0x3109 0x8efe 0x886b 0x2d1c 0x9077 0x886b 0x2d1c 0x91f0 0x886b 0x2d1c>;
				battery0_profile_t4_num = <0x64>;
				battery0_profile_t4_col = <0x03>;
				battery0_profile_t4 = <0x00 0xaa95 0x182e 0x179 0xa9e9 0x182e 0x2f3 0xa93e 0x182e 0x46c 0xa8b0 0x1824 0x5e6 0xa823 0x1819 0x75f 0xa79f 0x17f7 0x8d8 0xa71c 0x17d4 0xa52 0xa69c 0x17ae 0xbcb 0xa61d 0x1787 0xd44 0xa5a3 0x1760 0xebe 0xa529 0x1738 0x1037 0xa4b2 0x1712 0x11b1 0xa43a 0x16eb 0x132a 0xa3c3 0x16ca 0x14a3 0xa34d 0x16a8 0x161d 0xa2da 0x1684 0x1796 0xa266 0x1661 0x190f 0xa1f4 0x1643 0x1a89 0xa182 0x1626 0x1c02 0xa10f 0x1604 0x1d7c 0xa09c 0x15e3 0x1ef5 0xa02c 0x15c4 0x206e 0x9fbc 0x15a9 0x21e8 0x9f54 0x15a6 0x2361 0x9ee9 0x15a1 0x24da 0x9e74 0x158e 0x2654 0x9dfe 0x1577 0x27cd 0x9d85 0x154b 0x2947 0x9d0c 0x151f 0x2ac0 0x9c97 0x14f0 0x2c39 0x9c23 0x14c1 0x2db3 0x9bb6 0x1492 0x2f2c 0x9b4c 0x1468 0x30a5 0x9af0 0x1453 0x321f 0x9a95 0x143f 0x3398 0x9a3e 0x142d 0x3512 0x99e7 0x141d 0x368b 0x9990 0x140f 0x3804 0x9939 0x1403 0x397e 0x98e5 0x13f9 0x3af7 0x9892 0x13f0 0x3c70 0x9844 0x13ed 0x3dea 0x97f7 0x13ea 0x3f63 0x97ae 0x13e8 0x40dd 0x9766 0x13e8 0x4256 0x9723 0x13ed 0x43cf 0x96e1 0x13f2 0x4549 0x96a3 0x13f7 0x46c2 0x9666 0x13fe 0x483b 0x962c 0x1406 0x49b5 0x95f4 0x1411 0x4b2e 0x95bf 0x1423 0x4ca8 0x958b 0x1434 0x4e21 0x955b 0x1444 0x4f9a 0x952c 0x1454 0x5114 0x94fe 0x1466 0x528d 0x94d2 0x1479 0x5406 0x94a9 0x148f 0x5580 0x9481 0x14a6 0x56f9 0x945f 0x14bf 0x5873 0x943f 0x14de 0x59ec 0x9425 0x1505 0x5b65 0x940c 0x152f 0x5cdf 0x93f4 0x155d 0x5e58 0x93de 0x1592 0x5fd1 0x93ca 0x15d1 0x614b 0x93b4 0x1615 0x62c4 0x939d 0x1661 0x643e 0x9385 0x16b5 0x65b7 0x936e 0x1715 0x6730 0x9355 0x177d 0x68aa 0x9338 0x17ec 0x6a23 0x931b 0x1863 0x6b9d 0x92fc 0x18e2 0x6d16 0x92da 0x196c 0x6e8f 0x92b7 0x1a00 0x7009 0x9290 0x1a9d 0x7182 0x9268 0x1b43 0x72fb 0x923d 0x1bf9 0x7475 0x9212 0x1cc1 0x75ee 0x91e2 0x1d96 0x7768 0x91af 0x1e79 0x78e1 0x9179 0x1f7e 0x7a5a 0x9141 0x20a3 0x7bd4 0x9108 0x2209 0x7d4d 0x90ce 0x23a7 0x7ec6 0x9095 0x25bc 0x8040 0x905d 0x2836 0x81b9 0x9027 0x2bc4 0x8333 0x8ff2 0x302f 0x84ac 0x8fdb 0x3219 0x8625 0x8fdb 0x3219 0x879f 0x8fdb 0x3219 0x8918 0x8fdb 0x3219 0x8a91 0x8fdb 0x3219 0x8c0b 0x8fdb 0x3219 0x8d84 0x8fdb 0x3219 0x8efe 0x8fdb 0x3219 0x9077 0x8fdb 0x3219 0x91f0 0x8fdb 0x3219>;
				battery1_profile_t0_num = <0x64>;
				battery1_profile_t0_col = <0x03>;
				battery1_profile_t0 = <0x00 0xa960 0x492 0x16c 0xa8f3 0x490 0x2d9 0xa881 0x48f 0x445 0xa80d 0x48f 0x5b1 0xa799 0x48f 0x71e 0xa72b 0x499 0x88a 0xa6ba 0x49f 0x9f7 0xa645 0x49f 0xb63 0xa5d1 0x49f 0xccf 0xa55d 0x49f 0xe3c 0xa4e8 0x49f 0xfa8 0xa474 0x49f 0x1114 0xa407 0x4ab 0x1281 0xa395 0x4a8 0x13ed 0xa323 0x4a2 0x1559 0xa2b6 0x4ae 0x16c6 0xa249 0x4b0 0x1832 0xa1db 0x4b6 0x199f 0xa16e 0x4bf 0x1b0b 0xa101 0x4b3 0x1c77 0xa09a 0x4b9 0x1de4 0xa031 0x4c1 0x1f50 0x9fc4 0x4c1 0x20bc 0x9f65 0x4cd 0x2229 0x9f02 0x4d1 0x2395 0x9e9e 0x4d4 0x2501 0x9e40 0x4e0 0x266e 0x9de1 0x4e2 0x27da 0x9d83 0x4e8 0x2947 0x9d25 0x4f4 0x2ab3 0x9cce 0x500 0x2c1f 0x9c77 0x50c 0x2d8c 0x9c22 0x519 0x2ef8 0x9bd2 0x525 0x3064 0x9b82 0x531 0x31d1 0x9b2d 0x535 0x333d 0x9ad8 0x53b 0x34a9 0x9a88 0x554 0x3616 0x9a32 0x557 0x3782 0x99cf 0x54b 0x38ef 0x995f 0x52c 0x3a5b 0x98d5 0x4e4 0x3bc7 0x9866 0x4bf 0x3d34 0x9808 0x4a7 0x3ea0 0x97b8 0x48f 0x400c 0x9777 0x48f 0x4179 0x973a 0x48f 0x42e5 0x96ff 0x48f 0x4451 0x96c5 0x48f 0x45be 0x9691 0x48f 0x472a 0x965f 0x48f 0x4897 0x962d 0x490 0x4a03 0x9601 0x49c 0x4b6f 0x95d5 0x49f 0x4cdc 0x95aa 0x49f 0x4e48 0x957e 0x49f 0x4fb4 0x955a 0x4ab 0x5121 0x9535 0x4b8 0x528d 0x9511 0x4c1 0x53f9 0x94ed 0x4c1 0x5566 0x94c8 0x4c1 0x56d2 0x94a7 0x4c7 0x583f 0x948a 0x4d3 0x59ab 0x946d 0x4df 0x5b17 0x9450 0x4eb 0x5c84 0x9433 0x4f3 0x5df0 0x9416 0x4f3 0x5f5c 0x93f9 0x4f3 0x60c9 0x93d3 0x4eb 0x6235 0x93a0 0x4d6 0x63a1 0x9357 0x4a5 0x650e 0x931b 0x49f 0x667a 0x92e8 0x49f 0x67e7 0x92bd 0x49f 0x6953 0x9291 0x49f 0x6abf 0x9265 0x49f 0x6c2c 0x923c 0x49f 0x6d98 0x9218 0x49f 0x6f04 0x91f4 0x49f 0x7071 0x91d4 0x4ae 0x71dd 0x91b1 0x4be 0x7349 0x917e 0x4b2 0x74b6 0x913f 0x4a5 0x7622 0x9105 0x4a5 0x778f 0x90d0 0x4ae 0x78fb 0x908e 0x4a2 0x7a67 0x9047 0x496 0x7bd4 0x900f 0x48f 0x7d40 0x8ff2 0x48f 0x7eac 0x8feb 0x4a7 0x8019 0x8fe3 0x4bf 0x8185 0x8fd9 0x4da 0x82f1 0x8fc3 0x4ff 0x845e 0x8f8d 0x523 0x85ca 0x8edf 0x511 0x8737 0x8da3 0x4d3 0x88a3 0x8bbc 0x4df 0x8a0f 0x892b 0x506 0x8b7c 0x8599 0x572 0x8ce8 0x80b6 0x640>;
				battery1_profile_t1_num = <0x64>;
				battery1_profile_t1_col = <0x03>;
				battery1_profile_t1 = <0x00 0xa9f6 0x622 0x16c 0xa973 0x620 0x2d9 0xa8f4 0x61f 0x445 0xa87a 0x622 0x5b1 0xa806 0x62e 0x71e 0xa791 0x625 0x88a 0xa71c 0x625 0x9f7 0xa6a8 0x62f 0xb63 0xa633 0x62f 0xccf 0xa5bf 0x639 0xe3c 0xa54a 0x640 0xfa8 0xa4d5 0x640 0x1114 0xa461 0x634 0x1281 0xa3ec 0x637 0x13ed 0xa37a 0x643 0x1559 0xa30c 0x650 0x16c6 0xa298 0x651 0x1832 0xa228 0x651 0x199f 0xa1ba 0x651 0x1b0b 0xa14d 0x651 0x1c77 0xa0e6 0x65a 0x1de4 0xa07d 0x661 0x1f50 0xa010 0x662 0x20bc 0x9fa9 0x66e 0x2229 0x9f43 0x67a 0x2395 0x9ee0 0x68a 0x2501 0x9e81 0x6a2 0x266e 0x9e1b 0x6a4 0x27da 0x9db9 0x6ab 0x2947 0x9d5c 0x6b9 0x2ab3 0x9d05 0x6d1 0x2c1f 0x9cad 0x6ea 0x2d8c 0x9c56 0x6fd 0x2ef8 0x9bfe 0x708 0x3064 0x9ba7 0x708 0x31d1 0x9b54 0x719 0x333d 0x9b02 0x725 0x34a9 0x9aaa 0x719 0x3616 0x9a45 0x70d 0x3782 0x99d7 0x6ec 0x38ef 0x995f 0x6b4 0x3a5b 0x98dc 0x65f 0x3bc7 0x9871 0x632 0x3d34 0x9815 0x619 0x3ea0 0x97c6 0x60d 0x400c 0x977d 0x601 0x4179 0x9739 0x5f5 0x42e5 0x96fc 0x5f1 0x4451 0x96c9 0x5fd 0x45be 0x9696 0x609 0x472a 0x9663 0x60e 0x4897 0x9630 0x60b 0x4a03 0x95fd 0x5ff 0x4b6f 0x95d7 0x612 0x4cdc 0x95af 0x61f 0x4e48 0x9584 0x620 0x4fb4 0x9560 0x62c 0x5121 0x9536 0x626 0x528d 0x950f 0x628 0x53f9 0x94f2 0x640 0x5566 0x94ce 0x634 0x56d2 0x94ae 0x637 0x583f 0x9491 0x643 0x59ab 0x9474 0x64f 0x5b17 0x9456 0x651 0x5c84 0x9439 0x651 0x5df0 0x941c 0x651 0x5f5c 0x93ff 0x651 0x60c9 0x93e2 0x651 0x6235 0x93c5 0x64c 0x63a1 0x93a7 0x640 0x650e 0x9383 0x634 0x667a 0x935f 0x628 0x67e7 0x9338 0x61b 0x6953 0x930c 0x60f 0x6abf 0x92e7 0x60e 0x6c2c 0x92c3 0x60e 0x6d98 0x92a0 0x610 0x6f04 0x9282 0x61c 0x7071 0x9260 0x628 0x71dd 0x9235 0x62f 0x7349 0x9202 0x62f 0x74b6 0x91c8 0x62f 0x7622 0x918d 0x637 0x778f 0x9153 0x644 0x78fb 0x9119 0x650 0x7a67 0x90c4 0x63a 0x7bd4 0x9088 0x636 0x7d40 0x9067 0x644 0x7eac 0x9059 0x65d 0x8019 0x9050 0x67f 0x8185 0x9046 0x6ae 0x82f1 0x9035 0x6eb 0x845e 0x9002 0x734 0x85ca 0x8f4d 0x732 0x8737 0x8e11 0x728 0x88a3 0x8c30 0x759 0x8a0f 0x896c 0x7b7 0x8b7c 0x855f 0x89c 0x8ce8 0x8160 0x9a3>;
				battery1_profile_t2_num = <0x64>;
				battery1_profile_t2_col = <0x03>;
				battery1_profile_t2 = <0x00 0xaa28 0xb54 0x16c 0xa9a5 0xb54 0x2d9 0xa92b 0xb4c 0x445 0xa8b7 0xb40 0x5b1 0xa843 0xb34 0x71e 0xa7ce 0xb28 0x88a 0xa75a 0xb10 0x9f7 0xa6e5 0xaed 0xb63 0xa671 0xad5 0xccf 0xa5fd 0xabc 0xe3c 0xa588 0xaad 0xfa8 0xa514 0xaad 0x1114 0xa4a7 0xaad 0x1281 0xa435 0xaa6 0x13ed 0xa3c3 0xa9d 0x1559 0xa356 0xa9d 0x16c6 0xa2e2 0xa92 0x1832 0xa271 0xa8c 0x199f 0xa204 0xa8a 0x1b0b 0xa197 0xa7e 0x1c77 0xa12a 0xa7b 0x1de4 0xa0c0 0xa7b 0x1f50 0xa05a 0xa7b 0x20bc 0x9ff4 0xa7b 0x2229 0x9f8e 0xa7b 0x2395 0x9f2a 0xa81 0x2501 0x9ecc 0xa9a 0x266e 0x9e67 0xab2 0x27da 0x9e01 0xab8 0x2947 0x9d9b 0xaac 0x2ab3 0x9d35 0xaa0 0x2c1f 0x9cd5 0xa94 0x2d8c 0x9c77 0xa87 0x2ef8 0x9c18 0xa7b 0x3064 0x9bc1 0xa6f 0x31d1 0x9b65 0xa63 0x333d 0x9b06 0xa57 0x34a9 0x9aa8 0xa4b 0x3616 0x9a3d 0xa1f 0x3782 0x99cc 0x9ee 0x38ef 0x9959 0x9be 0x3a5b 0x98f3 0x98d 0x3bc7 0x9893 0x96f 0x3d34 0x983a 0x957 0x3ea0 0x97ea 0x93f 0x400c 0x979a 0x933 0x4179 0x9753 0x926 0x42e5 0x9713 0x920 0x4451 0x96d9 0x92c 0x45be 0x969f 0x92e 0x472a 0x9669 0x92e 0x4897 0x9636 0x92e 0x4a03 0x9603 0x92e 0x4b6f 0x95d5 0x937 0x4cdc 0x95aa 0x943 0x4e48 0x957e 0x94f 0x4fb4 0x9552 0x94f 0x5121 0x952b 0x957 0x528d 0x9507 0x963 0x53f9 0x94e3 0x96f 0x5566 0x94be 0x971 0x56d2 0x949d 0x977 0x583f 0x9480 0x983 0x59ab 0x9463 0x98f 0x5b17 0x9446 0x99b 0x5c84 0x9429 0x9a3 0x5df0 0x940c 0x9a3 0x5f5c 0x93ef 0x9a3 0x60c9 0x93d6 0x9aa 0x6235 0x93c1 0x9b3 0x63a1 0x93ab 0x9b3 0x650e 0x939b 0x9c9 0x667a 0x9389 0x9db 0x67e7 0x9372 0x9e7 0x6953 0x9355 0x9f3 0x6abf 0x9338 0xa11 0x6c2c 0x9318 0xa31 0x6d98 0x92f4 0xa49 0x6f04 0x92d0 0xa6e 0x7071 0x92ab 0xa9a 0x71dd 0x9285 0xacd 0x7349 0x9259 0xb0a 0x74b6 0x9221 0xb46 0x7622 0x91e3 0xb83 0x778f 0x91a3 0xbc4 0x78fb 0x9169 0xc25 0x7a67 0x9123 0xc7d 0x7bd4 0x90db 0xcd6 0x7d40 0x9092 0xd37 0x7eac 0x9066 0xdb1 0x8019 0x9048 0xe48 0x8185 0x9033 0xefe 0x82f1 0x901d 0xfd8 0x845e 0x8ffa 0x10fc 0x85ca 0x8fc0 0x1250 0x8737 0x8f57 0x13c8 0x88a3 0x8e43 0x153f 0x8a0f 0x8c6a 0x17ec 0x8b7c 0x8b1a 0x19d9 0x8ce8 0x8b1a 0x19d9>;
				battery1_profile_t3_num = <0x64>;
				battery1_profile_t3_col = <0x03>;
				battery1_profile_t3 = <0x00 0xa9c4 0x15ae 0x16c 0xa91c 0x15ae 0x2d9 0xa887 0x15bd 0x445 0xa7fe 0x15d2 0x5b1 0xa77b 0x15df 0x71e 0xa6f8 0x15cb 0x88a 0xa679 0x15b2 0x9f7 0xa5fe 0x159c 0xb63 0xa589 0x1590 0xccf 0xa515 0x157a 0xe3c 0xa4a0 0x1567 0xfa8 0xa42b 0x155a 0x1114 0xa3b7 0x154e 0x1281 0xa347 0x1532 0x13ed 0xa2d8 0x1515 0x1559 0xa263 0x1508 0x16c6 0xa1f5 0x14fc 0x1832 0xa188 0x14f0 0x199f 0xa11a 0x14e2 0x1b0b 0xa0ad 0x14ca 0x1c77 0xa046 0x14bb 0x1de4 0x9fe0 0x14b4 0x1f50 0x9f7a 0x14b4 0x20bc 0x9f13 0x14b4 0x2229 0x9ea9 0x14b4 0x2395 0x9e39 0x14b0 0x2501 0x9dc4 0x14a4 0x266e 0x9d57 0x148d 0x27da 0x9ce5 0x146e 0x2947 0x9c72 0x1447 0x2ab3 0x9c05 0x1417 0x2c1f 0x9ba3 0x13fa 0x2d8c 0x9b44 0x13dc 0x2ef8 0x9ae6 0x13b9 0x3064 0x9a87 0x13ad 0x31d1 0x9a23 0x1398 0x333d 0x99bd 0x137c 0x34a9 0x9957 0x1358 0x3616 0x98f8 0x134a 0x3782 0x989e 0x133e 0x38ef 0x9846 0x1332 0x3a5b 0x97ef 0x1326 0x3bc7 0x97a3 0x1324 0x3d34 0x975a 0x132a 0x3ea0 0x9712 0x1335 0x400c 0x96d1 0x1335 0x4179 0x968f 0x133d 0x42e5 0x9650 0x134a 0x4451 0x9616 0x1356 0x45be 0x95e2 0x1362 0x472a 0x95af 0x1375 0x4897 0x957e 0x138e 0x4a03 0x9552 0x13a6 0x4b6f 0x9520 0x13be 0x4cdc 0x94f4 0x13d6 0x4e48 0x94d0 0x13f0 0x4fb4 0x94ac 0x1414 0x5121 0x9482 0x141e 0x528d 0x945b 0x142b 0x53f9 0x943e 0x1450 0x5566 0x9421 0x1468 0x56d2 0x9408 0x148f 0x583f 0x93f3 0x14bd 0x59ab 0x93dd 0x14e1 0x5b17 0x93cd 0x151b 0x5c84 0x93bb 0x155e 0x5df0 0x93a6 0x15aa 0x5f5c 0x9398 0x160b 0x60c9 0x9383 0x1676 0x6235 0x936e 0x16e3 0x63a1 0x9358 0x1751 0x650e 0x933a 0x17e3 0x667a 0x931d 0x187c 0x67e7 0x9300 0x1921 0x6953 0x92e3 0x19d7 0x6abf 0x92b9 0x1a8d 0x6c2c 0x9291 0x1b56 0x6d98 0x926b 0x1c2f 0x6f04 0x9240 0x1cfe 0x7071 0x920e 0x1de8 0x71dd 0x91db 0x1edb 0x7349 0x91a8 0x1fce 0x74b6 0x9166 0x20c1 0x7622 0x9129 0x21bc 0x778f 0x90ed 0x22bf 0x78fb 0x90ab 0x23ca 0x7a67 0x906a 0x250d 0x7bd4 0x9030 0x2669 0x7d40 0x9001 0x27e0 0x7eac 0x8fe4 0x2989 0x8019 0x8fbb 0x2b6d 0x8185 0x8f8f 0x2d79 0x82f1 0x8f60 0x2fb2 0x845e 0x8f02 0x3297 0x85ca 0x8ee4 0x337f 0x8737 0x8ee4 0x337f 0x88a3 0x8ee4 0x337f 0x8a0f 0x8ee4 0x337f 0x8b7c 0x8ee4 0x337f 0x8ce8 0x8ee4 0x337f>;
				battery1_profile_t4_num = <0x64>;
				battery1_profile_t4_col = <0x03>;
				battery1_profile_t4 = <0x00 0xa9b0 0x22f6 0x16c 0xa8dd 0x22f6 0x2d9 0xa820 0x2314 0x445 0xa773 0x232f 0x5b1 0xa6cc 0x230b 0x71e 0xa637 0x22f1 0x88a 0xa5a6 0x22c6 0x9f7 0xa515 0x228b 0xb63 0xa48a 0x225b 0xccf 0xa40b 0x2233 0xe3c 0xa38f 0x220a 0xfa8 0xa313 0x21da 0x1114 0xa297 0x21a9 0x1281 0xa220 0x2188 0x13ed 0xa1ac 0x2169 0x1559 0xa137 0x2139 0x16c6 0xa0c2 0x2108 0x1832 0xa056 0x20e4 0x199f 0x9ff0 0x20d2 0x1b0b 0x9f8a 0x20de 0x1c77 0x9f18 0x20ce 0x1de4 0x9e9d 0x20b0 0x1f50 0x9e1a 0x208b 0x20bc 0x9d97 0x204e 0x2229 0x9d19 0x2011 0x2395 0x9ca1 0x1fdc 0x2501 0x9c34 0x1fb7 0x266e 0x9bcd 0x1f9e 0x27da 0x9b6f 0x1f8d 0x2947 0x9b19 0x1f80 0x2ab3 0x9ac9 0x1f74 0x2c1f 0x9a6d 0x1f54 0x2d8c 0x9a0e 0x1f35 0x2ef8 0x99b0 0x1f1f 0x3064 0x9951 0x1f1f 0x31d1 0x98f7 0x1f1f 0x333d 0x98a2 0x1f23 0x34a9 0x9852 0x1f2f 0x3616 0x97fb 0x1f18 0x3782 0x97ac 0x1f15 0x38ef 0x9763 0x1f21 0x3a5b 0x971a 0x1f2d 0x3bc7 0x96d7 0x1f39 0x3d34 0x9696 0x1f46 0x3ea0 0x9655 0x1f51 0x400c 0x961b 0x1f51 0x4179 0x95e0 0x1f59 0x42e5 0x95a8 0x1f6a 0x4451 0x9575 0x1f82 0x45be 0x954a 0x1fb2 0x472a 0x951e 0x1fcd 0x4897 0x94f2 0x1fd9 0x4a03 0x94c6 0x1fe5 0x4b6f 0x94a7 0x2010 0x4cdc 0x948d 0x2047 0x4e48 0x9478 0x2083 0x4fb4 0x9462 0x20c0 0x5121 0x944c 0x210f 0x528d 0x9436 0x215f 0x53f9 0x9420 0x21a8 0x5566 0x940a 0x2209 0x56d2 0x93f4 0x2279 0x583f 0x93df 0x22fc 0x59ab 0x93c9 0x239a 0x5b17 0x93b3 0x2442 0x5c84 0x939d 0x24f2 0x5df0 0x9386 0x25aa 0x5f5c 0x9369 0x266d 0x60c9 0x934c 0x2738 0x6235 0x932f 0x280b 0x63a1 0x9312 0x28e6 0x650e 0x92f4 0x29b4 0x667a 0x92d3 0x2a7b 0x67e7 0x92b0 0x2b37 0x6953 0x9293 0x2be1 0x6abf 0x926f 0x2c80 0x6c2c 0x924b 0x2d11 0x6d98 0x9225 0x2d95 0x6f04 0x91fa 0x2e0e 0x7071 0x91ce 0x2e75 0x71dd 0x919f 0x2ee0 0x7349 0x916c 0x2f59 0x74b6 0x9132 0x2fc6 0x7622 0x90fc 0x3054 0x778f 0x90c7 0x30f9 0x78fb 0x908d 0x31af 0x7a67 0x9059 0x329d 0x7bd4 0x902a 0x33c5 0x7d40 0x9000 0x3539 0x7eac 0x8fdb 0x3743 0x8019 0x8fab 0x385a 0x8185 0x8f8e 0x38d6 0x82f1 0x8f8e 0x38d6 0x845e 0x8f8e 0x38d6 0x85ca 0x8f8e 0x38d6 0x8737 0x8f8e 0x38d6 0x88a3 0x8f8e 0x38d6 0x8a0f 0x8f8e 0x38d6 0x8b7c 0x8f8e 0x38d6 0x8ce8 0x8f8e 0x38d6>;
				phandle = <0x5e>;
			};

			mtk_charger_type {
				compatible = "mediatek,mt6357-charger-type";
				io-channels = <0x23 0x02>;
				io-channel-names = "pmic_vbus";
				bc12_active = <0x00>;
				phandle = <0x72>;
			};

			mt6357_charger {
				compatible = "mediatek,mt6357-pulse-charger";
				charger_name = "primary_chg";
				alias_name = "mt6357";
				ichg = <0x7a120>;
				cv = <0x426030>;
				vcdt_hv_thres = <0x6acfc0>;
				vbat_ov_thres = <0x43e6d0>;
				phandle = <0x73>;
			};

			mtk_ts_pmic {
				compatible = "mediatek,mtk_ts_pmic";
				io-channels = <0x23 0x05 0x23 0x06 0x23 0x07>;
				io-channel-names = "pmic_chip_temp\0pmic_buck1_temp\0pmic_buck2_temp";
				interconnects = <0x23 0x01>;
				#interconnect-cells = <0x01>;
				phandle = <0x29>;
			};

			mt6357_ts_buck1 {
				compatible = "mediatek,mt6357_ts_buck1";
				io-channels = <0x23 0x06>;
				io-channel-names = "pmic_buck1_temp";
				interconnects = <0x29 0x01>;
				phandle = <0x74>;
			};

			mt6357_ts_buck2 {
				compatible = "mediatek,mt6357_ts_buck2";
				io-channels = <0x23 0x07>;
				io-channel-names = "pmic_buck2_temp";
				interconnects = <0x29 0x01>;
				phandle = <0x75>;
			};

			pmic_efuse {
				compatible = "mediatek,mt6357-efuse";
				#address-cells = <0x01>;
				#size-cells = <0x01>;
				phandle = <0x24>;
			};

			mt6357regulator {
				compatible = "mediatek,mt6357-regulator";
				phandle = <0x76>;

				buck_vs1 {
					regulator-name = "vs1";
					regulator-min-microvolt = <0x124f80>;
					regulator-max-microvolt = <0x2191c0>;
					regulator-ramp-delay = <0x30d4>;
					regulator-enable-ramp-delay = <0xdc>;
					regulator-always-on;
					phandle = <0x77>;
				};

				buck_vmodem {
					regulator-name = "vmodem";
					regulator-min-microvolt = <0x7a120>;
					regulator-max-microvolt = <0x123716>;
					regulator-ramp-delay = <0x186a>;
					regulator-enable-ramp-delay = <0xdc>;
					regulator-always-on;
					phandle = <0x34>;
				};

				buck_vcore {
					regulator-name = "vcore";
					regulator-min-microvolt = <0x7ea5e>;
					regulator-max-microvolt = <0x1406f4>;
					regulator-ramp-delay = <0x186a>;
					regulator-enable-ramp-delay = <0xdc>;
					regulator-always-on;
					phandle = <0x35>;
				};

				buck_vproc {
					regulator-name = "vproc";
					regulator-min-microvolt = <0x7ea5e>;
					regulator-max-microvolt = <0x1406f4>;
					regulator-ramp-delay = <0x186a>;
					regulator-enable-ramp-delay = <0xdc>;
					regulator-always-on;
					phandle = <0x78>;
				};

				buck_vpa {
					regulator-name = "vpa";
					regulator-min-microvolt = <0x7a120>;
					regulator-max-microvolt = <0x37b1d0>;
					regulator-ramp-delay = <0xc350>;
					regulator-enable-ramp-delay = <0xdc>;
					phandle = <0x79>;
				};

				ldo_vfe28 {
					regulator-name = "vfe28";
					regulator-min-microvolt = <0x2ab980>;
					regulator-max-microvolt = <0x2ab980>;
					regulator-enable-ramp-delay = <0x108>;
					phandle = <0x7a>;
				};

				ldo_vxo22 {
					regulator-name = "vxo22";
					regulator-min-microvolt = <0x2191c0>;
					regulator-max-microvolt = <0x249f00>;
					regulator-enable-ramp-delay = <0x6e>;
					regulator-always-on;
					phandle = <0x7b>;
				};

				ldo_vrf18 {
					regulator-name = "vrf18";
					regulator-min-microvolt = <0x1b7740>;
					regulator-max-microvolt = <0x1b7740>;
					regulator-enable-ramp-delay = <0x6e>;
					phandle = <0x7c>;
				};

				ldo_vrf12 {
					regulator-name = "vrf12";
					regulator-min-microvolt = <0x124f80>;
					regulator-max-microvolt = <0x124f80>;
					regulator-enable-ramp-delay = <0x6e>;
					phandle = <0x7d>;
				};

				ldo_vefuse {
					regulator-name = "vefuse";
					regulator-min-microvolt = <0x124f80>;
					regulator-max-microvolt = <0x325aa0>;
					regulator-enable-ramp-delay = <0x108>;
					phandle = <0x7e>;
				};

				ldo_vcn33_bt {
					regulator-name = "vcn33_bt";
					regulator-min-microvolt = <0x325aa0>;
					regulator-max-microvolt = <0x3567e0>;
					regulator-enable-ramp-delay = <0x108>;
					phandle = <0x7f>;
				};

				ldo_vcn33_wifi {
					regulator-name = "vcn33_wifi";
					regulator-min-microvolt = <0x325aa0>;
					regulator-max-microvolt = <0x3567e0>;
					regulator-enable-ramp-delay = <0x108>;
					phandle = <0x80>;
				};

				ldo_vcn28 {
					regulator-name = "vcn28";
					regulator-min-microvolt = <0x2ab980>;
					regulator-max-microvolt = <0x2ab980>;
					regulator-enable-ramp-delay = <0x108>;
					phandle = <0x81>;
				};

				ldo_vcn18 {
					regulator-name = "vcn18";
					regulator-min-microvolt = <0x1b7740>;
					regulator-max-microvolt = <0x1b7740>;
					regulator-enable-ramp-delay = <0x108>;
					phandle = <0x82>;
				};

				ldo_vcama {
					regulator-name = "vcama";
					regulator-min-microvolt = <0x2625a0>;
					regulator-max-microvolt = <0x2ab980>;
					regulator-enable-ramp-delay = <0x108>;
					phandle = <0x83>;
				};

				ldo_vcamd {
					regulator-name = "vcamd";
					regulator-min-microvolt = <0xf4240>;
					regulator-max-microvolt = <0x1b7740>;
					regulator-enable-ramp-delay = <0x108>;
					phandle = <0x84>;
				};

				ldo_vcamio {
					regulator-name = "vcamio";
					regulator-min-microvolt = <0x1b7740>;
					regulator-max-microvolt = <0x1b7740>;
					regulator-enable-ramp-delay = <0x108>;
					phandle = <0x85>;
				};

				ldo_vldo28 {
					regulator-name = "vldo28";
					regulator-min-microvolt = <0x2ab980>;
					regulator-max-microvolt = <0x2dc6c0>;
					regulator-enable-ramp-delay = <0x108>;
					phandle = <0x5c>;
				};

				ldo_vsram_others {
					regulator-name = "vsram_others";
					regulator-min-microvolt = <0x7ea5e>;
					regulator-max-microvolt = <0x1406f4>;
					regulator-ramp-delay = <0x186a>;
					regulator-enable-ramp-delay = <0x6e>;
					regulator-always-on;
					phandle = <0x86>;
				};

				ldo_vsram_proc {
					regulator-name = "vsram_proc";
					regulator-min-microvolt = <0x7ea5e>;
					regulator-max-microvolt = <0x1406f4>;
					regulator-ramp-delay = <0x186a>;
					regulator-enable-ramp-delay = <0x6e>;
					regulator-always-on;
					phandle = <0x87>;
				};

				ldo_vaux18 {
					regulator-name = "vaux18";
					regulator-min-microvolt = <0x1b7740>;
					regulator-max-microvolt = <0x1b7740>;
					regulator-enable-ramp-delay = <0x108>;
					regulator-always-on;
					phandle = <0x88>;
				};

				ldo_vaud28 {
					regulator-name = "vaud28";
					regulator-min-microvolt = <0x2ab980>;
					regulator-max-microvolt = <0x2ab980>;
					regulator-enable-ramp-delay = <0x108>;
					regulator-always-on;
					phandle = <0x89>;
				};

				ldo_vio28 {
					regulator-name = "vio28";
					regulator-min-microvolt = <0x2ab980>;
					regulator-max-microvolt = <0x2ab980>;
					regulator-enable-ramp-delay = <0x108>;
					regulator-always-on;
					phandle = <0x8a>;
				};

				ldo_vio18 {
					regulator-name = "vio18";
					regulator-min-microvolt = <0x1b7740>;
					regulator-max-microvolt = <0x1b7740>;
					regulator-enable-ramp-delay = <0x108>;
					regulator-always-on;
					phandle = <0x8b>;
				};

				ldo_vdram {
					regulator-name = "vdram";
					regulator-min-microvolt = <0x10c8e0>;
					regulator-max-microvolt = <0x124f80>;
					regulator-enable-ramp-delay = <0xce4>;
					regulator-always-on;
					phandle = <0x8c>;
				};

				ldo_vmc {
					regulator-name = "vmc";
					regulator-min-microvolt = <0x1b7740>;
					regulator-max-microvolt = <0x325aa0>;
					regulator-enable-ramp-delay = <0x2c>;
					regulator-always-on;
					phandle = <0x56>;
				};

				ldo_vmch {
					regulator-name = "vmch";
					regulator-min-microvolt = <0x2c4020>;
					regulator-max-microvolt = <0x325aa0>;
					regulator-enable-ramp-delay = <0x2c>;
					phandle = <0x55>;
				};

				ldo_vemc {
					regulator-name = "vemc";
					regulator-min-microvolt = <0x2c4020>;
					regulator-max-microvolt = <0x325aa0>;
					regulator-enable-ramp-delay = <0x2c>;
					regulator-always-on;
					phandle = <0x4f>;
				};

				ldo_vsim1 {
					regulator-name = "vsim1";
					regulator-min-microvolt = <0x19f0a0>;
					regulator-max-microvolt = <0x2f4d60>;
					regulator-enable-ramp-delay = <0x108>;
					phandle = <0x8d>;
				};

				ldo_vsim2 {
					regulator-name = "vsim2";
					regulator-min-microvolt = <0x19f0a0>;
					regulator-max-microvolt = <0x2f4d60>;
					regulator-enable-ramp-delay = <0x108>;
					phandle = <0x8e>;
				};

				ldo_vibr {
					regulator-name = "vibr";
					regulator-min-microvolt = <0x124f80>;
					regulator-max-microvolt = <0x325aa0>;
					regulator-enable-ramp-delay = <0x2c>;
					phandle = <0x1f>;
				};

				ldo_vusb33 {
					regulator-name = "vusb33";
					regulator-min-microvolt = <0x2dc6c0>;
					regulator-max-microvolt = <0x2f4d60>;
					regulator-enable-ramp-delay = <0x108>;
					regulator-always-on;
					phandle = <0x8f>;
				};
			};

			mtk_dynamic_loading_throttling {
				compatible = "mediatek,mt6357-dynamic_loading_throttling";
				mediatek,charger = <0x2a>;
				uvlo-level = <0xa28>;
				isense_support;
				io-channels = <0x23 0x0f 0x23 0x10 0x23 0x01 0x23 0x00>;
				io-channel-names = "pmic_ptim\0pmic_imix_r\0pmic_isense\0pmic_batadc";
			};

			pmic_lbat_service {
				compatible = "mediatek,mt6357-lbat_service";
			};

			mt6357_debug {
				compatible = "mediatek,mt63xx-debug";
			};

			mt63xx-oc-debug {
				compatible = "mediatek,mt63xx-oc-debug";
			};

			leds-mt6357 {
				compatible = "mediatek,mt6357_leds";

				Isink1 {
					reg = <0x01>;
					label = "green";
					linux,default-trigger = "none";
					default-state = "off";
				};
			};

			mtk_rtc {
				compatible = "mediatek,mt6357-rtc";
				#address-cells = <0x01>;
				#size-cells = <0x01>;
				bootmode = <0x26>;
				phandle = <0x90>;

				fg_init {
					reg = <0x00 0x01>;
					bits = <0x00 0x08>;
					phandle = <0x27>;
				};

				fg_soc {
					reg = <0x01 0x01>;
					bits = <0x00 0x08>;
					phandle = <0x28>;
				};

				ext_32k {
					reg = <0x02 0x01>;
					bits = <0x06 0x01>;
					phandle = <0x91>;
				};
			};

			pmic_codec {
				compatible = "mediatek,mt6357-sound";
				mediatek,pwrap-regmap = <0x12>;
				nvmem = <0x24>;
				nvmem-names = "pmic-hp-efuse";
				io-channels = <0x23 0x0c 0x23 0x09>;
				io-channel-names = "pmic_codec\0pmic_accdet";
				use_hp_depop_flow = <0x00>;
				use_ul_260k = <0x00>;
				phandle = <0x92>;
			};

			clock_buffer_ctrl {
				compatible = "mediatek,clock_buffer";
				n-clkbuf-pmic-dependent = <0x05>;
				clkbuf-pmic-dependent = "pmic-drvcurr\0pmic-auxout-sel\0pmic-auxout-xo\0pmic-auxout-drvcurr\0pmic-auxout-bblpm-en";
				pmic-dcxo-cw = <0x788>;
				pmic-xo-mode = <0x788 0x00 0x788 0x03 0x788 0x06 0x788 0x09 0xffff 0xffff 0x7a2 0x08 0x7a2 0x0b>;
				pmic-xo-en = <0x788 0x02 0x788 0x05 0x788 0x08 0x788 0x0b 0xffff 0xffff 0x7a2 0x0a 0x7a2 0x0d>;
				pmic-bblpm-sw = <0x788 0x0c>;
				pmic-srclkeni3 = <0x44a 0x00>;
				n-pmic-drvcurr = <0x07>;
				pmic-drvcurr = <0x7b0 0x00 0x7b0 0x02 0x7b0 0x04 0x7b0 0x06 0xffff 0xffff 0x7b0 0x0a 0x7b0 0x0c>;
				n-pmic-auxout-sel = <0x06>;
				pmic-auxout-sel = <0x7b4 0x00 0x7b4 0x05 0x7b4 0x06 0x7b4 0x07 0x7b4 0x06 0x7b4 0x18>;
				n-pmic-auxout-xo = <0x07>;
				pmic-auxout-xo = <0x7b6 0x00 0x7b6 0x06 0x7b6 0x00 0x7b6 0x06 0xffff 0xffff 0x7b6 0x06 0x7b6 0x0c>;
				n-pmic-auxout-drvcurr = <0x07>;
				pmic-auxout-drvcurr = <0x7b6 0x01 0x7b6 0x07 0x7b6 0x01 0x7b6 0x07 0xffff 0xffff 0x7b6 0x01 0x7b6 0x0c>;
				n-pmic-auxout-bblpm-en = <0x01>;
				pmic-auxout-bblpm-en = <0x7b6 0x00>;
				phandle = <0x93>;
			};
		};
	};

	scp@10500000 {
		compatible = "mediatek,scp";
		status = "okay";
		reg = <0x00 0x10500000 0x00 0x40000 0x00 0x105c0000 0x00 0x3000 0x00 0x105c4000 0x00 0x1000 0x00 0x105d4000 0x00 0x6000>;
		interrupts = <0x00 0x88 0x04>;
		core_1 = "enable";
		scp_sramSize = <0x40000>;
		scp_feature_tbl = <0x00 0x2f 0x01 0x164 0x02 0x3e 0x03 0x2f 0x04 0x1a 0x05 0x00 0x06 0xc8 0x07 0x00 0x08 0x64 0x09 0x0a>;
		scp_mem_key = "mediatek,reserve-memory-scp_share";
		scp_mem_tbl = <0x01 0x100000 0x04 0x200000>;
		phandle = <0x94>;
	};

	scp_dvfs {
		compatible = "mediatek,scp_dvfs";
		clocks = <0x0f 0x6c 0x21 0x0f 0x10 0x0f 0x1d 0x0f 0x04 0x0f 0x1a 0x0f 0x08 0x0f 0x1c>;
		clock-names = "clk_mux\0clk_pll_0\0clk_pll_1\0clk_pll_2\0clk_pll_3\0clk_pll_4\0clk_pll_5\0clk_pll_6";
		dvfsrc-opp-num = <0x03>;
		dvfs-opp = <0xff 0xff 0xff 0x00 0x00 0xfa 0x00 0xff 0xff 0xff 0x00 0x00 0x111 0x03 0xff 0xff 0xff 0x02 0x08 0x14a 0x05 0xff 0xff 0xff 0x03 0x0c 0x1a0 0x06>;
		pmic = <0x2b>;
		pmic-feature = "pmic-vow-lp\0pmic-pmrc";
		pmic-feature-cfg = <0x00 0x00>;
		gpio = <0x16 0x01>;
		gpio-feature = "gpio-mode";
		gpio-feature-cfg = <0x00>;
	};

	sleep_reg_md@1000f000 {
		compatible = "mediatek,sleep_reg_md";
		reg = <0x00 0x1000f000 0x00 0x1000>;
	};

	kp@10010000 {
		compatible = "mediatek,kp";
		reg = <0x00 0x10010000 0x00 0x1000>;
		interrupts = <0x00 0x7c 0x02>;
		clocks = <0x21>;
		clock-names = "kpd";
		phandle = <0x13>;
	};

	mrdump_ext_rst {
		compatible = "mediatek, mrdump_ext_rst-eint";
		force_mode = "EINT";
		mode = "IRQ";
		status = "okay";
		phandle = <0x95>;
	};

	touch {
		compatible = "goodix,touch";
		phandle = <0x96>;
	};

	accdet {
		compatible = "mediatek,pmic-accdet";
		phandle = <0x97>;
	};

	fingerprint {
		compatible = "mediatek,goodix-fp";
		phandle = <0x98>;
	};

	topmisc@10011000 {
		compatible = "mediatek,topmisc";
		reg = <0x00 0x10011000 0x00 0x1000>;
	};

	dvfsrc@10012000 {
		compatible = "mediatek,mt6761-dvfsrc";
		reg = <0x00 0x10012000 0x00 0x1000 0x00 0x10006000 0x00 0x1000>;
		reg-names = "dvfsrc\0spm";
		#address-cells = <0x02>;
		#size-cells = <0x02>;
		ranges;
		phandle = <0x99>;

		opp2 {
			opp-level = <0x02>;
			phandle = <0x2e>;
		};

		opp1 {
			opp-level = <0x01>;
			phandle = <0x2d>;
		};

		opp0 {
			opp-level = <0x00>;
			phandle = <0x2c>;
		};

		dvfsrc-up {
			compatible = "mediatek,mt6761-dvfsrc-up";
		};

		dvfsrc-debug {
			compatible = "mediatek,mt6761-dvfsrc-debug";
			required-opps = <0x2c 0x2d 0x2e>;
		};

		dvfsrc-met {
			compatible = "mediatek,mt6761-dvfsrc-met";
		};

		qos@00110780 {
			compatible = "mediatek,mt6761-qos";
			reg = <0x00 0x110780 0x00 0x80>;
		};
	};

	mbist_ao@10013000 {
		compatible = "mediatek,mbist_ao";
		reg = <0x00 0x10013000 0x00 0x1000>;
	};

	apcldmain_ao@10014000 {
		compatible = "mediatek,apcldmain_ao";
		reg = <0x00 0x10014000 0x00 0x400>;
	};

	apcldmaout_ao@10014400 {
		compatible = "mediatek,apcldmaout_ao";
		reg = <0x00 0x10014400 0x00 0x400>;
	};

	apcldmamisc_ao@10014800 {
		compatible = "mediatek,apcldmamisc_ao";
		reg = <0x00 0x10014800 0x00 0x400>;
	};

	apcldmamisc_ao@10014c00 {
		compatible = "mediatek,apcldmamisc_ao";
		reg = <0x00 0x10014c00 0x00 0x400>;
	};

	aes_top0@10016000 {
		compatible = "mediatek,aes_top0";
		reg = <0x00 0x10016000 0x00 0x1000>;
	};

	timer@10017000 {
		compatible = "mediatek,sys_timer\0mediatek,mt6761-timer\0mediatek,mt6765-timer";
		reg = <0x00 0x10017000 0x00 0x1000>;
		reg-names = "sys_timer_base";
		interrupts = <0x00 0x8a 0x04>;
		clocks = <0x2f>;
		phandle = <0x9a>;
	};

	modem_temp_share@10018000 {
		compatible = "mediatek,modem_temp_share";
		reg = <0x00 0x10018000 0x00 0x1000>;
	};

	security_ao@1001a000 {
		compatible = "mediatek,security_ao";
		reg = <0x00 0x1001a000 0x00 0x1000>;
	};

	topckgen_ao@1001b000 {
		compatible = "mediatek,topckgen_ao";
		reg = <0x00 0x1001b000 0x00 0x1000>;
	};

	iocfg_0@10002000 {
		compatible = "mediatek,iocfg_0";
		reg = <0x00 0x10002000 0x00 0x200>;
	};

	iocfg_1@10002200 {
		compatible = "mediatek,iocfg_1";
		reg = <0x00 0x10002200 0x00 0x200>;
	};

	iocfg_2@10002400 {
		compatible = "mediatek,iocfg_2";
		reg = <0x00 0x10002400 0x00 0x200>;
	};

	iocfg_3@10002600 {
		compatible = "mediatek,iocfg_3";
		reg = <0x00 0x10002600 0x00 0x200>;
	};

	iocfg_4@10002800 {
		compatible = "mediatek,iocfg_4";
		reg = <0x00 0x10002800 0x00 0x200>;
	};

	iocfg_5@10002a00 {
		compatible = "mediatek,iocfg_5";
		reg = <0x00 0x10002a00 0x00 0x200>;
	};

	mdcldmain_ao@10015000 {
		compatible = "mediatek,mdcldmain_ao";
		reg = <0x00 0x10015000 0x00 0x400>;
	};

	mdcldmaout_ao@10015400 {
		compatible = "mediatek,mdcldmaout_ao";
		reg = <0x00 0x10015400 0x00 0x400>;
	};

	mdcldmamisc_ao@10015800 {
		compatible = "mediatek,mdcldmamisc_ao";
		reg = <0x00 0x10015800 0x00 0x400>;
	};

	sys_cirq@10204000 {
		compatible = "mediatek,sys_cirq";
		reg = <0x00 0x10204000 0x00 0x1000>;
		mediatek,cirq_num = <0xd1>;
		mediatek,spi_start_offset = <0x10>;
		interrupts = <0x00 0xe0 0x08>;
	};

	mcucfg@10200000 {
		compatible = "mediatek,mcucfg";
		reg = <0x00 0x10200000 0x00 0x200>;
		interrupts = <0x00 0x00 0x04>;
	};

	mcucfg@10200200 {
		compatible = "mediatek,mcucfg";
		reg = <0x00 0x10200200 0x00 0x200>;
		interrupts = <0x00 0x01 0x08>;
	};

	mcucfg@10200400 {
		compatible = "mediatek,mcucfg";
		reg = <0x00 0x10200400 0x00 0x200>;
		interrupts = <0x00 0x02 0x04>;
	};

	mcucfg@10200600 {
		compatible = "mediatek,mcucfg";
		reg = <0x00 0x10200600 0x00 0x200>;
		interrupts = <0x00 0x03 0x04>;
	};

	mcucfg@10200800 {
		compatible = "mediatek,mcucfg";
		reg = <0x00 0x10200800 0x00 0x200>;
		interrupts = <0x00 0x04 0x04>;
	};

	mcucfg@10200a00 {
		compatible = "mediatek,mcucfg";
		reg = <0x00 0x10200a00 0x00 0x300>;
		interrupts = <0x00 0x05 0x08>;
	};

	mcucfg@10200f00 {
		compatible = "mediatek,mcucfg";
		reg = <0x00 0x10200f00 0x00 0x100>;
		interrupts = <0x00 0x06 0x08>;
	};

	mcucfg@10201000 {
		compatible = "mediatek,mcucfg";
		reg = <0x00 0x10201000 0x00 0x1000>;
		interrupts = <0x00 0x07 0x08>;
	};

	mcucfg@10202000 {
		compatible = "mediatek,mcucfg";
		reg = <0x00 0x10202000 0x00 0x1000>;
		interrupts = <0x00 0x08 0x08>;
	};

	mcucfg@10203000 {
		compatible = "mediatek,mcucfg";
		reg = <0x00 0x10203000 0x00 0x1000>;
		interrupts = <0x00 0x09 0x08>;
	};

	mcucfg_mp0_counter@10200000 {
		compatible = "mediatek,mcucfg_mp0_counter";
		reg = <0x00 0x10200000 0x00 0x4000>;
	};

	m4u@10205000 {
		cell-index = <0x00>;
		compatible = "mediatek,iommu_v0";
		reg = <0x00 0x10205000 0x00 0x1000>;
		mediatek,larbs = <0x30 0x31 0x32>;
		interrupts = <0x00 0x9e 0x08>;
		#iommu-cells = <0x01>;
		phandle = <0x60>;
	};

	devapc@10207000 {
		compatible = "mediatek,devapc";
		reg = <0x00 0x10207000 0x00 0x1000>;
		interrupts = <0x00 0x56 0x08>;
		clocks = <0x22 0x28>;
		clock-names = "devapc-infra-clock";
	};

	hwrng {
		compatible = "mediatek,mt67xx-rng";
		phandle = <0x9b>;
	};

	bus_dbg@10208000 {
		compatible = "mediatek,bus_dbg-v2";
		reg = <0x00 0x10208000 0x00 0x1000 0x00 0x10001000 0x00 0x1000>;
		mediatek,bus_dbg_con_offset = <0x2fc>;
		interrupts = <0x00 0x55 0x08>;
	};

	ap_ccif0@10209000 {
		compatible = "mediatek,ap_ccif0";
		reg = <0x00 0x10209000 0x00 0x1000>;
		interrupts = <0x00 0x5c 0x08>;
	};

	md_ccif0@1020a000 {
		compatible = "mediatek,md_ccif0";
		reg = <0x00 0x1020a000 0x00 0x1000>;
	};

	ap_ccif1@1020b000 {
		compatible = "mediatek,ap_ccif1";
		reg = <0x00 0x1020b000 0x00 0x1000>;
		interrupts = <0x00 0x5e 0x08>;
	};

	md_ccif1@1020c000 {
		compatible = "mediatek,md_ccif1";
		reg = <0x00 0x1020c000 0x00 0x1000>;
	};

	infra_mbist@1020d000 {
		compatible = "mediatek,infra_mbist";
		reg = <0x00 0x1020d000 0x00 0x1000>;
	};

	infracfg@1020e000 {
		compatible = "mediatek,infracfg";
		reg = <0x00 0x1020e000 0x00 0x1000>;
	};

	trng@1020f000 {
		compatible = "mediatek,trng";
		reg = <0x00 0x1020f000 0x00 0x1000>;
		interrupts = <0x00 0x69 0x08>;
	};

	dxcc_sec@10210000 {
		compatible = "mediatek,dxcc_sec";
		reg = <0x00 0x10210000 0x00 0x1000>;
		interrupts = <0x00 0x6a 0x04>;
	};

	mcupm_sram2@10211000 {
		compatible = "mediatek,mcupm_sram2";
		reg = <0x00 0x10211000 0x00 0x1000>;
	};

	cq_dma@10212000 {
		compatible = "mediatek,mt-cqdma-v1";
		reg = <0x00 0x10212000 0x00 0x80 0x00 0x10212080 0x00 0x80 0x00 0x10212100 0x00 0x68>;
		interrupts = <0x00 0x39 0x08 0x00 0x3a 0x08 0x00 0x3b 0x08>;
		nr_channel = <0x03>;
		keep_clock_ao = "yes";
		clocks = <0x22 0x43>;
		clock-names = "cqdma";
	};

	mcupm_sram3@10213000 {
		compatible = "mediatek,mcupm_sram3";
		reg = <0x00 0x10213000 0x00 0x1000>;
	};

	sramrom@10214000 {
		compatible = "mediatek,sramrom";
		reg = <0x00 0x10214000 0x00 0x1000>;
	};

	mcupm_reg@10216000 {
		compatible = "mediatek,mcupm_reg";
		reg = <0x00 0x10216000 0x00 0x1000>;
	};

	mcupm_sram0@10217000 {
		compatible = "mediatek,mcupm_sram0";
		reg = <0x00 0x10217000 0x00 0x1000>;
	};

	mcupm_sram1@10218000 {
		compatible = "mediatek,mcupm_sram1";
		reg = <0x00 0x10218000 0x00 0x1000>;
	};

	emi@10219000 {
		compatible = "mediatek,emi";
		reg = <0x00 0x10219000 0x00 0x1000 0x00 0x10226000 0x00 0x1000 0x00 0x1022d000 0x00 0x1000 0x00 0x10235000 0x00 0x1000>;
		interrupts = <0x00 0x58 0x08>;
	};

	apcldmain@1021b000 {
		compatible = "mediatek,apcldmain";
		reg = <0x00 0x1021b000 0x00 0x100>;
	};

	apcldmaout@1021b400 {
		compatible = "mediatek,apcldmaout";
		reg = <0x00 0x1021b400 0x00 0x100>;
	};

	apcldmamisc@1021b800 {
		compatible = "mediatek,apcldmamisc";
		reg = <0x00 0x1021b800 0x00 0x100>;
		interrupts = <0x00 0x6d 0x04>;
	};

	mdcldmain@1021c000 {
		compatible = "mediatek,mdcldmain";
		reg = <0x00 0x1021c000 0x00 0x400>;
	};

	mdcldmaout@1021c400 {
		compatible = "mediatek,mdcldmaout";
		reg = <0x00 0x1021c400 0x00 0x400>;
	};

	mdcldmamisc@1021c800 {
		compatible = "mediatek,mdcldmamisc";
		reg = <0x00 0x1021c800 0x00 0x1000>;
	};

	ccifdriver@10209000 {
		compatible = "mediatek,ccci_ccif";
		reg = <0x00 0x10209000 0x00 0x1000 0x00 0x1020a000 0x00 0x1000>;
		mediatek,sram_size = <0x200>;
		interrupts = <0x00 0x5c 0x08 0x00 0x5d 0x08>;
		clocks = <0x22 0x29 0x22 0x2c 0x22 0x23 0x22 0x24 0x22 0x58 0x22 0x59>;
		clock-names = "infra-ccif-ap\0infra-ccif-md\0infra-ccif1-ap\0infra-ccif1-md\0infra-ccif2-ap\0infra-ccif2-md";
		phandle = <0x9c>;
	};

	cldmadriver@10014000 {
		compatible = "mediatek,ccci_cldma";
		reg = <0x00 0x10014000 0x00 0x1000 0x00 0x1021b000 0x00 0x1000>;
		interrupts = <0x00 0x6d 0x04>;
		mediatek,cldma_capability = <0x06>;
		mediatek,md_generation = <0x1895>;
		mediatek,platform = <0x1a69>;
		clocks = <0x22 0x32>;
		clock-names = "infra-cldma-bclk";
		cldma-infracfg = <0x22>;
		phandle = <0x9d>;
	};

	mddriver@10014000 {
		compatible = "mediatek,mddriver\0mediatek,mddriver-mt6761";
		reg = <0x00 0x10014000 0x00 0x1000 0x00 0x1021b000 0x00 0x1000 0x00 0x10209000 0x00 0x1000 0x00 0x1020a000 0x00 0x1000>;
		interrupts = <0x00 0x6d 0x04 0x00 0x5c 0x08 0x00 0x5d 0x08 0x00 0xcd 0x02>;
		mediatek,mdhif_type = <0x03>;
		mediatek,md_id = <0x00>;
		mediatek,ap_plat_info = <0x1a69>;
		mediatek,md_generation = <0x1895>;
		mediatek,offset_apon_md1 = <0x1c24>;
		mediatek,cldma_capability = <0x06>;
		clocks = <0x33 0x00 0x22 0x32 0x22 0x29 0x22 0x2c 0x22 0x23 0x22 0x24 0x22 0x58 0x22 0x59>;
		clock-names = "scp-sys-md1-main\0infra-cldma-bclk\0infra-ccif-ap\0infra-ccif-md\0infra-ccif1-ap\0infra-ccif1-md\0infra-ccif2-ap\0infra-ccif2-md";
		_vmodem-supply = <0x34>;
		_vcore-supply = <0x35>;
		ccci-infracfg = <0x22>;
		phandle = <0x15>;
	};

	md_auxadc {
		compatible = "mediatek,md_auxadc";
		phandle = <0x9e>;
	};

	bat_id_adc {
		compatible = "hq, bat_id_adc";
		io-channels = <0x36 0x02>;
		io-channel-names = "hq-battery";
		phandle = <0x9f>;
	};

	md_thubadc {
		compatible = "mediatek,md_thubadc";
		io-channels = <0x36 0x04>;
		io-channel-names = "md-thubchannel";
		phandle = <0xa0>;
	};

	bpi_bsi_slv0@1021e000 {
		compatible = "mediatek,bpi_bsi_slv0";
		reg = <0x00 0x1021e000 0x00 0x1000>;
	};

	bpi_bsi_slv1@1021f000 {
		compatible = "mediatek,bpi_bsi_slv1";
		reg = <0x00 0x1021f000 0x00 0x6000>;
	};

	bpi_bsi_slv2@10225000 {
		compatible = "mediatek,bpi_bsi_slv2";
		reg = <0x00 0x10225000 0x00 0x1000>;
	};

	dvfsp@10227000 {
		compatible = "mediatek,dvfsp";
		reg = <0x00 0x10227000 0x00 0x1000>;
	};

	dvfsp@00110800 {
		compatible = "mediatek,mt6761-dvfsp";
		reg = <0x00 0x110800 0x00 0x1400 0x00 0x110800 0x00 0x1400>;
		nvmem-cells = <0x37>;
		nvmem-cell-names = "efuse_segment_cell";
	};

	dramc@1022a000 {
		compatible = "mediatek,dramc";
		reg = <0x00 0x1022a000 0x00 0x2000 0x00 0x10232000 0x00 0x2000 0x00 0x1022c000 0x00 0x1000 0x00 0x10234000 0x00 0x1000 0x00 0x10228000 0x00 0x2000 0x00 0x10230000 0x00 0x2000 0x00 0x1022e000 0x00 0x1000 0x00 0x10236000 0x00 0x1000>;
	};

	gce@10238000 {
		compatible = "mediatek,gce\0syscon";
		reg = <0x00 0x10238000 0x00 0x4000>;
		interrupts = <0x00 0x62 0x08>;
		g3d_config_base = <0x13000000 0x00 0xffff0000>;
		mmsys_config_base = <0x14000000 0x01 0xffff0000>;
		disp_dither_base = <0x14010000 0x02 0xffff0000>;
		mm_na_base = <0x14020000 0x03 0xffff0000>;
		imgsys_base = <0x15020000 0x04 0xffff0000>;
		vdec_gcon_base = <0x18800000 0x05 0xffff0000>;
		venc_gcon_base = <0x18810000 0x06 0xffff0000>;
		conn_peri_base = <0x18820000 0x07 0xffff0000>;
		topckgen_base = <0x18830000 0x08 0xffff0000>;
		kp_base = <0x18840000 0x09 0xffff0000>;
		scp_sram_base = <0x10000000 0x0a 0xffff0000>;
		infra_na3_base = <0x10010000 0x0b 0xffff0000>;
		infra_na4_base = <0x10020000 0x0c 0xffff0000>;
		scp_base = <0x10030000 0x0d 0xffff0000>;
		mcucfg_base = <0x10040000 0x0e 0xffff0000>;
		gcpu_base = <0x10050000 0x0f 0xffff0000>;
		usb0_base = <0x10200000 0x10 0xffff0000>;
		usb_sif_base = <0x10280000 0x11 0xffff0000>;
		audio_base = <0x17000000 0x12 0xffff0000>;
		vdec_base = <0x17010000 0x13 0xffff0000>;
		msdc2_base = <0x17020000 0x14 0xffff0000>;
		vdec1_base = <0x17030000 0x15 0xffff0000>;
		msdc3_base = <0x18000000 0x16 0xffff0000>;
		ap_dma_base = <0x18010000 0x17 0xffff0000>;
		gce_base = <0x18020000 0x18 0xffff0000>;
		vdec2_base = <0x18040000 0x19 0xffff0000>;
		vdec3_base = <0x18050000 0x1a 0xffff0000>;
		camsys_base = <0x18080000 0x1b 0xffff0000>;
		camsys1_base = <0x180a0000 0x1c 0xffff0000>;
		camsys2_base = <0x180b0000 0x1d 0xffff0000>;
		pwm_sw_base = <0x1100e000 0x63 0xffff0000>;
		mipitx0_base = <0x11c80000 0x63 0xffff0000>;
		mdp_rdma0_sof = <0x00>;
		mdp_ccorr0_sof = <0x01>;
		mdp_rsz0_sof = <0x02>;
		mdp_rsz1_sof = <0x03>;
		mdp_wdma_sof = <0x04>;
		mdp_wrot0_sof = <0x05>;
		mdp_tdshp0_sof = <0x06>;
		disp_ovl0_sof = <0x07>;
		disp_2l_ovl0_sof = <0x08>;
		disp_rdma0_sof = <0x09>;
		disp_wdma0_sof = <0x0a>;
		disp_color0_sof = <0x0b>;
		disp_ccorr0_sof = <0x0c>;
		disp_aal0_sof = <0x0d>;
		disp_gamma0_sof = <0x0e>;
		disp_dither0_sof = <0x0f>;
		disp_dsi0_sof = <0x10>;
		disp_rsz0_sof = <0x11>;
		img_dl_relay_sof = <0x12>;
		disp_pwm0_sof = <0x13>;
		mdp_rdma0_frame_done = <0x14>;
		mdp_ccorr0_frame_done = <0x15>;
		mdp_rsz0_frame_done = <0x16>;
		mdp_rsz1_frame_done = <0x17>;
		mdp_wrot0_write_frame_done = <0x18>;
		mdp_wdma_frame_done = <0x19>;
		mdp_tdshp0_frame_done = <0x1a>;
		disp_ovl0_frame_done = <0x1b>;
		disp_2l_ovl0_frame_done = <0x1c>;
		disp_rsz0_frame_done = <0x1d>;
		disp_rdma0_frame_done = <0x1e>;
		disp_wdma0_frame_done = <0x1f>;
		disp_color0_frame_done = <0x20>;
		disp_ccorr0_frame_done = <0x21>;
		disp_aal0_frame_done = <0x22>;
		disp_gamma0_frame_done = <0x23>;
		disp_dither0_frame_done = <0x24>;
		disp_dsi0_frame_done = <0x25>;
		stream_done_0 = <0x82>;
		stream_done_1 = <0x83>;
		stream_done_2 = <0x84>;
		stream_done_3 = <0x85>;
		stream_done_4 = <0x86>;
		stream_done_5 = <0x87>;
		stream_done_6 = <0x88>;
		stream_done_7 = <0x89>;
		stream_done_8 = <0x8a>;
		stream_done_9 = <0x8b>;
		buf_underrun_event_0 = <0x8c>;
		dsi0_te_event = <0x8d>;
		dsi0_irq_event = <0x8e>;
		dsi0_done_event = <0x8f>;
		disp_wdma0_rst_done = <0x93>;
		mdp_wdma_rst_done = <0x94>;
		mdp_wrot0_rst_done = <0x95>;
		mdp_rdma0_rst_done = <0x97>;
		disp_ovl0_frame_rst_done_pusle = <0x98>;
		dip_cq_thread2_frame_done = <0x101>;
		dip_cq_thread1_frame_done = <0x102>;
		dip_cq_thread0_frame_done = <0x103>;
		isp_frame_done_p1_1 = <0x104>;
		isp_frame_done_p1_0 = <0x105>;
		camsv_0_pass1_done = <0x106>;
		camsv_1_pass1_done = <0x107>;
		seninf_0_fifo_full = <0x108>;
		seninf_1_fifo_full = <0x109>;
		seninf_2_fifo_full = <0x10a>;
		seninf_3_fifo_full = <0x10b>;
		seninf_4_fifo_full = <0x10c>;
		seninf_5_fifo_full = <0x10d>;
		seninf_6_fifo_full = <0x10e>;
		seninf_7_fifo_full = <0x10f>;
		venc_done = <0x121>;
		jpgenc_done = <0x122>;
		jpgdec_done = <0x123>;
		venc_mb_done = <0x124>;
		venc_128byte_cnt_done = <0x125>;
		max_prefetch_cnt = <0x01>;
		prefetch_size = <0x60>;
		sram_size_cpr_64 = <0x40>;
		mmsys_config = <0x38>;
		mdp_rdma0 = <0x39>;
		mdp_rsz0 = <0x3a>;
		mdp_rsz1 = <0x3b>;
		mdp_wdma0 = <0x3c>;
		mdp_wrot0 = <0x3d>;
		mdp_tdshp0 = <0x3e>;
		mdp_color0 = <0x3f>;
		mdp_ccorr0 = <0x40>;
		mm_mutex = <0x41>;
		sram_share_cnt = <0x01>;
		sram_share_engine = <0x0a>;
		sram_share_event = <0x2c6>;
		clocks = <0x22 0x09 0x22 0x18>;
		clock-names = "GCE\0GCE_TIMER";
		mediatek,mailbox-gce = <0x42>;
		thread_count = <0x10>;
		secure_thread = <0x08 0x0a>;
		mboxes = <0x42 0x00 0x00 0x04 0x42 0x01 0x00 0x04 0x42 0x02 0x00 0x05 0x42 0x03 0x00 0x04 0x42 0x04 0x00 0x04 0x42 0x05 0x00 0x04 0x42 0x06 0xc8 0x03 0x42 0x07 0xffffffff 0x02 0x42 0x08 0x00 0x01 0x42 0x09 0x00 0x01 0x42 0x0a 0x00 0x01 0x42 0x0b 0x00 0x01 0x42 0x0c 0x00 0x01 0x42 0x0d 0x00 0x01 0x42 0x0e 0x00 0x01 0x42 0x0f 0x00 0x01>;
		phandle = <0xa1>;
	};

	gce_mbox@10238000 {
		compatible = "mediatek,mt6761-gce";
		reg = <0x00 0x10238000 0x00 0x4000>;
		interrupts = <0x00 0x62 0x08>;
		#mbox-cells = <0x03>;
		#gce-event-cells = <0x01>;
		#gce-subsys-cells = <0x02>;
		default_tokens = [02 bc 02 bd 02 be 02 bf 02 c0 02 c6 02 c7];
		clocks = <0x22 0x09 0x22 0x18>;
		clock-names = "gce\0gce-timer";
		phandle = <0x42>;
	};

	ap_ccif2@1023c000 {
		compatible = "mediatek,ap_ccif2";
		reg = <0x00 0x1023c000 0x00 0x1000>;
		interrupts = <0x00 0x57 0x08>;
	};

	md_ccif2@1023d000 {
		compatible = "mediatek,md_ccif2";
		reg = <0x00 0x1023d000 0x00 0x1000>;
	};

	ap_ccif3@1023e000 {
		compatible = "mediatek,ap_ccif3";
		reg = <0x00 0x1023e000 0x00 0x1000>;
		interrupts = <0x00 0x5a 0x08>;
	};

	md_ccif3@1023f000 {
		compatible = "mediatek,md_ccif3";
		reg = <0x00 0x1023f000 0x00 0x1000>;
	};

	sspm@10440000 {
		compatible = "mediatek,mt6761-sspm";
		reg = <0x00 0x10440000 0x00 0x10000 0x00 0x10450000 0x00 0x100 0x00 0x10451000 0x00 0x08 0x00 0x10460000 0x00 0x100 0x00 0x10461000 0x00 0x08 0x00 0x10470000 0x00 0x100 0x00 0x10471000 0x00 0x08 0x00 0x10480000 0x00 0x100 0x00 0x10481000 0x00 0x08 0x00 0x10490000 0x00 0x100 0x00 0x10491000 0x00 0x08>;
		reg-names = "cfgreg\0mbox0_base\0mbox0_ctrl\0mbox1_base\0mbox1_ctrl\0mbox2_base\0mbox2_ctrl\0mbox3_base\0mbox3_ctrl\0mbox4_base\0mbox4_ctrl";
		interrupts = <0x00 0x92 0x04 0x00 0x95 0x04 0x00 0x96 0x04 0x00 0x97 0x04 0x00 0x98 0x04 0x00 0x99 0x04>;
		interrupt-names = "ipc\0mbox0\0mbox1\0mbox2\0mbox3\0mbox4";
	};

	gic500@0c000000 {
		compatible = "mediatek,gic500";
		reg = <0x00 0xc000000 0x00 0x400000>;
	};

	gic_cpu@0c400000 {
		compatible = "mediatek,gic_cpu";
		reg = <0x00 0xc400000 0x00 0x40000>;
	};

	dfd@10200b00 {
		compatible = "mediatek,dfd";
		reg = <0x00 0x10200b00 0x00 0x10000>;
		mediatek,enabled = <0x01>;
		mediatek,chain_length = <0x61a8>;
		mediatek,rg_dfd_timeout = <0xa0>;
		mediatek,check_dfd_support = <0x01>;
		mediatek,dfd_infra_base = <0x390>;
		mediatek,dfd_ap_addr_offset = <0x18>;
		mediatek,dfd_latch_offset = <0x48>;
		reg_base = <0x43>;
	};

	dbg_cti@0d020000 {
		compatible = "mediatek,dbg_cti";
		reg = <0x00 0xd020000 0x00 0x10000>;
	};

	dbg_etr@0d030000 {
		compatible = "mediatek,dbg_etr";
		reg = <0x00 0xd030000 0x00 0x10000>;
	};

	dbg_funnel@0d040000 {
		compatible = "mediatek,dbg_funnel";
		reg = <0x00 0xd040000 0x00 0x10000>;
	};

	dbg_dem@0d0a0000 {
		compatible = "mediatek,dbg_dem";
		reg = <0x00 0xd0a0000 0x00 0x10000>;
		interrupts = <0x00 0x54 0x08>;
	};

	dbg_mdsys1@0d0c0000 {
		compatible = "mediatek,dbg_mdsys1";
		reg = <0x00 0xd0c0000 0x00 0x40000>;
	};

	dbg_apmcu_mp0@0d400000 {
		compatible = "mediatek,dbg_apmcu_mp0";
		reg = <0x00 0xd400000 0x00 0x1000>;
	};

	dbg_apmcu_mp0@0d410000 {
		compatible = "mediatek,dbg_apmcu_mp0";
		reg = <0x00 0xd410000 0x00 0x1000>;
	};

	dbg_apmcu_mp0@0d420000 {
		compatible = "mediatek,dbg_apmcu_mp0";
		reg = <0x00 0xd420000 0x00 0x1000>;
	};

	dbg_apmcu_mp0@0d430000 {
		compatible = "mediatek,dbg_apmcu_mp0";
		reg = <0x00 0xd430000 0x00 0x1000>;
	};

	dbg_apmcu_mp0@0d440000 {
		compatible = "mediatek,dbg_apmcu_mp0";
		reg = <0x00 0xd440000 0x00 0x1000>;
	};

	dbg_apmcu_mp0@0d510000 {
		compatible = "mediatek,dbg_apmcu_mp0";
		reg = <0x00 0xd510000 0x00 0x1000>;
	};

	dbg_apmcu_mp0@0d520000 {
		compatible = "mediatek,dbg_apmcu_mp0";
		reg = <0x00 0xd520000 0x00 0x1000>;
	};

	dbg_apmcu_mp0@0d530000 {
		compatible = "mediatek,dbg_apmcu_mp0";
		reg = <0x00 0xd530000 0x00 0x1000>;
	};

	dbg_apmcu_mp0@0d540000 {
		compatible = "mediatek,dbg_apmcu_mp0";
		reg = <0x00 0xd540000 0x00 0x1000>;
	};

	dbg_apmcu_mp0@0d610000 {
		compatible = "mediatek,dbg_apmcu_mp0";
		reg = <0x00 0xd610000 0x00 0x1000>;
	};

	dbg_apmcu_mp0@0d620000 {
		compatible = "mediatek,dbg_apmcu_mp0";
		reg = <0x00 0xd620000 0x00 0x1000>;
	};

	dbg_apmcu_mp0@0d630000 {
		compatible = "mediatek,dbg_apmcu_mp0";
		reg = <0x00 0xd630000 0x00 0x1000>;
	};

	dbg_apmcu_mp0@0d640000 {
		compatible = "mediatek,dbg_apmcu_mp0";
		reg = <0x00 0xd640000 0x00 0x1000>;
	};

	dbg_apmcu_mp0@0d710000 {
		compatible = "mediatek,dbg_apmcu_mp0";
		reg = <0x00 0xd710000 0x00 0x1000>;
	};

	dbg_apmcu_mp0@0d720000 {
		compatible = "mediatek,dbg_apmcu_mp0";
		reg = <0x00 0xd720000 0x00 0x1000>;
	};

	dbg_apmcu_mp0@0d730000 {
		compatible = "mediatek,dbg_apmcu_mp0";
		reg = <0x00 0xd730000 0x00 0x1000>;
	};

	dbg_apmcu_mp0@0d740000 {
		compatible = "mediatek,dbg_apmcu_mp0";
		reg = <0x00 0xd740000 0x00 0x1000>;
	};

	dbg_apmcu_mp1@0d800000 {
		compatible = "mediatek,dbg_apmcu_mp1";
		reg = <0x00 0xd800000 0x00 0x1000>;
	};

	dbg_apmcu_mp1@0d810000 {
		compatible = "mediatek,dbg_apmcu_mp1";
		reg = <0x00 0xd810000 0x00 0x1000>;
	};

	dbg_apmcu_mp1@0d820000 {
		compatible = "mediatek,dbg_apmcu_mp1";
		reg = <0x00 0xd820000 0x00 0x1000>;
	};

	dbg_apmcu_mp1@0d830000 {
		compatible = "mediatek,dbg_apmcu_mp1";
		reg = <0x00 0xd830000 0x00 0x1000>;
	};

	dbg_apmcu_mp1@0d840000 {
		compatible = "mediatek,dbg_apmcu_mp1";
		reg = <0x00 0xd840000 0x00 0x1000>;
	};

	dbg_apmcu_mp1@0d910000 {
		compatible = "mediatek,dbg_apmcu_mp1";
		reg = <0x00 0xd910000 0x00 0x1000>;
	};

	dbg_apmcu_mp1@0d920000 {
		compatible = "mediatek,dbg_apmcu_mp1";
		reg = <0x00 0xd920000 0x00 0x1000>;
	};

	dbg_apmcu_mp1@0d930000 {
		compatible = "mediatek,dbg_apmcu_mp1";
		reg = <0x00 0xd930000 0x00 0x1000>;
	};

	dbg_apmcu_mp1@0d940000 {
		compatible = "mediatek,dbg_apmcu_mp1";
		reg = <0x00 0xd940000 0x00 0x1000>;
	};

	dbg_apmcu_mp1@0da10000 {
		compatible = "mediatek,dbg_apmcu_mp1";
		reg = <0x00 0xda10000 0x00 0x1000>;
	};

	dbg_apmcu_mp1@0da20000 {
		compatible = "mediatek,dbg_apmcu_mp1";
		reg = <0x00 0xda20000 0x00 0x1000>;
	};

	dbg_apmcu_mp1@0da30000 {
		compatible = "mediatek,dbg_apmcu_mp1";
		reg = <0x00 0xda30000 0x00 0x1000>;
	};

	dbg_apmcu_mp1@0da40000 {
		compatible = "mediatek,dbg_apmcu_mp1";
		reg = <0x00 0xda40000 0x00 0x1000>;
	};

	dbg_apmcu_mp1@0db10000 {
		compatible = "mediatek,dbg_apmcu_mp1";
		reg = <0x00 0xdb10000 0x00 0x1000>;
	};

	dbg_apmcu_mp1@0db20000 {
		compatible = "mediatek,dbg_apmcu_mp1";
		reg = <0x00 0xdb20000 0x00 0x1000>;
	};

	dbg_apmcu_mp1@0db30000 {
		compatible = "mediatek,dbg_apmcu_mp1";
		reg = <0x00 0xdb30000 0x00 0x1000>;
	};

	dbg_apmcu_mp1@0db40000 {
		compatible = "mediatek,dbg_apmcu_mp1";
		reg = <0x00 0xdb40000 0x00 0x1000>;
	};

	ap_dma@11000000 {
		compatible = "mediatek,ap_dma";
		reg = <0x00 0x11000000 0x00 0x1000>;
		interrupts = <0x00 0x29 0x08>;
	};

	auxadc@11001000 {
		compatible = "mediatek,mt6765-auxadc";
		reg = <0x00 0x11001000 0x00 0x1000>;
		interrupts = <0x00 0x14 0x02>;
		clocks = <0x22 0x21>;
		clock-names = "main";
		#io-channel-cells = <0x01>;
		mediatek,cali-en-bit = <0x14>;
		mediatek,cali-ge-bit = <0x0a>;
		mediatek,cali-oe-bit = <0x00>;
		mediatek,cali-efuse-index = <0x6a>;
		#interconnect-cells = <0x01>;
		phandle = <0x36>;
	};

	dma-controller@11000580 {
		compatible = "mediatek,mt6577-uart-dma";
		reg = <0x00 0x11000680 0x00 0x80 0x00 0x11000700 0x00 0x80 0x00 0x11000780 0x00 0x80 0x00 0x11000800 0x00 0x80>;
		interrupts = <0x00 0x35 0x08 0x00 0x36 0x08 0x00 0x37 0x08 0x00 0x3c 0x08>;
		clocks = <0x22 0x26>;
		clock-names = "apdma";
		dma-requests = <0x04>;
		#dma-bits = <0x22>;
		#dma-cells = <0x01>;
		phandle = <0x44>;
	};

	serial@11020000 {
		compatible = "mediatek,mt6761-uart\0mediatek,mt6577-uart";
		reg = <0x00 0x11002000 0x00 0x1000>;
		interrupts = <0x00 0x23 0x08>;
		clocks = <0x21 0x22 0x16>;
		clock-names = "baud\0bus";
		dmas = <0x44 0x00 0x44 0x01>;
		dma-names = "tx\0rx";
		phandle = <0xa2>;
	};

	serial@11030000 {
		compatible = "mediatek,mt6761-uart\0mediatek,mt6577-uart";
		reg = <0x00 0x11003000 0x00 0x1000>;
		interrupts = <0x00 0x24 0x08>;
		clocks = <0x21 0x22 0x17>;
		clock-names = "baud\0bus";
		dmas = <0x44 0x02 0x44 0x03>;
		dma-names = "tx\0rx";
		phandle = <0xa3>;
	};

	pwm@11006000 {
		compatible = "mediatek,pwm";
		reg = <0x00 0x11006000 0x00 0x1000>;
		interrupts = <0x00 0x15 0x08>;
		clocks = <0x22 0x10 0x22 0x11 0x22 0x12 0x22 0x13 0x22 0x14 0x22 0x30 0x22 0x0f 0x22 0x15>;
		clock-names = "PWM1-main\0PWM2-main\0PWM3-main\0PWM4-main\0PWM5-main\0PWM6-main\0PWM-HCLK-main\0PWM-main";
		phandle = <0xa4>;
	};

	i2c_common {
		compatible = "mediatek,i2c_common";
		dma_support = [02];
		idvfs = [01];
		set_dt_div = [01];
		check_max_freq = [01];
		ver = [02];
		set_ltiming = [01];
		ext_time_config = [18 01];
		cnt_constraint = [01];
		phandle = <0xa5>;
	};

	i2c0@11007000 {
		compatible = "mediatek,i2c";
		id = <0x00>;
		reg = <0x00 0x11007000 0x00 0x1000 0x00 0x11000080 0x00 0x80>;
		interrupts = <0x00 0x1c 0x08>;
		clocks = <0x22 0x0b 0x22 0x26>;
		clock-names = "main\0dma";
		clock-div = <0x05>;
		scl-gpio-id = <0x53>;
		sda-gpio-id = <0x52>;
		gpio_start = <0x10002a00>;
		mem_len = <0x200>;
		eh_cfg = <0x20>;
		pu_cfg = <0x50>;
		rsel_cfg = <0x70>;
		aed = <0x1a>;
		mediatek,hs_only;
		phandle = <0xa6>;
	};

	i2c1@11008000 {
		compatible = "mediatek,i2c";
		id = <0x01>;
		reg = <0x00 0x11008000 0x00 0x1000 0x00 0x11000100 0x00 0x80>;
		interrupts = <0x00 0x1d 0x08>;
		clocks = <0x22 0x0b 0x22 0x26>;
		clock-names = "main\0dma";
		clock-div = <0x05>;
		scl-gpio-id = <0x54>;
		sda-gpio-id = <0x51>;
		gpio_start = <0x10002a00>;
		mem_len = <0x200>;
		eh_cfg = <0x20>;
		pu_cfg = <0x50>;
		rsel_cfg = <0x70>;
		aed = <0x1a>;
		mediatek,hs_only;
		phandle = <0xa7>;
	};

	i2c2@11009000 {
		compatible = "mediatek,i2c";
		id = <0x02>;
		reg = <0x00 0x11009000 0x00 0x1000 0x00 0x11000180 0x00 0x180>;
		interrupts = <0x00 0x1e 0x08>;
		clocks = <0x22 0x0b 0x22 0x26>;
		clock-names = "main\0dma";
		clock-div = <0x05>;
		scl-gpio-id = <0x67>;
		sda-gpio-id = <0x68>;
		gpio_start = <0x10002800>;
		mem_len = <0x200>;
		eh_cfg = <0x20>;
		pu_cfg = <0x60>;
		rsel_cfg = <0xa0>;
		aed = <0x1a>;
		ch_offset_default = <0x100>;
		ch_offset_ccu = <0x200>;
		mediatek,hs_only;
		phandle = <0xa8>;
	};

	i2c3@1100f000 {
		compatible = "mediatek,i2c";
		id = <0x03>;
		reg = <0x00 0x1100f000 0x00 0x1000 0x00 0x11000300 0x00 0x100>;
		interrupts = <0x00 0x1f 0x08>;
		clocks = <0x22 0x0b 0x22 0x26>;
		clock-names = "main\0dma";
		clock-div = <0x05>;
		scl-gpio-id = <0x32>;
		sda-gpio-id = <0x33>;
		gpio_start = <0x10002600>;
		mem_len = <0x200>;
		eh_cfg = <0x20>;
		pu_cfg = <0x90>;
		rsel_cfg = <0xb0>;
		aed = <0x1a>;
		ch_offset_default = <0x100>;
		mediatek,hs_only;
		phandle = <0xa9>;
	};

	i2c4@11011000 {
		compatible = "mediatek,i2c";
		id = <0x04>;
		reg = <0x00 0x11011000 0x00 0x1000 0x00 0x11000400 0x00 0x180>;
		interrupts = <0x00 0x20 0x08>;
		clocks = <0x22 0x0b 0x22 0x26>;
		clock-names = "main\0dma";
		clock-div = <0x05>;
		scl-gpio-id = <0x69>;
		sda-gpio-id = <0x6a>;
		gpio_start = <0x10002800>;
		mem_len = <0x200>;
		eh_cfg = <0x20>;
		pu_cfg = <0x60>;
		rsel_cfg = <0xa0>;
		aed = <0x1a>;
		ch_offset_default = <0x100>;
		ch_offset_ccu = <0x200>;
		mediatek,hs_only;
		phandle = <0xaa>;
	};

	i2c5@11016000 {
		compatible = "mediatek,i2c";
		id = <0x05>;
		reg = <0x00 0x11016000 0x00 0x1000 0x00 0x11000580 0x00 0x80>;
		interrupts = <0x00 0x4a 0x08>;
		clocks = <0x22 0x0b 0x22 0x26>;
		clock-names = "main\0dma";
		clock-div = <0x05>;
		scl-gpio-id = <0x30>;
		sda-gpio-id = <0x31>;
		gpio_start = <0x10002600>;
		mem_len = <0x200>;
		eh_cfg = <0x20>;
		pu_cfg = <0x90>;
		rsel_cfg = <0xb0>;
		aed = <0x1a>;
		mediatek,hs_only;
		phandle = <0xab>;
	};

	i2c6@1100d000 {
		compatible = "mediatek,i2c";
		id = <0x06>;
		reg = <0x00 0x1100d000 0x00 0x1000 0x00 0x11000600 0x00 0x80>;
		interrupts = <0x00 0x4b 0x08>;
		clocks = <0x22 0x0b 0x22 0x26>;
		clock-names = "main\0dma";
		clock-div = <0x05>;
		scl-gpio-id = <0xa1>;
		sda-gpio-id = <0xa2>;
		gpio_start = <0x10002c00>;
		mem_len = <0x200>;
		eh_cfg = <0x20>;
		pu_cfg = <0x50>;
		rsel_cfg = <0x70>;
		aed = <0x1a>;
		ch_offset_default = <0x100>;
		ch_offset_ccu = <0x200>;
		mediatek,hs_only;
		phandle = <0xac>;
	};

	i2c7 {
		phandle = <0xad>;
	};

	i2c8 {
		phandle = <0xae>;
	};

	i2c9 {
		phandle = <0xaf>;
	};

	spi0@1100a000 {
		compatible = "mediatek,mt6765-spi";
		mediatek,pad-select = <0x00>;
		reg = <0x00 0x1100a000 0x00 0x1000>;
		interrupts = <0x00 0x3e 0x08>;
		clocks = <0x0f 0x0d 0x0f 0x74 0x22 0x1b>;
		clock-names = "parent-clk\0sel-clk\0spi-clk";
		phandle = <0xb0>;
	};

	therm_ctrl@1100b000 {
		compatible = "mediatek,therm_ctrl";
		reg = <0x00 0x1100b000 0x00 0x1000>;
		interrupts = <0x00 0x16 0x08>;
		clocks = <0x22 0x0a>;
		clock-names = "therm-main";
		nvmem = <0x45>;
		nvmem-names = "mtk_efuse";
		nvmem-cells = <0x46 0x47>;
		nvmem-cell-names = "cpu_freq_segment_cell\0thermal_efuse_cell";
	};

	thermal-sensor1 {
		compatible = "mediatek,mtboard-thermistor1";
		io-channels = <0x36 0x00>;
		io-channel-names = "thermistor-ch0";
		interconnects = <0x36 0x00>;
		phandle = <0xb1>;
	};

	thermal-sensor2 {
		compatible = "mediatek,mtboard-thermistor2";
		io-channels = <0x36 0x01>;
		io-channel-names = "thermistor-ch1";
		interconnects = <0x36 0x01>;
		phandle = <0xb2>;
	};

	eem_fsm@1100b000 {
		compatible = "mediatek,eem_fsm";
		reg = <0x00 0x1100b000 0x00 0x1000>;
		interrupts = <0x00 0x45 0x08>;
		nvmem = <0x45>;
		nvmem-names = "mtk_efuse";
		nvmem-cells = <0x37>;
		nvmem-cell-names = "efuse_segment_cell";
	};

	btif@1100c000 {
		compatible = "mediatek,btif";
		reg = <0x00 0x1100c000 0x00 0x1000 0x00 0x11000880 0x00 0x80 0x00 0x11000900 0x00 0x80>;
		interrupts = <0x00 0x38 0x08 0x00 0x4c 0x08 0x00 0x4d 0x08>;
		clocks = <0x22 0x1a 0x22 0x26>;
		clock-names = "btifc\0apdmac";
	};

	consys@18002000 {
		compatible = "mediatek,mt6761-consys";
		#address-cells = <0x02>;
		#size-cells = <0x02>;
		reg = <0x00 0x18002000 0x00 0x1000 0x00 0x10007000 0x00 0x100 0x00 0x10001000 0x00 0x1000 0x00 0x10006000 0x00 0x1000 0x00 0x18007000 0x00 0x1000 0x00 0x180b1000 0x00 0x1000 0x00 0x180a3000 0x00 0x1000 0x00 0x180a5000 0x00 0x800 0x00 0x180c1000 0x00 0x1000 0x00 0x18004000 0x00 0x1000>;
		interrupts = <0x00 0xd3 0x08 0x00 0xd5 0x08 0x00 0xd6 0x01>;
		clocks = <0x33 0x01>;
		clock-names = "conn";
		pmic = <0x2b>;
		memory-region = <0x48>;
		phandle = <0x14>;
	};

	wifi@18000000 {
		compatible = "mediatek,wifi";
		reg = <0x00 0x18000000 0x00 0x100000>;
		interrupts = <0x00 0xd4 0x08>;
		memory-region = <0x49>;
	};

	disp_pwm@1100e000 {
		compatible = "mediatek,disp_pwm";
		reg = <0x00 0x1100e000 0x00 0x1000>;
	};

	spi1@11010000 {
		compatible = "mediatek,mt6765-spi";
		mediatek,pad-select = <0x00>;
		reg = <0x00 0x11010000 0x00 0x1000>;
		interrupts = <0x00 0x42 0x08>;
		clocks = <0x0f 0x0d 0x0f 0x74 0x22 0x34>;
		clock-names = "parent-clk\0sel-clk\0spi-clk";
		phandle = <0xb3>;
	};

	spi2@11012000 {
		compatible = "mediatek,mt6765-spi";
		mediatek,pad-select = <0x00>;
		reg = <0x00 0x11012000 0x00 0x1000>;
		interrupts = <0x00 0x48 0x08>;
		clocks = <0x0f 0x0d 0x0f 0x74 0x22 0x37>;
		clock-names = "parent-clk\0sel-clk\0spi-clk";
		phandle = <0xb4>;
	};

	spi3@11013000 {
		compatible = "mediatek,mt6765-spi";
		mediatek,pad-select = <0x00>;
		reg = <0x00 0x11013000 0x00 0x1000>;
		interrupts = <0x00 0x49 0x08>;
		clocks = <0x0f 0x0d 0x0f 0x74 0x22 0x38>;
		clock-names = "parent-clk\0sel-clk\0spi-clk";
		phandle = <0xb5>;
	};

	spi4@11014000 {
		compatible = "mediatek,mt6765-spi";
		mediatek,pad-select = <0x00>;
		reg = <0x00 0x11014000 0x00 0x1000>;
		interrupts = <0x00 0x27 0x08>;
		clocks = <0x0f 0x0d 0x0f 0x74 0x22 0x41>;
		clock-names = "parent-clk\0sel-clk\0spi-clk";
		phandle = <0xb6>;
	};

	spi5@11015000 {
		compatible = "mediatek,mt6765-spi";
		mediatek,pad-select = <0x00>;
		reg = <0x00 0x11015000 0x00 0x1000>;
		interrupts = <0x00 0x28 0x08>;
		clocks = <0x0f 0x0d 0x0f 0x74 0x22 0x42>;
		clock-names = "parent-clk\0sel-clk\0spi-clk";
		phandle = <0xb7>;
	};

	imp_iic@11017000 {
		compatible = "mediatek,imp_iic";
		reg = <0x00 0x11017000 0x00 0x1000>;
	};

	nfi@11018000 {
		compatible = "mediatek,nfi";
		reg = <0x00 0x11018000 0x00 0x1000>;
	};

	nfiecc@11019000 {
		compatible = "mediatek,nfiecc";
		reg = <0x00 0x11019000 0x00 0x1000>;
	};

	usb0@11200000 {
		compatible = "mediatek,mt6761-usb20";
		reg = <0x00 0x11200000 0x00 0x10000 0x00 0x11cc0000 0x00 0x10000>;
		interrupts = <0x00 0x11 0x08>;
		mode = <0x02>;
		multipoint = <0x01>;
		num_eps = <0x10>;
		clocks = <0x22 0x08 0x0f 0x7f 0x0f 0x23>;
		clock-names = "usb0\0usb0_clk_top_sel\0usb0_clk_univpll3_d4";
		charger = <0x25>;
		nvmem-cells = <0x4a>;
		nvmem-cell-names = "efuse_idx107";
		phandle = <0xb8>;
	};

	usb_sif@11210000 {
		compatible = "mediatek,usb_sif";
		reg = <0x00 0x11210000 0x00 0x1000>;
	};

	msdc@11230000 {
		compatible = "mediatek,msdc";
		reg = <0x00 0x11230000 0x00 0x10000>;
		interrupts = <0x00 0x17 0x08>;
		index = [00];
		clk_src = [01];
		bus-width = <0x08>;
		max-frequency = <0xbebc200>;
		cap-mmc-highspeed;
		mmc-ddr-1_8v;
		mmc-hs200-1_8v;
		mmc-hs400-1_8v;
		no-sd;
		no-sdio;
		non-removable;
		pinctl = <0x4b>;
		pinctl_hs400 = <0x4c>;
		pinctl_hs200 = <0x4d>;
		register_setting = <0x4e>;
		host_function = [00];
		bootable;
		status = "okay";
		vmmc-supply = <0x4f>;
		clocks = <0x22 0x4f 0x22 0x1c 0x22 0x45>;
		clock-names = "msdc0-clock\0msdc0-hclock\0msdc0-aes-clock";
		phandle = <0xb9>;
	};

	msdc@11240000 {
		compatible = "mediatek,msdc";
		reg = <0x00 0x11240000 0x00 0x10000>;
		interrupts = <0x00 0x18 0x08>;
		index = [01];
		clk_src = [02];
		bus-width = <0x04>;
		max-frequency = <0xbebc200>;
		cap-sd-highspeed;
		sd-uhs-sdr12;
		sd-uhs-sdr25;
		sd-uhs-sdr50;
		sd-uhs-sdr104;
		sd-uhs-ddr50;
		no-mmc;
		no-sdio;
		pinctl = <0x50>;
		pinctl_sdr104 = <0x51>;
		pinctl_sdr50 = <0x52>;
		pinctl_ddr50 = <0x53>;
		register_setting = <0x54>;
		host_function = [01];
		cd_level = [00];
		cd-gpios = <0x1e 0x01 0x00>;
		status = "okay";
		vmmc-supply = <0x55>;
		vqmmc-supply = <0x56>;
		mediatek,pwrap-regmap = <0x12>;
		clocks = <0x22 0x50 0x22 0x1d>;
		clock-names = "msdc1-clock\0msdc1-hclock";
		phandle = <0xba>;
	};

	msdc@11250000 {
		compatible = "mediatek,msdc2";
		reg = <0x00 0x11250000 0x00 0x10000>;
		status = "disable";
		phandle = <0xbb>;
	};

	msdc@11260000 {
		compatible = "mediatek,msdc3";
		reg = <0x00 0x11250000 0x00 0x10000>;
		status = "disable";
		phandle = <0xbc>;
	};

	msdc1_ins@0 {
		compatible = "mediatek,mt6761-sdcard-ins";
		phandle = <0xbd>;
	};

	msdc0_top@11cd0000 {
		compatible = "mediatek,msdc0_top";
		reg = <0x00 0x11cd0000 0x00 0x1000>;
	};

	msdc1_top@11c90000 {
		compatible = "mediatek,msdc1_top";
		reg = <0x00 0x11c90000 0x00 0x1000>;
	};

	usb1p_sif@11210000 {
		compatible = "mediatek,usb1p_sif";
		reg = <0x00 0x11210000 0x00 0x10000>;
	};

	audclk@11220000 {
		compatible = "mediatek,mt6761-audsys\0syscon";
		reg = <0x00 0x11220000 0x00 0x1000>;
		#clock-cells = <0x01>;
		phandle = <0x58>;
	};

	audio@11220000 {
		compatible = "mediatek,audio\0syscon";
		reg = <0x00 0x11220000 0x00 0x1000>;
		mediatek,btcvsd_snd = <0x57>;
		phandle = <0xbe>;
	};

	mt_soc_dl1_pcm@11220000 {
		compatible = "mediatek,mt_soc_pcm_dl1";
		reg = <0x00 0x11220000 0x00 0x1000>;
		interrupts = <0x00 0x61 0x08>;
		clocks = <0x58 0x00 0x58 0x04 0x58 0x05 0x58 0x03 0x58 0x01 0x58 0x02 0x58 0x06 0x22 0x2b 0x22 0x33 0x0f 0x78 0x0f 0x79 0x0f 0x05 0x0f 0x7a 0x0f 0x2b 0x0f 0x7b 0x0f 0x2e 0x20 0x06 0x21>;
		clock-names = "aud_afe_clk\0aud_dac_clk\0aud_dac_predis_clk\0aud_adc_clk\0aud_apll22m_clk\0aud_apll1_tuner_clk\0aud_tml_clk\0aud_infra_clk\0mtkaif_26m_clk\0top_mux_audio\0top_mux_audio_int\0top_sys_pll1_d4\0top_mux_aud_1\0top_apll1_ck\0top_mux_aud_eng1\0top_apll1_d8\0apmixed_apll1\0top_clk26m_clk";
		phandle = <0xbf>;
	};

	audio_sram@11221000 {
		compatible = "mediatek,audio_sram";
		reg = <0x00 0x11221000 0x00 0x9000>;
	};

	mtk-btcvsd-snd@18050000 {
		compatible = "mediatek,mtk-btcvsd-snd";
		reg = <0x00 0x18050000 0x00 0x1000 0x00 0x18080000 0x00 0x10000>;
		interrupts = <0x00 0xd2 0x08>;
		mediatek,infracfg = <0x22>;
		mediatek,offset = <0xf00 0x800 0x140 0x144 0x148>;
		phandle = <0x57>;
	};

	mipi_rx_ana_csi0a@11c10000 {
		compatible = "mediatek,mt6761-mipi0a\0syscon";
		reg = <0x00 0x11c10000 0x00 0x1000>;
		#clock-cells = <0x01>;
		phandle = <0x5b>;
	};

	mipi_rx_ana_csi1@11c20000 {
		compatible = "mediatek,mipi_rx_ana_csi1";
		reg = <0x00 0x11c20000 0x00 0x10000>;
	};

	mipi_rx_ana_csi0b@11c11000 {
		compatible = "mediatek,mt6761-mipi0b\0syscon";
		reg = <0x00 0x11c11000 0x00 0x1000>;
		#clock-cells = <0x01>;
		phandle = <0xc0>;
	};

	mipi_rx_ana_csi1a@11c12000 {
		compatible = "mediatek,mt6761-mipi1a\0syscon";
		reg = <0x00 0x11c12000 0x00 0x1000>;
		#clock-cells = <0x01>;
		phandle = <0xc1>;
	};

	mipi_rx_ana_csi1b@11c13000 {
		compatible = "mediatek,mt6761-mipi1b\0syscon";
		reg = <0x00 0x11c13000 0x00 0x1000>;
		#clock-cells = <0x01>;
		phandle = <0xc2>;
	};

	mipi_rx_ana_csi2a@11c14000 {
		compatible = "mediatek,mt6761-mipi2a\0syscon";
		reg = <0x00 0x11c14000 0x00 0x1000>;
		#clock-cells = <0x01>;
		phandle = <0xc3>;
	};

	mipi_rx_ana_csi2b@11c15000 {
		compatible = "mediatek,mt6761-mipi2b\0syscon";
		reg = <0x00 0x11c15000 0x00 0x1000>;
		#clock-cells = <0x01>;
		phandle = <0xc4>;
	};

	mipi_rx_ana_csi2@11c30000 {
		compatible = "mediatek,mipi_rx_ana_csi2";
		reg = <0x00 0x11c30000 0x00 0x10000>;
	};

	efuse@11c50000 {
		compatible = "mediatek,devinfo";
		reg = <0x00 0x11c50000 0x00 0x10000>;
		#address-cells = <0x01>;
		#size-cells = <0x01>;
		phandle = <0x45>;

		segment@78 {
			reg = <0x78 0x04>;
			phandle = <0x37>;
		};

		segment@1c {
			reg = <0x1c 0x04>;
			phandle = <0x46>;
		};

		segment@190 {
			reg = <0x190 0x0c>;
			phandle = <0x47>;
		};

		efuse_analog7@1ac {
			reg = <0x1ac 0x04>;
			phandle = <0x4a>;
		};
	};

	mipi_tx0@11c80000 {
		compatible = "mediatek,mipi_tx0";
		reg = <0x00 0x11c80000 0x00 0x10000>;
	};

	msdc1_pad_macro@11c90000 {
		compatible = "mediatek,msdc1_pad_macro";
		reg = <0x00 0x11c90000 0x00 0x10000>;
	};

	msdc0_pad_macro@11cd0000 {
		compatible = "mediatek,msdc0_pad_macro";
		reg = <0x00 0x11cd0000 0x00 0x10000>;
	};

	mfg_clark@13000000 {
		compatible = "mediatek,clark";
		reg = <0x00 0x13000000 0x00 0x80000>;
		interrupts = <0x00 0xcb 0x08>;
		interrupt-names = "RGX";
		clock-frequency = <0x21f98280>;
		ged-supply = <0x59>;
		phandle = <0xc5>;
	};

	mfg_cfg@13ffe000 {
		compatible = "mediatek,mfgcfg\0syscon";
		reg = <0x00 0x13ffe000 0x00 0x1000>;
		#clock-cells = <0x01>;
		phandle = <0xc6>;
	};

	gpufreq {
		compatible = "mediatek,mt6761-gpufreq";
		clocks = <0x0f 0x6d 0x0f 0x28 0x21 0x33 0x07 0x33 0x04 0x33 0x06>;
		clock-names = "clk_mux\0clk_main_parent\0clk_sub_parent\0mtcmos_mfg_async\0mtcmos_mfg\0mtcmos_mfg_core0";
		nvmem-cells = <0x37>;
		nvmem-cell-names = "efuse_segment_cell";
		vcore-supply = <0x35>;
		phandle = <0x5a>;
	};

	ged {
		compatible = "mediatek,ged";
		gpufreq-supply = <0x5a>;
		phandle = <0x59>;
	};

	mmsys_config@14000000 {
		compatible = "mediatek,mt6761-mmsys_config\0syscon";
		reg = <0x00 0x14000000 0x00 0x1000>;
		interrupts = <0x00 0xab 0x08>;
		#clock-cells = <0x01>;
		phandle = <0x10>;
	};

	dispsys_config@14000000 {
		compatible = "mediatek,mmsys_config\0syscon";
		reg = <0x00 0x14000000 0x00 0x1000>;
		interrupts = <0x00 0xab 0x08>;
		clocks = <0x10 0x17 0x10 0x1a 0x10 0x1b>;
		clock-names = "CAM_MDP\0IMG_DL_RELAY\0IMG_DL_ASYNC_TOP";
		phandle = <0x38>;
	};

	nfc {
		compatible = "mediatek,nfc-gpio-v2";
		gpio-rst = <0xac>;
		gpio-rst-std = <0x1e 0xac 0x00>;
		gpio-irq = <0x0a>;
		gpio-irq-std = <0x1e 0x0a 0x00>;
		phandle = <0xc7>;
	};

	irq_nfc {
		compatible = "mediatek,irq_nfc-eint";
		phandle = <0xc8>;
	};

	disp_mutex0@14001000 {
		compatible = "mediatek,disp_mutex0";
		reg = <0x00 0x14001000 0x00 0x1000>;
		interrupts = <0x00 0x9a 0x08>;
		phandle = <0x41>;
	};

	smi_common@14002000 {
		compatible = "mediatek,smi_common\0mediatek,mt6761-smi-common";
		reg = <0x00 0x14002000 0x00 0x1000>;
		mmsys_config = <0x38>;
		clocks = <0x33 0x03 0x10 0x15 0x10 0x16 0x10 0x13>;
		clock-names = "apb\0gals0\0gals1\0smi";
		mediatek,smi-id = <0x03>;
		mediatek,smi-cnt = <0x04>;
		phandle = <0xc9>;
	};

	mmdvfs_pmqos {
		compatible = "mediatek,mmdvfs_pmqos";
		mm_step0 = <0x1b4 0x01 0x00 0x01>;
		mm_step0_ext = <0x1b4 0x02 0x06 0x10c4ec>;
		mm_step1 = <0x138 0x01 0x00 0x02>;
		mm_step1_ext = <0x138 0x02 0x06 0x10c4ec>;
		mm_step2 = <0xe3 0x01 0x00 0x03>;
		mm_step2_ext = <0xe3 0x02 0x06 0x117627>;
		vopp_steps = <0x00 0x01 0x03>;
		disp_freq = "mm_step0\0mm_step1\0mm_step2";
		mdp_freq = "mm_step0\0mm_step1\0mm_step2";
		cam_freq = "mm_step0\0mm_step1\0mm_step2";
		img_freq = "mm_step0\0mm_step1\0mm_step2";
		vdec_freq = "mm_step0\0mm_step1\0mm_step2";
		venc_freq = "mm_step0\0mm_step1\0mm_step2";
		clocks = <0x0f 0x6b 0x0f 0x24 0x0f 0x1a 0x0f 0x25>;
		clock-names = "mmdvfs_clk_mm_sel_ck\0mmdvfs_clk_mmpll_ck\0mmdvfs_clk_univpll1_d2_ck\0mmdvfs_clk_mmpll_d2_ck";
	};

	smi_larb0@14003000 {
		compatible = "mediatek,smi_larb0\0mediatek,smi_larb\0mediatek,mt6761-smi-larb";
		reg = <0x00 0x14003000 0x00 0x1000>;
		mediatek,larb-id = <0x00>;
		clocks = <0x33 0x03 0x10 0x14>;
		clock-names = "apb\0smi";
		mediatek,smi-id = <0x00>;
		phandle = <0x30>;
	};

	mdp_rdma0@14004000 {
		compatible = "mediatek,mdp_rdma0";
		reg = <0x00 0x14004000 0x00 0x1000>;
		interrupts = <0x00 0x9b 0x08>;
		clocks = <0x10 0x00>;
		clock-names = "MDP_RDMA0";
		phandle = <0x39>;
	};

	mdp_ccorr0@14005000 {
		compatible = "mediatek,mdp_ccorr0";
		reg = <0x00 0x14005000 0x00 0x1000>;
		interrupts = <0x00 0xaa 0x08>;
		clocks = <0x10 0x01>;
		clock-names = "MDP_CCORR";
		phandle = <0x40>;
	};

	mdp_rsz0@14006000 {
		compatible = "mediatek,mdp_rsz0";
		reg = <0x00 0x14006000 0x00 0x1000>;
		interrupts = <0x00 0x9c 0x08>;
		clocks = <0x10 0x02>;
		clock-names = "MDP_RSZ0";
		phandle = <0x3a>;
	};

	mdp_rsz1@14007000 {
		compatible = "mediatek,mdp_rsz1";
		reg = <0x00 0x14007000 0x00 0x1000>;
		interrupts = <0x00 0x9d 0x08>;
		clocks = <0x10 0x03>;
		clock-names = "MDP_RSZ1";
		phandle = <0x3b>;
	};

	mdp_wdma0@14008000 {
		compatible = "mediatek,mdp_wdma0";
		reg = <0x00 0x14008000 0x00 0x1000>;
		interrupts = <0x00 0xa0 0x08>;
		clocks = <0x10 0x06>;
		clock-names = "MDP_WDMA";
		phandle = <0x3c>;
	};

	mdp_wrot0@14009000 {
		compatible = "mediatek,mdp_wrot0";
		reg = <0x00 0x14009000 0x00 0x1000>;
		interrupts = <0x00 0x9f 0x08>;
		clocks = <0x10 0x05>;
		clock-names = "MDP_WROT0";
		phandle = <0x3d>;
	};

	mdp_tdshp0@1400a000 {
		compatible = "mediatek,mdp_tdshp0";
		reg = <0x00 0x1400a000 0x00 0x1000>;
		clocks = <0x10 0x04>;
		clock-names = "MDP_TDSHP";
		phandle = <0x3e>;
	};

	disp_ovl0@1400b000 {
		compatible = "mediatek,disp_ovl0";
		reg = <0x00 0x1400b000 0x00 0x1000>;
		interrupts = <0x00 0xa1 0x08>;
	};

	disp_ovl0_2l@1400c000 {
		compatible = "mediatek,disp_ovl0_2l";
		reg = <0x00 0x1400c000 0x00 0x1000>;
		interrupts = <0x00 0xad 0x08>;
	};

	disp_rdma0@1400d000 {
		compatible = "mediatek,disp_rdma0";
		reg = <0x00 0x1400d000 0x00 0x1000>;
		interrupts = <0x00 0xa2 0x08>;
	};

	disp_wdma0@1400e000 {
		compatible = "mediatek,disp_wdma0";
		reg = <0x00 0x1400e000 0x00 0x1000>;
		interrupts = <0x00 0xa3 0x08>;
	};

	disp_color0@1400f000 {
		compatible = "mediatek,disp_color0";
		reg = <0x00 0x1400f000 0x00 0x1000>;
		interrupts = <0x00 0xa4 0x08>;
		phandle = <0x3f>;
	};

	disp_ccorr0@14010000 {
		compatible = "mediatek,disp_ccorr0";
		reg = <0x00 0x14010000 0x00 0x1000>;
		interrupts = <0x00 0xa5 0x08>;
	};

	disp_aal0@14011000 {
		compatible = "mediatek,disp_aal0";
		reg = <0x00 0x14011000 0x00 0x1000>;
		interrupts = <0x00 0xa6 0x08>;
	};

	disp_gamma0@14012000 {
		compatible = "mediatek,disp_gamma0";
		reg = <0x00 0x14012000 0x00 0x1000>;
		interrupts = <0x00 0xa7 0x08>;
	};

	disp_dither0@14013000 {
		compatible = "mediatek,disp_dither0";
		reg = <0x00 0x14013000 0x00 0x1000>;
		interrupts = <0x00 0xa8 0x08>;
	};

	dsi0@14014000 {
		compatible = "mediatek,dsi0";
		reg = <0x00 0x14014000 0x00 0x1000>;
		interrupts = <0x00 0xa9 0x08>;
	};

	disp_rsz0@14015000 {
		compatible = "mediatek,disp_rsz0";
		reg = <0x00 0x14015000 0x00 0x1000>;
		interrupts = <0x00 0xdc 0x08>;
	};

	mtkfb@0 {
		compatible = "mediatek,mtkfb";
		phandle = <0xca>;
	};

	dispsys {
		compatible = "mediatek,dispsys";
		mediatek,larb = <0x30>;
		clocks = <0x33 0x03 0x10 0x13 0x10 0x14 0x10 0x15 0x10 0x16 0x10 0x07 0x10 0x08 0x10 0x0a 0x10 0x0b 0x10 0x0c 0x10 0x0d 0x10 0x0e 0x10 0x0f 0x10 0x10 0x10 0x11 0x10 0x1c 0x10 0x1d 0x10 0x09 0x20 0x13 0x0f 0x7c 0x22 0x31 0x21 0x0f 0x1e 0x0f 0x2f 0x0f 0x31>;
		clock-names = "MMSYS_MTCMOS\0MMSYS_SMI_COMMON\0MMSYS_SMI_LARB0\0MMSYS_GALS_COMM0\0MMSYS_GALS_COMM1\0MMSYS_DISP_OVL0\0MMSYS_DISP_OVL0_2L\0MMSYS_DISP_RDMA0\0MMSYS_DISP_WDMA0\0MMSYS_DISP_COLOR0\0MMSYS_DISP_CCORR0\0MMSYS_DISP_AAL0\0MMSYS_DISP_GAMMA0\0MMSYS_DISP_DITHER0\0MMSYS_DSI0_MM_CK\0MMSYS_DSI0_IF_CK\0MMSYS_26M\0MMSYS_DISP_RSZ0\0APMIXED_MIPI_26M\0TOP_MUX_DISP_PWM\0DISP_PWM\0TOP_26M\0TOP_UNIVPLL2_D4\0TOP_ULPOSC1_D2\0TOP_ULPOSC1_D8";
	};

	dsi_te {
		compatible = "mediatek, DSI_TE-eint";
		status = "disabled";
		phandle = <0xcb>;
	};

	mm_mutex@14016000 {
		compatible = "mediatek,mm_mutex";
		reg = <0x00 0x14016000 0x00 0x1000>;
		phandle = <0xcc>;
	};

	camsys@15000000 {
		compatible = "mediatek,mt6761-camsys\0syscon";
		reg = <0x00 0x15000000 0x00 0x1000>;
		#clock-cells = <0x01>;
		phandle = <0x11>;
	};

	ispsys@15000000 {
		compatible = "mediatek,mt6761-ispsys";
		reg = <0x00 0x15004000 0x00 0x9000 0x00 0x1500d000 0x00 0x1000 0x00 0x15000000 0x00 0x52000 0x00 0x15040000 0x00 0x8000 0x00 0x10215000 0x00 0x3000 0x00 0x10211000 0x00 0x1000>;
		interrupts = <0x00 0xb3 0x08 0x00 0xb4 0x08 0x00 0xb5 0x08 0x00 0xb8 0x08 0x00 0xb9 0x08 0x00 0xba 0x08 0x00 0xbb 0x08>;
		clocks = <0x33 0x03 0x33 0x08 0x11 0x00 0x11 0x01 0x11 0x02 0x11 0x03 0x11 0x04 0x11 0x05 0x10 0x15 0x10 0x16 0x10 0x13>;
		clock-names = "CG_SCP_SYS_DIS\0CG_SCP_SYS_CAM\0CG_CAM_LARB2\0CG_CAM\0CG_CAMTG\0CG_CAM_SENINF\0CG_CAMSV0\0CG_CAMSV1\0CG_MM_SMI_COMM0\0CG_MM_SMI_COMM1\0CG_MM_SMI_COMMON";
	};

	smi_larb2@15001000 {
		compatible = "mediatek,smi_larb2\0mediatek,smi_larb\0mediatek,mt6761-smi-larb";
		reg = <0x00 0x15001000 0x00 0x1000>;
		mediatek,larb-id = <0x02>;
		clocks = <0x33 0x08 0x10 0x18 0x11 0x00>;
		clock-names = "apb\0gals\0smi";
		mediatek,smi-id = <0x02>;
		phandle = <0x32>;
	};

	cam@15004000 {
		compatible = "mediatek,cam";
		reg = <0x00 0x15004000 0x00 0x1000>;
	};

	cam_lut@15005000 {
		compatible = "mediatek,cam_lut";
		reg = <0x00 0x15005000 0x00 0x1000>;
	};

	camd@15006000 {
		compatible = "mediatek,camd";
		reg = <0x00 0x15006000 0x00 0x1000>;
	};

	cam_dma@15007000 {
		compatible = "mediatek,cam_dma";
		reg = <0x00 0x15007000 0x00 0x1000>;
	};

	fdvt@1500b000 {
		compatible = "mediatek,fdvt";
		reg = <0x00 0x1500b000 0x00 0x1000>;
		interrupts = <0x00 0xb6 0x08>;
		clocks = <0x11 0x06>;
		clock-names = "FD_CLK_CAM_FDVT";
	};

	cam_inner@1500d000 {
		compatible = "mediatek,cam_inner";
		reg = <0x00 0x1500d000 0x00 0x1000>;
	};

	camd_inner@1500e000 {
		compatible = "mediatek,camd_inner";
		reg = <0x00 0x1500e000 0x00 0x1000>;
	};

	cam_inner_dma@1500f000 {
		compatible = "mediatek,cam_inner_dma";
		reg = <0x00 0x1500f000 0x00 0x1000>;
	};

	camsv0@15050000 {
		compatible = "mediatek,camsv0";
		reg = <0x00 0x15050000 0x00 0x1000>;
	};

	camsv1@15051000 {
		compatible = "mediatek,camsv1";
		reg = <0x00 0x15051000 0x00 0x1000>;
	};

	kd_camera_hw1@15040000 {
		compatible = "mediatek,camera_hw";
		reg = <0x00 0x15040000 0x00 0x1000>;
		clocks = <0x0f 0x6f 0x0f 0x70 0x0f 0x71 0x0f 0x72 0x0f 0x16 0x0f 0x15 0x0f 0x20 0x0f 0x13 0x0f 0x1f 0x0f 0x14 0x21 0x11 0x03 0x20 0x0c 0x20 0x10 0x5b 0x00 0x0f 0x86 0x0f 0x1d 0x33 0x08>;
		clock-names = "CLK_TOP_CAMTG_SEL\0CLK_TOP_CAMTG1_SEL\0CLK_TOP_CAMTG2_SEL\0CLK_TOP_CAMTG3_SEL\0CLK_MCLK_6M\0CLK_MCLK_12M\0CLK_MCLK_13M\0CLK_MCLK_48M\0CLK_MCLK_52M\0CLK_MCLK_24M\0CLK_MCLK_26M\0CLK_CAM_SENINF_CG\0CLK_MIPI_C0_26M_CG\0CLK_MIPI_C1_26M_CG\0CLK_MIPI_ANA_0A_CG\0CLK_TOP_CAMTM_SEL_CG\0CLK_TOP_CAMTM_208_CG\0CLK_SCP_SYS_CAM";
		phandle = <0xcd>;
	};

	camera_af_hw_node {
		compatible = "mediatek,camera_af_lens";
		camaf_m1_pmic-supply = <0x5c>;
		phandle = <0xce>;
	};

	flashlight_core {
		compatible = "mediatek,flashlight_core";
		phandle = <0xcf>;
	};

	flashlights_mt6370 {
		compatible = "mediatek,flashlights_mt6370";
		decouple = <0x00>;
		phandle = <0xd0>;

		channel@1 {
			type = <0x00>;
			ct = <0x00>;
			part = <0x00>;
		};

		channel@2 {
			type = <0x00>;
			ct = <0x01>;
			part = <0x00>;
		};
	};

	flashlights_aw3644 {
		compatible = "mediatek,flashlights_aw3644";
		phandle = <0xd1>;
	};

	vcodecsys@17000000 {
		compatible = "mediatek,mt6761-vcodecsys\0syscon";
		reg = <0x00 0x17000000 0x00 0x10000>;
		#clock-cells = <0x01>;
		phandle = <0x5d>;
	};

	venc_gcon@17000000 {
		compatible = "mediatek,venc_gcon\0syscon";
		reg = <0x00 0x17000000 0x00 0x10000>;
		clocks = <0x33 0x03 0x33 0x09 0x10 0x15 0x10 0x16 0x10 0x13 0x5d 0x03 0x5d 0x01>;
		clock-names = "MT_SCP_SYS_DIS\0MT_SCP_SYS_VCODEC\0MT_CG_MM_SMI_COMM0\0MT_CG_MM_SMI_COMM1\0MT_CG_MM_SMI_COMMON\0MT_CG_VDEC\0MT_CG_VENC";
		phandle = <0xd2>;
	};

	smi_larb1@17010000 {
		compatible = "mediatek,smi_larb1\0mediatek,smi_larb\0mediatek,mt6761-smi-larb";
		reg = <0x00 0x17010000 0x00 0x1000>;
		mediatek,larb-id = <0x01>;
		clocks = <0x33 0x09 0x5d 0x01>;
		clock-names = "apb\0smi";
		mediatek,smi-id = <0x01>;
		phandle = <0x31>;
	};

	venc@17020000 {
		compatible = "mediatek,venc";
		reg = <0x00 0x17020000 0x00 0x10000>;
		interrupts = <0x00 0xae 0x08>;
	};

	venc_jpg@17030000 {
		compatible = "mediatek,venc_jpg";
		reg = <0x00 0x17030000 0x00 0x10000>;
		interrupts = <0x00 0xb0 0x08>;
		clocks = <0x5d 0x02>;
		clock-names = "MT_CG_VENC_JPGENC";
	};

	vdec@17040000 {
		compatible = "mediatek,vdec";
		reg = <0x00 0x17040000 0x00 0x10000>;
		interrupts = <0x00 0xb1 0x08>;
	};

	mbist@17050000 {
		compatible = "mediatek,mbist";
		reg = <0x00 0x17050000 0x00 0x10000>;
	};

	otg_iddig {
		compatible = "mediatek,usb_iddig_bi_eint";
		phandle = <0xd3>;
	};

	odm {
		compatible = "simple-bus";
		phandle = <0xd4>;
	};

	audio_snd_card {
		compatible = "mediatek,audio_snd_card";
	};

	mt_soc_deep_buffer_dl_pcm {
		compatible = "mediatek,mt_soc_pcm_deep_buffer_dl";
	};

	mt_soc_ul1_pcm {
		compatible = "mediatek,mt_soc_pcm_capture";
	};

	mt_soc_voice_md1 {
		compatible = "mediatek,mt_soc_pcm_voice_md1";
	};

	mt_soc_uldlloopback_pcm {
		compatible = "mediatek,mt_soc_pcm_uldlloopback";
	};

	mt_soc_i2s0_pcm {
		compatible = "mediatek,mt_soc_pcm_dl1_i2s0";
	};

	mt_soc_mrgrx_pcm {
		compatible = "mediatek,mt_soc_pcm_mrgrx";
	};

	mt_soc_mrgrx_awb_pcm {
		compatible = "mediatek,mt_soc_pcm_mrgrx_awb";
	};

	mt_soc_fm_i2s_pcm {
		compatible = "mediatek,mt_soc_pcm_fm_i2s";
	};

	mt_soc_fm_i2s_awb_pcm {
		compatible = "mediatek,mt_soc_pcm_fm_i2s_awb";
	};

	mt_soc_i2s0dl1_pcm {
		compatible = "mediatek,mt_soc_pcm_dl1_i2s0dl1";
	};

	mt_soc_dl1_awb_pcm {
		compatible = "mediatek,mt_soc_pcm_dl1_awb";
	};

	mt_soc_voice_md1_bt {
		compatible = "mediatek,mt_soc_pcm_voice_md1_bt";
	};

	mt_soc_voip_bt_out {
		compatible = "mediatek,mt_soc_pcm_dl1_bt";
	};

	mt_soc_voip_bt_in {
		compatible = "mediatek,mt_soc_pcm_bt_dai";
	};

	mt_soc_tdmrx_pcm {
		compatible = "mediatek,mt_soc_tdm_capture";
	};

	mt_soc_fm_mrgtx_pcm {
		compatible = "mediatek,mt_soc_pcm_fmtx";
	};

	mt_soc_ul2_pcm {
		compatible = "mediatek,mt_soc_pcm_capture2";
	};

	mt_soc_i2s0_awb_pcm {
		compatible = "mediatek,mt_soc_pcm_i2s0_awb";
	};

	mt_soc_voice_md2 {
		compatible = "mediatek,mt_soc_pcm_voice_md2";
	};

	mt_soc_routing_pcm {
		compatible = "mediatek,mt_soc_pcm_routing";
	};

	mt_soc_voice_md2_bt {
		compatible = "mediatek,mt_soc_pcm_voice_md2_bt";
	};

	mt_soc_hp_impedance_pcm {
		compatible = "mediatek,mt_soc_pcm_hp_impedance";
	};

	mt_soc_dummy_pcm {
		compatible = "mediatek,mt_soc_pcm_dummy";
	};

	mt_soc_codec_dummy_name {
		compatible = "mediatek,mt_soc_codec_dummy";
	};

	mt_soc_routing_dai_name {
		compatible = "mediatek,mt_soc_dai_routing";
	};

	mt_soc_dai_name {
		compatible = "mediatek,mt_soc_dai_stub";
	};

	mt_soc_dl2_pcm {
		compatible = "mediatek,mt_soc_pcm_dl2";
	};

	mt_soc_anc_pcm {
		compatible = "mediatek,mt_soc_pcm_anc";
	};

	mt_soc_pcm_voice_ultra {
		compatible = "mediatek,mt_soc_pcm_voice_ultra";
	};

	mt_soc_pcm_voice_usb {
		compatible = "mediatek,mt_soc_pcm_voice_usb";
	};

	mt_soc_pcm_voice_usb_echoref {
		compatible = "mediatek,mt_soc_pcm_voice_usb_echoref";
	};

	lk_charger {
		compatible = "mediatek,lk_charger";
		enable_anime;
		enable_pe_plus;
		enable_pd20_reset;
		power_path_support;
		max_charger_voltage = <0x632ea0>;
		fast_charge_voltage = <0x2dc6c0>;
		usb_charger_current = <0x7a120>;
		ac_charger_current = <0x1f47d0>;
		ac_charger_input_current = <0x30d400>;
		non_std_ac_charger_current = <0x7a120>;
		charging_host_charger_current = <0x16e360>;
		ta_ac_charger_current = <0x2dc6c0>;
		pd_charger_current = <0x7a120>;
		temp_t4_threshold = <0x32>;
		temp_t3_threshold = <0x2d>;
		temp_t1_threshold = <0x00>;
		phandle = <0xd5>;
	};

	pe {
		compatible = "mediatek,charger,pe";
		gauge = <0x5e>;
		ta_12v_support;
		ta_9v_support;
		pe_ichg_level_threshold = <0xf4240>;
		ta_start_battery_soc = <0x00>;
		ta_stop_battery_soc = <0x55>;
		min_charger_voltage = <0x4630c0>;
		ta_ac_12v_input_current = <0x30d400>;
		ta_ac_9v_input_current = <0x30d400>;
		ta_ac_7v_input_current = <0x30d400>;
		pe_charger_current = <0x2dc6c0>;
		phandle = <0xd6>;
	};

	pe2 {
		compatible = "mediatek,charger,pe2";
		gauge = <0x5e>;
		pe20_ichg_level_threshold = <0xf4240>;
		ta_start_battery_soc = <0x00>;
		ta_stop_battery_soc = <0x55>;
		min_charger_voltage = <0x4630c0>;
		cable_imp_threshold = <0x2bb>;
		vbat_cable_imp_threshold = <0x3b8260>;
		sc_input_current = <0x30d400>;
		sc_charger_current = <0x2dc6c0>;
		dcs_input_current = <0x30d400>;
		dcs_chg1_charger_current = <0x16e360>;
		dcs_chg2_charger_current = <0x16e360>;
		dual_polling_ieoc = <0x6ddd0>;
		slave_mivr_diff = <0x186a0>;
		phandle = <0xd7>;
	};

	pdc {
		compatible = "mediatek,charger,pd";
		gauge = <0x5e>;
		min_charger_voltage = <0x4630c0>;
		pd_vbus_low_bound = <0x4c4b40>;
		pd_vbus_upper_bound = <0x4c4b40>;
		vsys_watt = <0x4c4b40>;
		ibus_err = <0x0e>;
		pd_stop_battery_soc = <0x50>;
		sc_input_current = <0x30d400>;
		sc_charger_current = <0x2dc6c0>;
		dcs_input_current = <0x30d400>;
		dcs_chg1_charger_current = <0x16e360>;
		dcs_chg2_charger_current = <0x16e360>;
		dual_polling_ieoc = <0x6ddd0>;
		slave_mivr_diff = <0x186a0>;
		phandle = <0xd8>;
	};

	pe4 {
		compatible = "mediatek,charger,pe4";
		gauge = <0x5e>;
		min_charger_voltage = <0x4630c0>;
		pe40_stop_battery_soc = <0x50>;
		high_temp_to_leave_pe40 = <0x2e>;
		high_temp_to_enter_pe40 = <0x27>;
		low_temp_to_leave_pe40 = <0x0a>;
		low_temp_to_enter_pe40 = <0x10>;
		ibus_err = <0x0e>;
		pe40_r_cable_1a_lower = <0x1f4>;
		pe40_r_cable_2a_lower = <0x15f>;
		pe40_r_cable_3a_lower = <0xf0>;
		sc_input_current = <0x30d400>;
		sc_charger_current = <0x2dc6c0>;
		dcs_input_current = <0x30d400>;
		dcs_chg1_charger_current = <0x16e360>;
		dcs_chg2_charger_current = <0x16e360>;
		dual_polling_ieoc = <0x6ddd0>;
		slave_mivr_diff = <0x186a0>;
		phandle = <0xd9>;
	};

	charger {
		compatible = "mediatek,charger";
		gauge = <0x5e>;
		charger = <0x25>;
		bootmode = <0x26>;
		pmic = <0x2b>;
		algorithm_name = "Basic";
		charger_configuration = <0x00>;
		battery_cv = <0x432380>;
		max_charger_voltage = <0x632ea0>;
		min_charger_voltage = <0x4630c0>;
		enable_sw_jeita;
		jeita_temp_above_t4_cv = <0x3e8fa0>;
		jeita_temp_t3_to_t4_cv = <0x3e8fa0>;
		jeita_temp_t2_to_t3_cv = <0x432380>;
		jeita_temp_t1_to_t2_cv = <0x432380>;
		jeita_temp_t0_to_t1_cv = <0x3e8fa0>;
		jeita_temp_below_t0_cv = <0x3e8fa0>;
		jeita_temp_above_t4_cc_current = <0x00>;
		jeita_temp_t3_to_t4_cc_current = <0x1b7740>;
		jeita_temp_t2_to_t3_cc_current = <0x1b7740>;
		jeita_temp_t1_to_t2_cc_current = "\0\f5";
		jeita_temp_below_t0_cc_current = <0x00>;
		temp_t4_thres = <0x32>;
		temp_t4_thres_minus_x_degree = <0x30>;
		temp_t3_thres = <0x2d>;
		temp_t3_thres_minus_x_degree = <0x2c>;
		temp_t2_thres = <0x0f>;
		temp_t2_thres_plus_x_degree = <0x10>;
		temp_t1_thres = <0x00>;
		temp_t1_thres_plus_x_degree = <0x01>;
		temp_t0_thres = <0x00>;
		temp_t0_thres_plus_x_degree = <0x00>;
		temp_neg_10_thres = <0x00>;
		enable_min_charge_temp;
		min_charge_temp = <0x00>;
		min_charge_temp_plus_x_degree = <0x06>;
		max_charge_temp = <0x32>;
		max_charge_temp_minus_x_degree = <0x2f>;
		usb_charger_current = <0x7a120>;
		ac_charger_current = <0x1b7740>;
		ac_charger_input_current = <0x1b7740>;
		charging_host_charger_current = <0x16e360>;
		enable_dynamic_mivr;
		min_charger_voltage_1 = <0x432380>;
		min_charger_voltage_2 = <0x401640>;
		max_dmivr_charger_current = <0x1b7740>;
		phandle = <0x2a>;
	};

	pd_adapter {
		compatible = "mediatek,pd_adapter";
		adapter_name = "pd_adapter";
		phandle = <0xda>;
	};

	rt9465_slave_chr {
		compatible = "richtek,rt9465";
		status = "disabled";
		phandle = <0xdb>;
	};

	rt-pd-manager {
		compatible = "mediatek,rt-pd-manager";
	};

	mt6370_pmu_eint {
		phandle = <0xdc>;
	};

	pmic_clock_buffer_ctrl {
		compatible = "mediatek,pmic_clock_buffer";
		mediatek,clkbuf-quantity = <0x07>;
		mediatek,clkbuf-config = <0x02 0x01 0x01 0x02 0x00 0x00 0x00>;
		mediatek,clkbuf-driving-current = <0x01 0x01 0x01 0x01 0x01 0x01 0x01>;
		mediatek,bblpm-support = "enable";
		pwrap-dcxo-en = <0x188 0x00 0x188 0x01 0x188 0x00>;
		pwrap-dcxo-cfg = <0x18c 0x19c>;
		spm-pwr-status = <0x180 0x00 0x180 0x01>;
		pwrap = <0x12>;
		sleep = <0x5f>;
		phandle = <0xdd>;
	};

	pbm {
		compatible = "mediatek,pbm";
		io-channels = <0x23 0x00>;
		io-channel-names = "pmic_batadc";
		phandle = <0xde>;
	};

	battery {
		compatible = "mediatek,bat_gm30";
		phandle = <0xdf>;
	};

	pseudo_m4u {
		compatible = "mediatek,mt-pseudo_m4u";
		iommus = <0x60 0x02>;
	};

	pseudo_m4u-larb0 {
		compatible = "mediatek,mt-pseudo_m4u-port";
		mediatek,larbid = <0x00>;
		iommus = <0x60 0x00 0x60 0x01 0x60 0x02 0x60 0x03 0x60 0x04 0x60 0x05 0x60 0x06 0x60 0x07>;
	};

	pseudo_m4u-larb1 {
		compatible = "mediatek,mt-pseudo_m4u-port";
		mediatek,larbid = <0x01>;
		iommus = <0x60 0x20 0x60 0x21>;
	};

	pseudo_m4u-larb2 {
		compatible = "mediatek,mt-pseudo_m4u-port";
		mediatek,larbid = <0x02>;
		iommus = <0x60 0x40 0x60 0x41>;
	};

	radio_md_cfg {
		compatible = "mediatek,radio_md_cfg";
		phandle = <0xe0>;
	};

	dynamic_options {
		compatible = "mediatek,dynamic_options";
		phandle = <0xe1>;
	};

	cm_mgr@10200000 {
		compatible = "mediatek,mt6761-cm_mgr";
		reg = <0x00 0x10200000 0x00 0x4000>;
		reg-names = "cm_mgr_base";
		required-opps = <0x2c 0x2d 0x2e>;
		cm_mgr,cp_down = <0x64 0x64>;
		cm_mgr,cp_up = <0x64 0x64>;
		cm_mgr,dt_down = <0x00 0x03>;
		cm_mgr,dt_up = <0x00 0x03>;
		cm_mgr,vp_down = <0x64 0x64>;
		cm_mgr,vp_up = <0x64 0x64>;
		use_cpu_to_dram_map = "enable";
		cm_mgr_cpu_opp_to_dram = <0x00 0x00 0x00 0x00 0x01 0x01 0x01 0x01 0x01 0x02 0x02 0x02 0x02 0x02 0x02 0x02>;
		phandle = <0xe2>;
	};

	dram_ctrl {
		compatible = "mediatek,dram-qosctrl";
		required-opps = <0x2c 0x2d>;
	};

	swtp@ {
		compatible = "mediatek, swtp-eint";
		interrupt-parent = <0x1e>;
		interrupts = <0x37 0x04 0x37 0x00>;
		deb-gpios = <0x1e 0x37 0x00>;
		debounce = <0x7d000>;
		status = "okay";
		phandle = <0xe3>;
	};

	mt6370_pmu_dts {
		interrupt-controller;
		#interrupt-cells = <0x01>;
		mt6370,intr_gpio_num = <0x03>;
		mt6370,intr_gpio = <0x1e 0x03 0x00>;
		phandle = <0xe4>;

		core {
			compatible = "mediatek,mt6370_pmu_core";
			interrupt-names = "otp\0vdda_ovp\0vdda_uv";
			i2cstmr_rst_tmr = <0x00>;
			mrstb_en;
			mrstb_tmr = <0x03>;
			int_wdt = <0x00>;
			int_deg = <0x00>;
		};

		charger {
			compatible = "mediatek,mt6370_pmu_charger";
			interrupt-names = "chg_mivr\0chg_aiclmeasi\0attachi\0ovpctrl_uvp_d_evt\0chg_wdtmri\0chg_vbusov\0chg_tmri\0chg_treg\0dcdti";
			charger_name = "primary_chg";
			load_switch_name = "primary_load_switch";
			ichg = <0x1e8480>;
			aicr = <0x7a120>;
			mivr = <0x432380>;
			cv = <0x426030>;
			ieoc = <0x249f0>;
			safety_timer = <0x0c>;
			dc_wdt = "\0=\t";
			ircmp_resistor = <0x61a8>;
			ircmp_vclamp = <0x7d00>;
			enable_te;
			enable_wdt;
			lbp_hys_sel = <0x01>;
			lbp_dt = <0x01>;
			charger = <0x25>;
			bc12_sel = <0x00>;
			phandle = <0x25>;

			usb-otg-vbus {
				regulator-compatible = "usb-otg-vbus";
				regulator-name = "usb-otg-vbus";
				regulator-min-microvolt = <0x426030>;
				regulator-max-microvolt = <0x588040>;
				regulator-min-microamp = <0x7a120>;
				regulator-max-microamp = <0x2dc6c0>;
				phandle = <0xe5>;
			};
		};

		mt6370_pmu_fled1 {
			compatible = "mediatek,mt6370_pmu_fled1";
			interrupt-names = "fled_lvf\0fled2_short\0fled1_short";
			fled_enable = <0x01>;
			torch_cur = <0x493e0>;
			strobe_cur = <0x124f80>;
			strobe_timeout = <0x960>;
		};

		mt6370_pmu_fled2 {
			compatible = "mediatek,mt6370_pmu_fled2";
			fled_enable = <0x01>;
			torch_cur = <0x30d40>;
			strobe_cur = <0xf4240>;
			strobe_timeout = <0x4b0>;
		};

		ldo {
			compatible = "mediatek,mt6370_pmu_ldo";
			interrupt-names = "ldo_oc";
			ldo_oms = <0x01>;
			ldo_vrc_lt = <0x01>;

			mt6370_ldo {
				regulator-name = "irtx_ldo";
				regulator-min-microvolt = <0x186a00>;
				regulator-max-microvolt = "\0=\t";
			};
		};

		rgbled {
			compatible = "mediatek,mt6370_pmu_rgbled";
			interrupt-names = "isink4_short\0isink3_short\0isink2_short\0isink1_short\0isink4_open\0isink3_open\0isink2_open\0isink1_open";
			mt,led_name = "mt6370_pmu_led1\0mt6370_pmu_led2\0mt6370_pmu_led3\0mt6370_pmu_led4";
			mt,led_default_trigger = "cc_mode\0cc_mode\0cc_mode\0none";
		};

		bled {
			compatible = "mediatek,mt6370_pmu_bled";
			interrupt-names = "bled_ocp";
			mt,bled_name = "mt6370_pmu_bled";
			mt,chan_en = <0x0f>;
			mt,map_linear;
			mt,bl_ovp_level = <0x03>;
			mt,bl_ocp_level = <0x02>;
			mt,use_pwm;
			mt,pwm_fsample = <0x02>;
			mt,pwm_deglitch = <0x01>;
			mt,pwm_hys_en = <0x01>;
			mt,pwm_hys = <0x00>;
			mt,pwm_avg_cycle = <0x00>;
			mt,bled_ramptime = <0x03>;
			mt,bled_flash_ramp = <0x01>;
			mt,max_bled_brightness = <0x200>;
			mt,bled_curr_scale = <0x00>;
			mt,pwm_lpf_coef = <0x00>;
		};

		dsv {
			compatible = "mediatek,mt6370_pmu_dsv";
			interrupt-names = "dsv_vneg_ocp\0dsv_vpos_ocp\0dsv_bst_ocp\0dsv_vneg_scp\0dsv_vpos_scp";
			db_ext_en = <0x00>;
			db_periodic_fix = <0x00>;
			db_single_pin = <0x00>;
			db_freq_pm = <0x00>;
			db_periodic_mode = <0x00>;
			db_startup = <0x00>;
			db_vneg_20ms = <0x01>;
			db_vneg_disc = <0x00>;
			db_vpos_20ms = <0x01>;
			db_vpos_disc = <0x01>;
			db_delay = <0x03>;
			db_vbst = <0x1644>;
			db_vpos_slew = <0x01>;
			db_vneg_slew = <0x01>;

			mt6370_dsvp {
				regulator-name = "dsv_pos";
				regulator-min-microvolt = "\0=\t";
				regulator-max-microvolt = <0x5b8d80>;
			};

			mt6370_dsvn {
				regulator-name = "dsv_neg";
				regulator-min-microvolt = "\0=\t";
				regulator-max-microvolt = <0x5b8d80>;
			};
		};
	};

	type_c_port0 {
		tcpc-dual,supported_modes = <0x00>;
		mt-tcpc,name = "type_c_port0";
		mt-tcpc,role_def = <0x04>;
		mt-tcpc,rp_level = <0x01>;
		mt-tcpc,vconn_supply = <0x01>;
		mt-tcpc,notifier_supply_num = <0x02>;
		mt6370pd,intr_gpio = <0x1e 0x18 0x00>;
		mt6370pd,intr_gpio_num = <0x18>;
		charger = <0x25>;
		phandle = <0xe6>;

		pd-data {
			pd,vid = <0x29cf>;
			pd,pid = <0x5081>;
			pd,source-cap-ext = <0x508129cf 0x00 0x00 0x00 0x00 0x7000000>;
			pd,mfrs = "RichtekTCPC";
			pd,charging_policy = <0x31>;
			pd,source-pdo-size = <0x01>;
			pd,source-pdo-data = <0x19096>;
			pd,sink-pdo-size = <0x01>;
			pd,sink-pdo-data = <0x190c8>;
			pd,id-vdo-size = <0x03>;
			pd,id-vdo-data = <0xd10029cf 0x00 0x50810000>;
			bat,nr = <0x01>;
			pd,country_nr = <0x00>;

			bat-info0 {
				bat,vid = <0x29cf>;
				bat,pid = <0x5081>;
				bat,mfrs = "bat1";
				bat,design_cap = <0xbb8>;
			};
		};

		dpm_caps {
			local_dr_power;
			local_dr_data;
			local_usb_comm;
			local_no_suspend;
			local_vconn_supply;
			attemp_enter_dp_mode;
			attemp_discover_cable;
			attemp_discover_id;
			pr_check = <0x00>;
			dr_check = <0x00>;
		};

		displayport {
			1st_connection = "dfp_d";
			2nd_connection = "dfp_d";
			signal,dp_v13;
			usbr20_not_used;
			typec,receptacle;

			ufp_d {
			};

			dfp_d {
				pin_assignment,mode_c;
				pin_assignment,mode_d;
				pin_assignment,mode_e;
				pin_assignment,mode_f;
			};
		};
	};

	trusty {
		compatible = "android,trusty-smc-v1";
		ranges;
		#address-cells = <0x02>;
		#size-cells = <0x02>;
		tee-id = <0x00>;
		tee-name = "trusty";

		mtee {
			compatible = "mediatek,trusty-mtee-v1";
		};

		gz-main {
			compatible = "mediatek,trusty-gz";
		};

		trusty-irq {
			compatible = "android,trusty-irq-v1";
			ppi-interrupt-parent = <0x0e>;
		};

		trusty-virtio {
			compatible = "android,trusty-virtio-v1";
		};

		trusty-gz-log {
			compatible = "android,trusty-gz-log-v1";
		};
	};

	nebula {
		compatible = "android,nebula-smc-v1";
		ranges;
		#address-cells = <0x02>;
		#size-cells = <0x02>;
		tee-id = <0x01>;
		tee-name = "nebula";

		nebula-virtio {
			compatible = "android,nebula-virtio-v1";
		};

		nebula-irq {
			compatible = "android,nebula-irq-v1";
			ppi-interrupt-parent = <0x0e>;
		};

		nebula-gz-log {
			compatible = "android,nebula-gz-log-v1";
		};
	};

	__symbols__ {
		chosen = "/chosen";
		cluster0_opp = "/opp_table0";
		cpu0 = "/cpus/cpu@000";
		cpu1 = "/cpus/cpu@001";
		cpu2 = "/cpus/cpu@002";
		cpu3 = "/cpus/cpu@003";
		STANDBY = "/cpus/idle-states/standby";
		MCDI_CPU = "/cpus/idle-states/mcdi-cpu";
		MCDI_CLUSTER = "/cpus/idle-states/mcdi-cluster";
		SODI = "/cpus/idle-states/sodi";
		SODI3 = "/cpus/idle-states/sodi3";
		DPIDLE = "/cpus/idle-states/dpidle";
		SUSPEND = "/cpus/idle-states/suspend";
		consys_mem = "/reserved-memory/consys-reserve-memory";
		wifi_mem = "/reserved-memory/wifi-reserve-memory";
		cpu_dbgapb = "/cpu_dbgapb@0d410000";
		gic = "/interrupt-controller@0c000000";
		sysirq = "/intpol-controller@10200a80";
		infracfg_ao = "/infracfg_ao@10001000";
		scpsys = "/scpsys@10001000";
		scp_infra = "/scp_infra@10001000";
		topckgen = "/topckgen@10000000";
		dcm = "/dcm@10001000";
		io_cfg_lt = "/io_cfg_lt@10002000";
		io_cfg_lm = "/io_cfg_lm@10002200";
		io_cfg_lb = "/io_cfg_lb@10002400";
		io_cfg_bl = "/io_cfg_bl@10002600";
		io_cfg_rr = "/io_cfg_rr@10002800";
		io_cfg_rb = "/io_cfg_rb@10002a00";
		io_cfg_rt = "/io_cfg_rt@10002c00";
		pericfg = "/pericfg@10003000";
		smart_pa = "/smart_pa";
		tcpc_pd = "/tcpc_pd";
		md1_sim1_hot_plug_eint = "/md1_sim1_hot_plug_eint";
		md1_sim2_hot_plug_eint = "/md1_sim2_hot_plug_eint";
		gpio_usage_mapping = "/gpio";
		gpio = "/gpio@10005000";
		syscfg_pctl_0 = "/syscfg_pctl_0@10005000";
		sleep = "/sleep@10006000";
		eint = "/eint@1000b000";
		pio = "/pinctrl@10005000";
		msdc0_pins_default = "/pinctrl@10005000/msdc0@default";
		msdc0_pins_hs400 = "/pinctrl@10005000/msdc0@hs400";
		msdc0_pins_hs200 = "/pinctrl@10005000/msdc0@hs200";
		msdc0_register_setting_default = "/pinctrl@10005000/msdc0@register_default";
		msdc1_pins_default = "/pinctrl@10005000/msdc1@default";
		msdc1_pins_sdr104 = "/pinctrl@10005000/msdc1@sdr104";
		msdc1_pins_sdr50 = "/pinctrl@10005000/msdc1@sdr50";
		msdc1_pins_ddr50 = "/pinctrl@10005000/msdc1@ddr50";
		msdc1_register_setting_default = "/pinctrl@10005000/msdc1@register_default";
		msdc3_pins_default = "/pinctrl@10005000/msdc3@default";
		msdc3_register_setting_default = "/pinctrl@10005000/msdc3@register_default";
		toprgu = "/toprgu@10007000";
		clk26m = "/clocks/clk26m";
		clk13m = "/clocks/clk13m";
		clk32k = "/clocks/clk32k";
		apmixed = "/apmixed@1000c000";
		fhctl = "/fhctl@1000ce00";
		pwrap = "/pwrap@1000d000";
		main_pmic = "/pwrap@1000d000/main_pmic";
		pmic_accdet = "/pwrap@1000d000/main_pmic/pmic_accdet";
		mt6357keys = "/pwrap@1000d000/main_pmic/mt6357keys";
		pmic_auxadc = "/pwrap@1000d000/main_pmic/pmic_auxadc";
		mtk_gauge = "/pwrap@1000d000/main_pmic/mtk_gauge";
		mtk_charger_type = "/pwrap@1000d000/main_pmic/mtk_charger_type";
		mt6357_charger = "/pwrap@1000d000/main_pmic/mt6357_charger";
		mtk_ts_pmic = "/pwrap@1000d000/main_pmic/mtk_ts_pmic";
		mt6357_ts_buck1 = "/pwrap@1000d000/main_pmic/mt6357_ts_buck1";
		mt6357_ts_buck2 = "/pwrap@1000d000/main_pmic/mt6357_ts_buck2";
		pmic_efuse = "/pwrap@1000d000/main_pmic/pmic_efuse";
		mt6357regulator = "/pwrap@1000d000/main_pmic/mt6357regulator";
		mt_pmic_vs1_buck_reg = "/pwrap@1000d000/main_pmic/mt6357regulator/buck_vs1";
		mt_pmic_vmodem_buck_reg = "/pwrap@1000d000/main_pmic/mt6357regulator/buck_vmodem";
		mt_pmic_vcore_buck_reg = "/pwrap@1000d000/main_pmic/mt6357regulator/buck_vcore";
		mt_pmic_vproc_buck_reg = "/pwrap@1000d000/main_pmic/mt6357regulator/buck_vproc";
		mt_pmic_vpa_buck_reg = "/pwrap@1000d000/main_pmic/mt6357regulator/buck_vpa";
		mt_pmic_vfe28_ldo_reg = "/pwrap@1000d000/main_pmic/mt6357regulator/ldo_vfe28";
		mt_pmic_vxo22_ldo_reg = "/pwrap@1000d000/main_pmic/mt6357regulator/ldo_vxo22";
		mt_pmic_vrf18_ldo_reg = "/pwrap@1000d000/main_pmic/mt6357regulator/ldo_vrf18";
		mt_pmic_vrf12_ldo_reg = "/pwrap@1000d000/main_pmic/mt6357regulator/ldo_vrf12";
		mt_pmic_vefuse_ldo_reg = "/pwrap@1000d000/main_pmic/mt6357regulator/ldo_vefuse";
		mt_pmic_vcn33_bt_ldo_reg = "/pwrap@1000d000/main_pmic/mt6357regulator/ldo_vcn33_bt";
		mt_pmic_vcn33_wifi_ldo_reg = "/pwrap@1000d000/main_pmic/mt6357regulator/ldo_vcn33_wifi";
		mt_pmic_vcn28_ldo_reg = "/pwrap@1000d000/main_pmic/mt6357regulator/ldo_vcn28";
		mt_pmic_vcn18_ldo_reg = "/pwrap@1000d000/main_pmic/mt6357regulator/ldo_vcn18";
		mt_pmic_vcama_ldo_reg = "/pwrap@1000d000/main_pmic/mt6357regulator/ldo_vcama";
		mt_pmic_vcamd_ldo_reg = "/pwrap@1000d000/main_pmic/mt6357regulator/ldo_vcamd";
		mt_pmic_vcamio_ldo_reg = "/pwrap@1000d000/main_pmic/mt6357regulator/ldo_vcamio";
		mt_pmic_vldo28_ldo_reg = "/pwrap@1000d000/main_pmic/mt6357regulator/ldo_vldo28";
		mt_pmic_vsram_others_ldo_reg = "/pwrap@1000d000/main_pmic/mt6357regulator/ldo_vsram_others";
		mt_pmic_vsram_proc_ldo_reg = "/pwrap@1000d000/main_pmic/mt6357regulator/ldo_vsram_proc";
		mt_pmic_vaux18_ldo_reg = "/pwrap@1000d000/main_pmic/mt6357regulator/ldo_vaux18";
		mt_pmic_vaud28_ldo_reg = "/pwrap@1000d000/main_pmic/mt6357regulator/ldo_vaud28";
		mt_pmic_vio28_ldo_reg = "/pwrap@1000d000/main_pmic/mt6357regulator/ldo_vio28";
		mt_pmic_vio18_ldo_reg = "/pwrap@1000d000/main_pmic/mt6357regulator/ldo_vio18";
		mt_pmic_vdram_ldo_reg = "/pwrap@1000d000/main_pmic/mt6357regulator/ldo_vdram";
		mt_pmic_vmc_ldo_reg = "/pwrap@1000d000/main_pmic/mt6357regulator/ldo_vmc";
		mt_pmic_vmch_ldo_reg = "/pwrap@1000d000/main_pmic/mt6357regulator/ldo_vmch";
		mt_pmic_vemc_ldo_reg = "/pwrap@1000d000/main_pmic/mt6357regulator/ldo_vemc";
		mt_pmic_vsim1_ldo_reg = "/pwrap@1000d000/main_pmic/mt6357regulator/ldo_vsim1";
		mt_pmic_vsim2_ldo_reg = "/pwrap@1000d000/main_pmic/mt6357regulator/ldo_vsim2";
		mt_pmic_vibr_ldo_reg = "/pwrap@1000d000/main_pmic/mt6357regulator/ldo_vibr";
		mt_pmic_vusb33_ldo_reg = "/pwrap@1000d000/main_pmic/mt6357regulator/ldo_vusb33";
		mtk_rtc = "/pwrap@1000d000/main_pmic/mtk_rtc";
		fg_init = "/pwrap@1000d000/main_pmic/mtk_rtc/fg_init";
		fg_soc = "/pwrap@1000d000/main_pmic/mtk_rtc/fg_soc";
		ext_32k = "/pwrap@1000d000/main_pmic/mtk_rtc/ext_32k";
		pmic_codec = "/pwrap@1000d000/main_pmic/pmic_codec";
		clock_buffer_ctrl = "/pwrap@1000d000/main_pmic/clock_buffer_ctrl";
		scp = "/scp@10500000";
		keypad = "/kp@10010000";
		mrdump_ext_rst = "/mrdump_ext_rst";
		touch = "/touch";
		accdet = "/accdet";
		goodix_fp = "/fingerprint";
		dvfsrc = "/dvfsrc@10012000";
		dvfsrc_freq_opp2 = "/dvfsrc@10012000/opp2";
		dvfsrc_freq_opp1 = "/dvfsrc@10012000/opp1";
		dvfsrc_freq_opp0 = "/dvfsrc@10012000/opp0";
		timer = "/timer@10017000";
		iommu = "/m4u@10205000";
		hwrng = "/hwrng";
		ccifdriver = "/ccifdriver@10209000";
		cldmadriver = "/cldmadriver@10014000";
		mddriver = "/mddriver@10014000";
		md_auxadc = "/md_auxadc";
		bat_id_adc = "/bat_id_adc";
		md_thubadc = "/md_thubadc";
		gce = "/gce@10238000";
		gce_mbox = "/gce_mbox@10238000";
		auxadc = "/auxadc@11001000";
		apdma = "/dma-controller@11000580";
		uart0 = "/serial@11020000";
		uart1 = "/serial@11030000";
		pwm = "/pwm@11006000";
		i2c_common = "/i2c_common";
		i2c0 = "/i2c0@11007000";
		i2c1 = "/i2c1@11008000";
		i2c2 = "/i2c2@11009000";
		i2c3 = "/i2c3@1100f000";
		i2c4 = "/i2c4@11011000";
		i2c5 = "/i2c5@11016000";
		i2c6 = "/i2c6@1100d000";
		i2c7 = "/i2c7";
		i2c8 = "/i2c8";
		i2c9 = "/i2c9";
		spi0 = "/spi0@1100a000";
		tboard_thermistor1 = "/thermal-sensor1";
		tboard_thermistor2 = "/thermal-sensor2";
		consys = "/consys@18002000";
		spi1 = "/spi1@11010000";
		spi2 = "/spi2@11012000";
		spi3 = "/spi3@11013000";
		spi4 = "/spi4@11014000";
		spi5 = "/spi5@11015000";
		usb = "/usb0@11200000";
		msdc0 = "/msdc@11230000";
		msdc1 = "/msdc@11240000";
		msdc2 = "/msdc@11250000";
		msdc3 = "/msdc@11260000";
		msdc1_ins = "/msdc1_ins@0";
		audclk = "/audclk@11220000";
		audio = "/audio@11220000";
		audgpio = "/mt_soc_dl1_pcm@11220000";
		btcvsd_snd = "/mtk-btcvsd-snd@18050000";
		mipi_rx_ana_csi0a = "/mipi_rx_ana_csi0a@11c10000";
		mipi_rx_ana_csi0b = "/mipi_rx_ana_csi0b@11c11000";
		mipi_rx_ana_csi1a = "/mipi_rx_ana_csi1a@11c12000";
		mipi_rx_ana_csi1b = "/mipi_rx_ana_csi1b@11c13000";
		mipi_rx_ana_csi2a = "/mipi_rx_ana_csi2a@11c14000";
		mipi_rx_ana_csi2b = "/mipi_rx_ana_csi2b@11c15000";
		efuse = "/efuse@11c50000";
		efuse_segment = "/efuse@11c50000/segment@78";
		cpu_freq_segment = "/efuse@11c50000/segment@1c";
		thermal_efuse = "/efuse@11c50000/segment@190";
		efuse_analog7 = "/efuse@11c50000/efuse_analog7@1ac";
		mfg_clark = "/mfg_clark@13000000";
		mfg_cfg = "/mfg_cfg@13ffe000";
		gpufreq = "/gpufreq";
		ged = "/ged";
		mmsys_config = "/mmsys_config@14000000";
		dispsys_config = "/dispsys_config@14000000";
		nfc = "/nfc";
		irq_nfc = "/irq_nfc";
		disp_mutex0 = "/disp_mutex0@14001000";
		smi_common = "/smi_common@14002000";
		smi_larb0 = "/smi_larb0@14003000";
		mdp_rdma0 = "/mdp_rdma0@14004000";
		mdp_ccorr = "/mdp_ccorr0@14005000";
		mdp_rsz0 = "/mdp_rsz0@14006000";
		mdp_rsz1 = "/mdp_rsz1@14007000";
		mdp_wdma0 = "/mdp_wdma0@14008000";
		mdp_wrot0 = "/mdp_wrot0@14009000";
		mdp_tdshp0 = "/mdp_tdshp0@1400a000";
		disp_color0 = "/disp_color0@1400f000";
		mtkfb = "/mtkfb@0";
		dsi_te = "/dsi_te";
		mm_mutex = "/mm_mutex@14016000";
		camsys = "/camsys@15000000";
		smi_larb2 = "/smi_larb2@15001000";
		kd_camera_hw1 = "/kd_camera_hw1@15040000";
		camera_af_hw_node = "/camera_af_hw_node";
		flashlight_core = "/flashlight_core";
		flashlights_mt6370 = "/flashlights_mt6370";
		flashlights_aw3644 = "/flashlights_aw3644";
		vcodecsys = "/vcodecsys@17000000";
		venc_gcon = "/venc_gcon@17000000";
		smi_larb1 = "/smi_larb1@17010000";
		otg_iddig = "/otg_iddig";
		odm = "/odm";
		lk_charger = "/lk_charger";
		pe = "/pe";
		pe2 = "/pe2";
		pdc = "/pdc";
		pe4 = "/pe4";
		charger = "/charger";
		pd_adapter = "/pd_adapter";
		rt9465_slave_chr = "/rt9465_slave_chr";
		subpmic_pmu_eint = "/mt6370_pmu_eint";
		pmic_clock_buffer_ctrl = "/pmic_clock_buffer_ctrl";
		pbm = "/pbm";
		bat_gm30 = "/battery";
		radio_md_cfg = "/radio_md_cfg";
		dynamic_options = "/dynamic_options";
		cm_mgr = "/cm_mgr@10200000";
		swtp = "/swtp@";
		mt6370_pmu = "/mt6370_pmu_dts";
		mt6370_chg = "/mt6370_pmu_dts/charger";
		otg_vbus = "/mt6370_pmu_dts/charger/usb-otg-vbus";
		mt6370_typec = "/type_c_port0";
	};
};
